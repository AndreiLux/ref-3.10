/*
 * Power monitor devices for the E1784
 *
 * Copyright (c) 2014, NVIDIA CORPORATION.  All rights reserved.
 *
 * This program is free software; you can redistribute it and/or modify
 * it under the terms of the GNU General Public License as published by
 * the Free Software Foundation; either version 2 of the License, or
 * (at your option) any later version.
 *
 * This program is distributed in the hope that it will be useful, but WITHOUT
 * ANY WARRANTY; without even the implied warranty of MERCHANTABILITY or
 * FITNESS FOR A PARTICULAR PURPOSE.  See the GNU General Public License for
 * more details.
 */

/ {
	i2c@7000c400 {
		ina230x: ina230x@40 {
			compatible = "ti,ina230x";
			reg = <0x40>;
			ti,trigger-config = <0x7203>;
			ti,continuous-config = <0x7c07>;
			ti,current-threshold = <9000>;
			ti,rail-name = "VDD_BAT";
			ti,resistor = <10>;
			ti,calibration-data = <186>;
			ti,power-lsb = <7>;
			ti,divisor = <25>;
			ti,shunt-resistor-mohm = <10>;
			ti,precision-multiplier = <1>;
			ti,shunt-polartiy-inverted = <0>;
		};
	};
};
