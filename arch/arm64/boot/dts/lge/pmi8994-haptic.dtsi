/* Copyright (c) 2014, The Linux Foundation. All rights reserved.
 *
 * This program is free software; you can redistribute it and/or modify
 * it under the terms of the GNU General Public License version 2 and
 * only version 2 as published by the Free Software Foundation.
 *
 * This program is distributed in the hope that it will be useful,
 * but WITHOUT ANY WARRANTY; without even the implied warranty of
 * MERCHANTABILITY or FITNESS FOR A PARTICULAR PURPOSE.  See the
 * GNU General Public License for more details.
 */

&pmi8994_haptics {
	status = "okay";
	compatible = "qcom,qpnp-haptic";
	reg = <0xc000 0x100>;
	interrupts = <0x3 0xc0 0x0>,
		   <0x3 0xc0 0x1>;
	interrupt-names = "sc-irq", "play-irq";
	qcom,play-mode = "direct";
	qcom,wave-play-rate-us = <5263>;
	qcom,actuator-type = "erm";
	qcom,wave-shape = "square";
	qcom,vmax-mv = <2400>;
	qcom,ilim-ma = <150>;
	qcom,sc-deb-cycles = <8>;
	qcom,int-pwm-freq-khz = <505>;
	qcom,brake-pattern = [03 03 03 03];
	qcom,use-play-irq;
	qcom,use-sc-irq;
	qcom,wave-samples = [3e 3e 3e 3e 3e 3e 3e 3e];
	qcom,wave-rep-cnt = <1>;
	qcom,wave-samp-rep-cnt = <1>;
};

