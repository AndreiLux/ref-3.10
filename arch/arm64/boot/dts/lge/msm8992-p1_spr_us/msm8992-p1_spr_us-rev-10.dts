/* Copyright (c) 2014, The Linux Foundation. All rights reserved.
 *
 * This program is free software; you can redistribute it and/or modify
 * it under the terms of the GNU General Public License version 2 and
 * only version 2 as published by the Free Software Foundation.
 *
 * This program is distributed in the hope that it will be useful,
 * but WITHOUT ANY WARRANTY; without even the implied warranty of
 * MERCHANTABILITY or FITNESS FOR A PARTICULAR PURPOSE.  See the
 * GNU General Public License for more details.
 */


/dts-v1/;

#include "../../qcom/msm8992.dtsi"
#include "msm8992-p1_spr_us.dtsi"

/ {
	model = "Qualcomm Technologies, Inc. MSM8992 P1 SPR US";
	compatible = "qcom,msm8992-cdp", "qcom,msm8992", "qcom,cdp";
	qcom,board-id = <0xB64 0>;
};

//ADD HERE TO SUPPORT HW CHANGE

&soc {
	i2c_5: i2c@f9967000 {
		ti-tas2552_41@41 {
			status = "ok";
		};
	};
};



