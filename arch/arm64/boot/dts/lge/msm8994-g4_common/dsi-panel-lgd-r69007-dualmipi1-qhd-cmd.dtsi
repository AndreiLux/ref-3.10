/* Copyright (c) 2014, Code Aurora Forum. All rights reserved.
 *
 * This program is free software; you can redistribute it and/or modify
 * it under the terms of the GNU General Public License version 2 and
 * only version 2 as published by the Free Software Foundation.
 *
 * This program is distributed in the hope that it will be useful,
 * but WITHOUT ANY WARRANTY; without even the implied warranty of
 * MERCHANTABILITY or FITNESS FOR A PARTICULAR PURPOSE.  See the
 * GNU General Public License for more details.
 */

&mdss_mdp {
	dsi_dual_lgd_cmd_1: qcom,mdss_dsi_lgd_r69007_1440p_mipi1_cmd {
		qcom,mdss-dsi-panel-name = "LGD INCELL 1440p Dual 1 cmd mode dsi panel";
		qcom,mdss-dsi-panel-controller = <&mdss_dsi1>;
		qcom,mdss-dsi-panel-type = "dsi_cmd_mode";
		qcom,mdss-dsi-panel-destination = "display_2";
		qcom,mdss-dsi-panel-framerate = <60>;
		qcom,mdss-dsi-virtual-channel-id = <0>;
		qcom,mdss-dsi-stream = <0>;
		qcom,mdss-dsi-panel-width = <720>;
		qcom,mdss-dsi-panel-height = <2560>;
		qcom,mdss-dsi-h-front-porch = <192>;
		qcom,mdss-dsi-h-back-porch = <80>;
		qcom,mdss-dsi-h-pulse-width = <1>;
		qcom,mdss-dsi-h-sync-skew = <0>;
		qcom,mdss-dsi-v-back-porch = <7>;
		qcom,mdss-dsi-v-front-porch = <8>;
		qcom,mdss-dsi-v-pulse-width = <1>;
		qcom,mdss-dsi-h-left-border = <0>;
		qcom,mdss-dsi-h-right-border = <0>;
		qcom,mdss-dsi-v-top-border = <0>;
		qcom,mdss-dsi-v-bottom-border = <0>;
		qcom,mdss-dsi-bpp = <24>;
		qcom,mdss-dsi-color-order = "rgb_swap_rgb";
		qcom,mdss-dsi-underflow-color = <0xff>;
		qcom,mdss-dsi-border-color = <0>;
		qcom,mdss-dsi-h-sync-pulse = <0>;
		qcom,mdss-dsi-traffic-mode = "burst_mode";
		qcom,mdss-dsi-lane-map = "lane_map_0123";
		qcom,mdss-dsi-lane-hs = <1>;
		qcom,mdss-dsi-bllp-eof-power-mode;
		qcom,mdss-dsi-bllp-power-mode;
		qcom,cmd-sync-wait-broadcast;
		qcom,cmd-sync-wait-trigger;
		qcom,mdss-dsi-lane-0-state;
		qcom,mdss-dsi-lane-1-state;
		qcom,mdss-dsi-lane-2-state;
		qcom,mdss-dsi-lane-3-state;
		qcom,mdss-dsi-hor-line-idle = <0 40 256>,
						<40 120 128>,
						<120 240 64>;
		qcom,mdss-dsi-panel-timings = [F3 3A 26 00 6A 6E 2C 3E 2F 03 04 00];
		qcom,mdss-dsi-reset-sequence = <1 10>, <0 10>, <1 10>;
		qcom,mdss-dsi-t-clk-post = <0x02>;
		qcom,mdss-dsi-t-clk-pre = <0x2D>;
		qcom,mdss-dsi-bl-max-level = <4095>;
		qcom,mdss-dsi-dma-trigger = "trigger_sw";
		qcom,mdss-dsi-mdp-trigger = "none";
		qcom,mdss-dsi-te-pin-select = <1>;
		qcom,mdss-dsi-wr-mem-start = <0x2c>;
		qcom,mdss-dsi-wr-mem-continue = <0x3c>;
		qcom,mdss-dsi-te-dcs-command = <1>;
		qcom,mdss-dsi-te-check-enable;
		qcom,mdss-dsi-te-using-te-pin;
		qcom,mdss-dsi-on-command = [
			/* Manufacturer Command Protection */
			29 01 00 00 00 00 02
			B0 00
			/* DSI Control */
			29 01 00 00 00 00 04
			B6 3B D3 00
			/* Display Setting 1 */
			29 01 00 00 00 00 28
			C1 80 08 11 1F FC
			F2 C9 1F 5F 98
			B3 FE FF F7 FE
			FF D7 31 F1 CB
			3F 3F FD EF 03
			24 69 18 AA 40
			01 42 02 08 00
			01 00 01 00
			/* Display Setting 2 */
			29 01 00 00 00 00 0F
			C2 01 FA 00 04 64
			08 00 60 00 38
			70 00 00 00
			/* Display Setting 3 Active - V */
			29 01 00 00 00 00 09
			C3 07 01 08 01 00
			00 00 00
			/* Source Timing Setting & Sout Equalize Setting */
			29 01 00 00 00 00 12
			C4 70 00 00 00 00
			00 00 00 00 02
			01 00 01 01 00
			00 00
			/* LTPS Timing Setting */
			29 01 00 00 00 00 11
			C6 3C 00 3C 02 38
			01 0E 01 02 01
			02 03 0F 04 3C
			46
			/* Gamma Setting Common Set */
			29 01 00 00 00 00 1F
			C7 00 12 1E 2A 39
			47 50 5D 40 47
			52 5F 69 70 78
			00 12 1E 2A 39
			47 50 5D 40 47
			52 5F 69 70 78
			/* Digital Gamma Setting 1 */
			29 01 00 00 00 00 14
			C8 00 00 00 00 00
			FC 00 00 00 00
			00 FC 00 00 00
			00 00 FC 00
			/* Digital Gamma Setting 2 */
			29 01 00 00 00 00 14
			C9 00 00 00 00 00
			FC 00 00 00 00
			00 FC 00 00 00
			00 00 FC 00
			/* Panel PIN Control */
			29 01 00 00 00 00 14
			CB AA 1E E3 55 F1
			FF 00 00 00 00
			00 00 00 00 00
			00 00 00 00
			/* Panel IF Control */
			29 01 00 00 00 00 02
			CC 07
			/* V Black Control */
			29 01 00 00 00 00 0B
			CD 3A 86 3A 86 8D
			8D 04 04 00 00
			/* Power Setting(for CHGP) */
			29 01 00 00 00 00 11
			D0 3B 01 91 0B 8B
			19 19 00 00 00
			19 99 00 00 00
			00
			/* Power Setting for Internal Power */
			29 01 00 00 00 00 21
			D3 1B 3B BB 77 77
			77 BB B3 33 00
			80 A7 AC 5B 5B
			33 33 33 C0 00
			F2 0F FD 7C FF
			0F 99 00 33 00
			FF FF
			/* Driving Option anjd Touch Setting */
			29 01 00 00 00 00 06
			D4 57 33 07 00 FF
			/* Vcom Setting */
			29 01 00 00 00 00 0C
			D5 66 00 00 01 3D
			01 3D 00 38 00
			38
			/* Sequencer Timing Control for Pon */
			29 01 00 00 00 00 22
			D7 04 FF 23 15 75
			A4 C3 1F C3 1F
			D9 07 1C 1F 30
			8E 87 C7 E3 F1
			CC F0 1F F0 0D
			70 00 2A 00 7E
			1D 07 00
			/* Sequencer Test Control */
			29 01 00 00 00 00 02
			D6 01

			/* Color Ehancement */
		/*	29 01 00 00 00 00 2C
			CA 1D FC FC FC 00
			F1 F1 EC 00 EC
			EF EF 00 E2 00
			00 00 EC 00 00
			00 E7 FF 9F 83
			FF 9F 83 7D 00
			00 00 00 00 00
			00 00 00 00 00
			00 00 00*/

			/* CABC */
		/*	39 01 00 00 00 00 02
			51 FF
			39 01 00 00 00 00 02
			53 0C
			39 01 00 00 00 00 02
			55 01*/

			/* Sleep out & Display on set */
			/* Host display data transfer start(HS) */
			/* Display On */
			05 01 00 00 00 00 01 29
			/* Sleep out & wait 120ms*/
			05 01 00 00 78 00 01 11
			];
		qcom,mdss-dsi-on-command-state = "dsi_lp_mode";
		qcom,mdss-dsi-off-command = [
			/* Display off */
			05 01 00 00 14 00 01 28
			/* Sleep in */
			05 01 00 00 64 00 01 10
			];
		qcom,mdss-dsi-off-command-state = "dsi_hs_mode";
		qcom,cont-splash-enabled;
		qcom,blmap-size = <256>;
		qcom,blmap = <
			  0
			 109  109  109  109  109  109  109  109  109  109						// 001-010
			 109  109  110  110  110  111  111  112  112  112						// 011-020
			 113  113  114  115  117  119  121  122  124  126						// 021-030
			 128  129  131  133  135  137  140  142  145  148						// 031-040
			 150  153  156  158  161  164  166  169  172  177						// 041-050
			 183  188  194  199  205  210  216  221  227  232						// 051-060
			 237  242  247  252  257  263  268  273  278  283						// 061-070
			 288  293  299  306  313  321  328  336  343  350						// 071-080
			 358  365  373  380  388  396  404  412  420  429						// 081-090
			 437  445  453  462  470  478  486  495  506  518						// 091-100
			 529  541  553  564  576  588  599  611  623  634						// 101-110
			 645  657  668  679  691  702  714  725  736  748						// 111-120
			 759  771  785  799  814  828  842  857  871  885						// 121-130
			 900  914  928  943  960  978  995  1013  1031  1048					// 131-140
			 1066  1084  1101  1119  1137  1153  1170  1187  1204  1221				// 141-150
			 1238  1254  1271  1288  1305  1322  1339  1356  1376  1396				// 151-160
			 1417  1437  1458  1478  1498  1519  1539  1560  1580  1601				// 161-170
			 1622  1643  1664  1685  1706  1727  1748  1769  1790  1811				// 171-180
			 1832  1853  1874  1898  1923  1948  1973  1998  2023  2047				// 181-190
			 2072  2097  2122  2147  2172  2197  2222  2248  2273  2299				// 191-200
			 2324  2350  2375  2401  2426  2452  2477  2503  2535  2568				// 201-210
			 2601  2634  2667  2700  2733  2766  2799  2832  2865  2894				// 211-220
			 2924  2953  2983  3013  3042  3072  3101  3131  3161  3190				// 221-230
			 3220  3250  3284  3318  3352  3386  3420  3455  3489  3523				// 231-240
			 3557  3591  3625  3660  3699  3739  3778  3818  3857  3897				// 241-250
			 3936  3976  4015  4055  4095											// 251-255
		>;
		qcom,mdss-pan-physical-width-dimension = <68>;
		qcom,mdss-pan-physical-height-dimension = <121>;
	};
};
