/* Copyright (c) 2014, Code Aurora Forum. All rights reserved.
 *
 * This program is free software; you can redistribute it and/or modify
 * it under the terms of the GNU General Public License version 2 and
 * only version 2 as published by the Free Software Foundation.
 *
 * This program is distributed in the hope that it will be useful,
 * but WITHOUT ANY WARRANTY; without even the implied warranty of
 * MERCHANTABILITY or FITNESS FOR A PARTICULAR PURPOSE.  See the
 * GNU General Public License for more details.
 */

&mdss_mdp {
	dsi_dual_jdi_cmd_1: qcom,mdss_dsi_jdi_nt36850_1440p_mipi1_cmd {
		qcom,mdss-dsi-panel-name = "JDI INCELL 1440p Dual 1 cmd mode dsi panel";
		qcom,mdss-dsi-panel-controller = <&mdss_dsi1>;
		qcom,mdss-dsi-panel-type = "dsi_cmd_mode";
		qcom,mdss-dsi-panel-destination = "display_2";
		qcom,mdss-dsi-panel-framerate = <60>;
		qcom,mdss-dsi-virtual-channel-id = <0>;
		qcom,mdss-dsi-stream = <0>;
		qcom,mdss-dsi-panel-width = <720>;
		qcom,mdss-dsi-panel-height = <2560>;
		qcom,mdss-dsi-h-front-porch = <180>;
		qcom,mdss-dsi-h-back-porch = <120>;
		qcom,mdss-dsi-h-pulse-width = <4>;
		qcom,mdss-dsi-h-sync-skew = <0>;
		qcom,mdss-dsi-v-back-porch = <7>;
		qcom,mdss-dsi-v-front-porch = <8>;
		qcom,mdss-dsi-v-pulse-width = <1>;
		qcom,mdss-dsi-h-left-border = <0>;
		qcom,mdss-dsi-h-right-border = <0>;
		qcom,mdss-dsi-v-top-border = <0>;
		qcom,mdss-dsi-v-bottom-border = <0>;
		qcom,mdss-dsi-bpp = <24>;
		qcom,mdss-dsi-color-order = "rgb_swap_rgb";
		qcom,mdss-dsi-underflow-color = <0xff>;
		qcom,mdss-dsi-border-color = <0>;
		qcom,mdss-dsi-h-sync-pulse = <0>;
		qcom,mdss-dsi-traffic-mode = "burst_mode";
		qcom,mdss-dsi-lane-map = "lane_map_0123";

		qcom,mdss-dsi-bllp-eof-power-mode;
		qcom,mdss-dsi-bllp-power-mode;
		qcom,cmd-sync-wait-broadcast;
		qcom,cmd-sync-wait-trigger;
		qcom,cont-splash-enabled;
		qcom,mdss-dsi-lane-0-state;
		qcom,mdss-dsi-lane-1-state;
		qcom,mdss-dsi-lane-2-state;
		qcom,mdss-dsi-lane-3-state;
		qcom,mdss-dsi-hor-line-idle = <0 40 256>,
						<40 120 128>,
						<120 240 64>;
		qcom,mdss-dsi-panel-timings = [F7 3A 28 00 6E 72
									2C 3E 31 03 04 00];
		qcom,mdss-dsi-reset-sequence = <1 10>, <0 10>, <1 10>;
		qcom,mdss-dsi-t-clk-post = <0x2D>; // 60 + 420 * UI
		qcom,mdss-dsi-t-clk-pre = <0x2D>;
		qcom,mdss-dsi-bl-max-level = <4095>;
		qcom,mdss-dsi-dma-trigger = "trigger_sw";
		qcom,mdss-dsi-mdp-trigger = "none";
		qcom,mdss-dsi-te-pin-select = <1>;
		qcom,mdss-dsi-wr-mem-start = <0x2c>;
		qcom,mdss-dsi-wr-mem-continue = <0x3c>;
		qcom,mdss-dsi-te-dcs-command = <1>;
		qcom,mdss-dsi-te-check-enable;
		qcom,mdss-dsi-te-using-te-pin;
		qcom,mdss-dsi-on-command = [
			/* cmd page select */
			15 01 00 00 00 00 02 FF 10
			/* Non reload OTP */
			15 01 00 00 00 00 02 FB 01
			/* write display brightness */
			39 01 00 00 00 00 03 51 FF 03
			/* write ctrl display */
			15 01 00 00 00 00 02 53 2C
			/* write power save */
			15 01 00 00 00 00 02 55 82	// 82 for cabc still mode on
			/* set tear on */
			15 01 00 00 00 00 02 35 00
			/* set tear scan line */
			39 01 00 00 00 00 03 44 09 D9

			/* JDI REDDISH REDUCING CODE STARTS */
			/* Gamma correction code */
			/* CMD Page Select */
			15 01 00 00 00 00 02 FF 20
			/* Non reload OTP */
			15 01 00 00 00 00 02 FB 01

			15	01	00	00	00	00	02	75	00
			15	01	00	00	00	00	02	76	E8
			15	01	00	00	00	00	02	77	00
			15	01	00	00	00	00	02	78	EE
			15	01	00	00	00	00	02	79	00
			15	01	00	00	00	00	02	7A	FB
			15	01	00	00	00	00	02	7B	01
			15	01	00	00	00	00	02	7C	09
			15	01	00	00	00	00	02	7D	01
			15	01	00	00	00	00	02	7E	15
			15	01	00	00	00	00	02	7F	01
			15	01	00	00	00	00	02	80	20
			15	01	00	00	00	00	02	81	01
			15	01	00	00	00	00	02	82	2A
			15	01	00	00	00	00	02	83	01
			15	01	00	00	00	00	02	84	36
			15	01	00	00	00	00	02	85	01
			15	01	00	00	00	00	02	86	3E
			15	01	00	00	00	00	02	87	01
			15	01	00	00	00	00	02	88	5E
			15	01	00	00	00	00	02	89	01
			15	01	00	00	00	00	02	8A	7B
			15	01	00	00	00	00	02	8B	01
			15	01	00	00	00	00	02	8C	AD
			15	01	00	00	00	00	02	8D	01
			15	01	00	00	00	00	02	8E	D5
			15	01	00	00	00	00	02	8F	02
			15	01	00	00	00	00	02	90	1A
			15	01	00	00	00	00	02	91	02
			15	01	00	00	00	00	02	92	56
			15	01	00	00	00	00	02	93	02
			15	01	00	00	00	00	02	94	58
			15	01	00	00	00	00	02	95	02
			15	01	00	00	00	00	02	96	93
			15	01	00	00	00	00	02	97	02
			15	01	00	00	00	00	02	98	D6
			15	01	00	00	00	00	02	99	03
			15	01	00	00	00	00	02	9A	00
			15	01	00	00	00	00	02	9B	03
			15	01	00	00	00	00	02	9C	2F
			15	01	00	00	00	00	02	9D	03
			15	01	00	00	00	00	02	9E	4F
			15	01	00	00	00	00	02	9F	03
			15	01	00	00	00	00	02	A0	70
			15	01	00	00	00	00	02	A2	03
			15	01	00	00	00	00	02	A3	7B
			15	01	00	00	00	00	02	A4	03
			15	01	00	00	00	00	02	A5	87
			15	01	00	00	00	00	02	A6	03
			15	01	00	00	00	00	02	A7	96
			15	01	00	00	00	00	02	A9	03
			15	01	00	00	00	00	02	AA	A8
			15	01	00	00	00	00	02	AB	03
			15	01	00	00	00	00	02	AC	C7
			15	01	00	00	00	00	02	AD	03
			15	01	00	00	00	00	02	AE	DC
			15	01	00	00	00	00	02	AF	03
			15	01	00	00	00	00	02	B0	F1
			15	01	00	00	00	00	02	B1	03
			15	01	00	00	00	00	02	B2	FF
			15	01	00	00	00	00	02	B3	00
			15	01	00	00	00	00	02	B4	E8
			15	01	00	00	00	00	02	B5	00
			15	01	00	00	00	00	02	B6	EE
			15	01	00	00	00	00	02	B7	00
			15	01	00	00	00	00	02	B8	FB
			15	01	00	00	00	00	02	B9	01
			15	01	00	00	00	00	02	BA	09
			15	01	00	00	00	00	02	BB	01
			15	01	00	00	00	00	02	BC	15
			15	01	00	00	00	00	02	BD	01
			15	01	00	00	00	00	02	BE	20
			15	01	00	00	00	00	02	BF	01
			15	01	00	00	00	00	02	C0	2A
			15	01	00	00	00	00	02	C1	01
			15	01	00	00	00	00	02	C2	36
			15	01	00	00	00	00	02	C3	01
			15	01	00	00	00	00	02	C4	3E
			15	01	00	00	00	00	02	C5	01
			15	01	00	00	00	00	02	C6	5E
			15	01	00	00	00	00	02	C7	01
			15	01	00	00	00	00	02	C8	7B
			15	01	00	00	00	00	02	C9	01
			15	01	00	00	00	00	02	CA	AD
			15	01	00	00	00	00	02	CB	01
			15	01	00	00	00	00	02	CC	D5
			15	01	00	00	00	00	02	CD	02
			15	01	00	00	00	00	02	CE	1A
			15	01	00	00	00	00	02	CF	02
			15	01	00	00	00	00	02	D0	56
			15	01	00	00	00	00	02	D1	02
			15	01	00	00	00	00	02	D2	58
			15	01	00	00	00	00	02	D3	02
			15	01	00	00	00	00	02	D4	93
			15	01	00	00	00	00	02	D5	02
			15	01	00	00	00	00	02	D6	D6
			15	01	00	00	00	00	02	D7	03
			15	01	00	00	00	00	02	D8	00
			15	01	00	00	00	00	02	D9	03
			15	01	00	00	00	00	02	DA	2F
			15	01	00	00	00	00	02	DB	03
			15	01	00	00	00	00	02	DC	4F
			15	01	00	00	00	00	02	DD	03
			15	01	00	00	00	00	02	DE	70
			15	01	00	00	00	00	02	DF	03
			15	01	00	00	00	00	02	E0	7B
			15	01	00	00	00	00	02	E1	03
			15	01	00	00	00	00	02	E2	87
			15	01	00	00	00	00	02	E3	03
			15	01	00	00	00	00	02	E4	96
			15	01	00	00	00	00	02	E5	03
			15	01	00	00	00	00	02	E6	A8
			15	01	00	00	00	00	02	E7	03
			15	01	00	00	00	00	02	E8	C7
			15	01	00	00	00	00	02	E9	03
			15	01	00	00	00	00	02	EA	DC
			15	01	00	00	00	00	02	EB	03
			15	01	00	00	00	00	02	EC	F1
			15	01	00	00	00	00	02	ED	03
			15	01	00	00	00	00	02	EE	FF
			15	01	00	00	00	00	02	EF	00
			15	01	00	00	00	00	02	F0	00
			15	01	00	00	00	00	02	F1	00
			15	01	00	00	00	00	02	F2	1C
			15	01	00	00	00	00	02	F3	00
			15	01	00	00	00	00	02	F4	43
			15	01	00	00	00	00	02	F5	00
			15	01	00	00	00	00	02	F6	64
			15	01	00	00	00	00	02	F7	00
			15	01	00	00	00	00	02	F8	80
			15	01	00	00	00	00	02	F9	00
			15	01	00	00	00	00	02	FA	9A

			/* CMD Page Select */
			15 01 00 00 00 00 02 FF 21
			/* Non reload OTP */
			15 01 00 00 00 00 02 FB 01

			15	01	00	00	00	00	02	00	00
			15	01	00	00	00	00	02	01	AD
			15	01	00	00	00	00	02	02	00
			15	01	00	00	00	00	02	03	C5
			15	01	00	00	00	00	02	04	00
			15	01	00	00	00	00	02	05	D7
			15	01	00	00	00	00	02	06	01
			15	01	00	00	00	00	02	07	12
			15	01	00	00	00	00	02	08	01
			15	01	00	00	00	00	02	09	3F
			15	01	00	00	00	00	02	0A	01
			15	01	00	00	00	00	02	0B	80
			15	01	00	00	00	00	02	0C	01
			15	01	00	00	00	00	02	0D	B5
			15	01	00	00	00	00	02	0E	02
			15	01	00	00	00	00	02	0F	04
			15	01	00	00	00	00	02	10	02
			15	01	00	00	00	00	02	11	45
			15	01	00	00	00	00	02	12	02
			15	01	00	00	00	00	02	13	47
			15	01	00	00	00	00	02	14	02
			15	01	00	00	00	00	02	15	86
			15	01	00	00	00	00	02	16	02
			15	01	00	00	00	00	02	17	C9
			15	01	00	00	00	00	02	18	02
			15	01	00	00	00	00	02	19	F5
			15	01	00	00	00	00	02	1A	03
			15	01	00	00	00	00	02	1B	26
			15	01	00	00	00	00	02	1C	03
			15	01	00	00	00	00	02	1D	47
			15	01	00	00	00	00	02	1E	03
			15	01	00	00	00	00	02	1F	6A
			15	01	00	00	00	00	02	20	03
			15	01	00	00	00	00	02	21	75
			15	01	00	00	00	00	02	22	03
			15	01	00	00	00	00	02	23	82
			15	01	00	00	00	00	02	24	03
			15	01	00	00	00	00	02	25	90
			15	01	00	00	00	00	02	26	03
			15	01	00	00	00	00	02	27	A4
			15	01	00	00	00	00	02	28	03
			15	01	00	00	00	00	02	29	C2
			15	01	00	00	00	00	02	2A	03
			15	01	00	00	00	00	02	2B 	D8
			15	01	00	00	00	00	02	2D	03
			15	01	00	00	00	00	02	2F	F1
			15	01	00	00	00	00	02	30	03
			15	01	00	00	00	00	02	31	FF
			15	01	00	00	00	00	02	32	00
			15	01	00	00	00	00	02	33	00
			15	01	00	00	00	00	02	34	00
			15	01	00	00	00	00	02	35	1C
			15	01	00	00	00	00	02	36	00
			15	01	00	00	00	00	02	37	43
			15	01	00	00	00	00	02	38	00
			15	01	00	00	00	00	02	39	64
			15	01	00	00	00	00	02	3A	00
			15	01	00	00	00	00	02	3B	80
			15	01	00	00	00	00	02	3D	00
			15	01	00	00	00	00	02	3F	9A
			15	01	00	00	00	00	02	40	00
			15	01	00	00	00	00	02	41	AD
			15	01	00	00	00	00	02	42	00
			15	01	00	00	00	00	02	43	C5
			15	01	00	00	00	00	02	44	00
			15	01	00	00	00	00	02	45	D7
			15	01	00	00	00	00	02	46	01
			15	01	00	00	00	00	02	47	12
			15	01	00	00	00	00	02	48	01
			15	01	00	00	00	00	02	49	3F
			15	01	00	00	00	00	02	4A	01
			15	01	00	00	00	00	02	4B	80
			15	01	00	00	00	00	02	4C	01
			15	01	00	00	00	00	02	4D	B5
			15	01	00	00	00	00	02	4E	02
			15	01	00	00	00	00	02	4F	04
			15	01	00	00	00	00	02	50	02
			15	01	00	00	00	00	02	51	45
			15	01	00	00	00	00	02	52	02
			15	01	00	00	00	00	02	53	47
			15	01	00	00	00	00	02	54	02
			15	01	00	00	00	00	02	55	86
			15	01	00	00	00	00	02	56	02
			15	01	00	00	00	00	02	58	C9
			15	01	00	00	00	00	02	59	02
			15	01	00	00	00	00	02	5A	F5
			15	01	00	00	00	00	02	5B	03
			15	01	00	00	00	00	02	5C	26
			15	01	00	00	00	00	02	5D	03
			15	01	00	00	00	00	02	5E	47
			15	01	00	00	00	00	02	5F	03
			15	01	00	00	00	00	02	60	6A
			15	01	00	00	00	00	02	61	03
			15	01	00	00	00	00	02	62	75
			15	01	00	00	00	00	02	63	03
			15	01	00	00	00	00	02	64	82
			15	01	00	00	00	00	02	65	03
			15	01	00	00	00	00	02	66	90
			15	01	00	00	00	00	02	67	03
			15	01	00	00	00	00	02	68	A4
			15	01	00	00	00	00	02	69	03
			15	01	00	00	00	00	02	6A	C2
			15	01	00	00	00	00	02	6B	03
			15	01	00	00	00	00	02	6C	D8
			15	01	00	00	00	00	02	6D	03
			15	01	00	00	00	00	02	6E	F1
			15	01	00	00	00	00	02	6F	03
			15	01	00	00	00	00	02	70	FF
			15	01	00	00	00	00	02	71	01
			15	01	00	00	00	00	02	72	0C
			15	01	00	00	00	00	02	73	01
			15	01	00	00	00	00	02	74	12
			15	01	00	00	00	00	02	75	01
			15	01	00	00	00	00	02	76	1D
			15	01	00	00	00	00	02	77	01
			15	01	00	00	00	00	02	78	28
			15	01	00	00	00	00	02	79	01
			15	01	00	00	00	00	02	7A	32
			15	01	00	00	00	00	02	7B	01
			15	01	00	00	00	00	02	7C	3C
			15	01	00	00	00	00	02	7D	01
			15	01	00	00	00	00	02	7E	44
			15	01	00	00	00	00	02	7F	01
			15	01	00	00	00	00	02	80	4C
			15	01	00	00	00	00	02	81	01
			15	01	00	00	00	00	02	82	53
			15	01	00	00	00	00	02	83	01
			15	01	00	00	00	00	02	84	71
			15	01	00	00	00	00	02	85	01
			15	01	00	00	00	00	02	86	8B
			15	01	00	00	00	00	02	87	01
			15	01	00	00	00	00	02	88	B9
			15	01	00	00	00	00	02	89	01
			15	01	00	00	00	00	02	8A	DF
			15	01	00	00	00	00	02	8B	02
			15	01	00	00	00	00	02	8C	21
			15	01	00	00	00	00	02	8D	02
			15	01	00	00	00	00	02	8E	5B
			15	01	00	00	00	00	02	8F	02
			15	01	00	00	00	00	02	90	5D
			15	01	00	00	00	00	02	91	02
			15	01	00	00	00	00	02	92	97
			15	01	00	00	00	00	02	93	02
			15	01	00	00	00	00	02	94	D9
			15	01	00	00	00	00	02	95	03
			15	01	00	00	00	00	02	96	02
			15	01	00	00	00	00	02	97	03
			15	01	00	00	00	00	02	98	32
			15	01	00	00	00	00	02	99	03
			15	01	00	00	00	00	02	9A	51
			15	01	00	00	00	00	02	9B	03
			15	01	00	00	00	00	02	9C	71
			15	01	00	00	00	00	02	9D	03
			15	01	00	00	00	00	02	9E	7D
			15	01	00	00	00	00	02	9F	03
			15	01	00	00	00	00	02	A0	89
			15	01	00	00	00	00	02	A2	03
			15	01	00	00	00	00	02	A3	98
			15	01	00	00	00	00	02	A4	03
			15	01	00	00	00	00	02	A5	AB
			15	01	00	00	00	00	02	A6	03
			15	01	00	00	00	00	02	A7	C8
			15	01	00	00	00	00	02	A9	03
			15	01	00	00	00	00	02	AA	DC
			15	01	00	00	00	00	02	AB	03
			15	01	00	00	00	00	02	AC	F1
			15	01	00	00	00	00	02	AD	03
			15	01	00	00	00	00	02	AE	FF
			15	01	00	00	00	00	02	AF	01
			15	01	00	00	00	00	02	B0	0C
			15	01	00	00	00	00	02	B1	01
			15	01	00	00	00	00	02	B2	12
			15	01	00	00	00	00	02	B3	01
			15	01	00	00	00	00	02	B4	1D
			15	01	00	00	00	00	02	B5	01
			15	01	00	00	00	00	02	B6	28
			15	01	00	00	00	00	02	B7	01
			15	01	00	00	00	00	02	B8	32
			15	01	00	00	00	00	02	B9	01
			15	01	00	00	00	00	02	BA	3C
			15	01	00	00	00	00	02	BB	01
			15	01	00	00	00	00	02	BC	44
			15	01	00	00	00	00	02	BD	01
			15	01	00	00	00	00	02	BE	4C
			15	01	00	00	00	00	02	BF	01
			15	01	00	00	00	00	02	C0	53
			15	01	00	00	00	00	02	C1	01
			15	01	00	00	00	00	02	C2	71
			15	01	00	00	00	00	02	C3	01
			15	01	00	00	00	00	02	C4	8B
			15	01	00	00	00	00	02	C5	01
			15	01	00	00	00	00	02	C6	B9
			15	01	00	00	00	00	02	C7	01
			15	01	00	00	00	00	02	C8	DF
			15	01	00	00	00	00	02	C9	02
			15	01	00	00	00	00	02	CA	21
			15	01	00	00	00	00	02	CB	02
			15	01	00	00	00	00	02	CC	5B
			15	01	00	00	00	00	02	CD	02
			15	01	00	00	00	00	02	CE	5D
			15	01	00	00	00	00	02	CF	02
			15	01	00	00	00	00	02	D0	97
			15	01	00	00	00	00	02	D1	02
			15	01	00	00	00	00	02	D2	D9
			15	01	00	00	00	00	02	D3	03
			15	01	00	00	00	00	02	D4	02
			15	01	00	00	00	00	02	D5	03
			15	01	00	00	00	00	02	D6	32
			15	01	00	00	00	00	02	D7	03
			15	01	00	00	00	00	02	D8	51
			15	01	00	00	00	00	02	D9	03
			15	01	00	00	00	00	02	DA	71
			15	01	00	00	00	00	02	DB	03
			15	01	00	00	00	00	02	DC	7D
			15	01	00	00	00	00	02	DD	03
			15	01	00	00	00	00	02	DE	89
			15	01	00	00	00	00	02	DF	03
			15	01	00	00	00	00	02	E0	98
			15	01	00	00	00	00	02	E1	03
			15	01	00	00	00	00	02	E2	AB
			15	01	00	00	00	00	02	E3	03
			15	01	00	00	00	00	02	E4	C8
			15	01	00	00	00	00	02	E5	03
			15	01	00	00	00	00	02	E6	DC
			15	01	00	00	00	00	02	E7	03
			15	01	00	00	00	00	02	E8	F1
			15	01	00	00	00	00	02	E9	03
			15	01	00	00	00	00	02	EA	FF

			/* CMD Page Select */
			15 01 00 00 00 00 02 FF 10

			/* ENDS */

			/* IE setting start */
			/* CMD Page Select */
			15 01 00 00 00 00 02 FF 22
			/* Non reload OTP */
			15 01 00 00 00 00 02 FB 01

			//To enhance saturation, using VIVID region
			15	01	00	00	00	00	02	00	00
			15	01	00	00	00	00	02	01	04
			15	01	00	00	00	00	02	02	08
			15	01	00	00	00	00	02	03	0C
			15	01	00	00	00	00	02	04	10
			15	01	00	00	00	00	02	05	14
			15	01	00	00	00	00	02	06	18
			15	01	00	00	00	00	02	07	20
			15	01	00	00	00	00	02	08	24
			15	01	00	00	00	00	02	09	28
			15	01	00	00	00	00	02	0A	30
			15	01	00	00	00	00	02	0B	30
			15	01	00	00	00	00	02	0C	30
			15	01	00	00	00	00	02	0D	20
			15	01	00	00	00	00	02	0E	10
			15	01	00	00	00	00	02	0F	0C
			15	01	00	00	00	00	02	10	0A
			15	01	00	00	00	00	02	11	08
			15	01	00	00	00	00	02	12	06
			15	01	00	00	00	00	02	13	04

			//SKIN_HUE and HUE_RATIO
			15	01	00	00	00	00	02	32	80
			15	01	00	00	00	00	02	33	80
			15	01	00	00	00	00	02	34	80
			15	01	00	00	00	00	02	35	80
			15	01	00	00	00	00	02	36	00
			15	01	00	00	00	00	02	37	00
			15	01	00	00	00	00	02	38	00
			15	01	00	00	00	00	02	39	00
			15	01	00	00	00	00	02	3A	02
			15	01	00	00	00	00	02	3B	04
			15	01	00	00	00	00	02	3F	10
			15	01	00	00	00	00	02	40	18
			15	01	00	00	00	00	02	41	1E
			15	01	00	00	00	00	02	42	22
			15	01	00	00	00	00	02	43	26
			15	01	00	00	00	00	02	44	26
			15	01	00	00	00	00	02	45	20
			15	01	00	00	00	00	02	46	12
			15	01	00	00	00	00	02	47	08
			15	01	00	00	00	00	02	48	04
			15	01	00	00	00	00	02	49	02
			15	01	00	00	00	00	02	4A	00
			15	01	00	00	00	00	02	4B	00
			15	01	00	00	00	00	02	4C	80

			//IE ENABLE CODE
			15	01	00	00	00	00	02	1A	00	//Vivid color
			15	01	00	00	00	00	02	53	01	//Smart color
			15	01	00	00	00	00	02	54	01	//skin keep
			15	01	00	00	00	00	02	55	00
			15	01	00	00	00	00	02	68	00	//sharpness

			//SRE enable 0304
			15	01	00	00	00	00	02	56	10	//EN_SRE
			15	01	00	00	00	00	02	A2	20	//smoothing

			//SRE setting
			15	01	00	00	00	00	02	5E	1B
			15	01	00	00	00	00	02	5F	1A

			//SRE dimming
			15	01	00	00	00	00	02	6A	20

			/* IE setting Ends */

			/* CABC SETTING START */
			//CMD Page Select
			15 01 00 00 00 00 02 FF 23
			//Non reload OTP
			15 01 00 00 00 00 02 FB 01

			//10kHz PWM freq.
			15	01	00	00	00	00	02	07	00
			15	01	00	00	00	00	02	08	06
			15	01	00	00	00	00	02	45	01	//10bit from 51h FF 03
			15	01	00	00	00	00	02	46	EA

			//20% power saving max spec, 0210_07
			15	01	00	00	00	00	02	17	FF
			15	01	00	00	00	00	02	18	FC
			15	01	00	00	00	00	02	19	F8
			15	01	00	00	00	00	02	1A	F0
			15	01	00	00	00	00	02	1B	EC
			15	01	00	00	00	00	02	1C	E6
			15	01	00	00	00	00	02	1D	DF
			15	01	00	00	00	00	02	1E	D8
			15	01	00	00	00	00	02	1F	D2
			15	01	00	00	00	00	02	20	CC

			//CABC gamma select setting
			15	01	00	00	00	00	02	09	02	//240-255
			15	01	00	00	00	00	02	0A	02	//224-239
			15	01	00	00	00	00	02	0B	02	//208-223
			15	01	00	00	00	00	02	0C	03	//192-207
			15	01	00	00	00	00	02	0D	03	//160-191
			15	01	00	00	00	00	02	0E	03	//128-159
			15	01	00	00	00	00	02	0F	04	//112-127
			15	01	00	00	00	00	02	10	04	//64-111
			15	01	00	00	00	00	02	11	05	//16-63
			15	01	00	00	00	00	02	12	06	//0-15


			/* ENDS */

			/* CMD Page Select */
			15 01 00 00 05 00 02 FF 10
			/* exit_sleep_mode, wait 100ms */
			05 01 00 00 64 00 01 11
			/* set_address_mode */
			15 01 00 00 00 00 02 36 00
			/* jdi_write_payload_ff_20 */
			15 01 00 00 00 00 02 FF 20
			/* jdi_write_payload_fb_01 */
			15 01 00 00 00 00 02 FB 01
			/* jdi_write_payload_01_33 */
			15 01 00 00 00 00 02 01 33
			/* jdi_write_payload_56_80 */
			15 01 00 00 00 00 02 56 80
			/* jdi_write_payload_ff_24 */
			15 01 00 00 00 00 02 FF 24
			/* jdi_write_payload_fb_01 */
			15 01 00 00 00 00 02 FB 01
			/* jdi_write_payload_8b_f4 */
			15 01 00 00 00 00 02 8B F4
			/* jdi_write_payload_8c_01 */
			15 01 00 00 00 00 02 8C 01
			/* jdi_write_payload_86_1b */
			15 01 00 00 00 00 02 86 1B
			/* jdi_write_payload_87_27 */
			15 01 00 00 00 00 02 87 27
			/* jdi_write_payload_88_1b */
			15 01 00 00 00 00 02 88 1B
			/* jdi_write_payload_89_27 */
			15 01 00 00 00 00 02 89 27
			/* jdi_write_payload_ff_26 */
			15 01 00 00 00 00 02 FF 26
			/* jdi_write_payload_fb_01 */
			15 01 00 00 00 00 02 FB 01
			/* jdi_write_payload_f2_10 */
			15 01 00 00 00 00 02 F2 10
			/* jdi_write_payload_a3_33 */
			15 01 00 00 00 00 02 A3 33
			/* jdi_write_payload_ff_10 */
			15 01 00 00 00 00 02 FF 10
			/* jdi_driver_ic_margin_ff_e0 */
			15 01 00 00 00 00 02 FF E0
			/* jdi_driver_ic_margin_fb_01 */
			15 01 00 00 00 00 02 FB 01
			/* jdi_driver_ic_margin_21_44 */
			15 01 00 00 00 00 02 21 44
			/* jdi_driver_ic_margin_22_74 */
			15 01 00 00 00 00 02 22 74
			/* jdi_driver_ic_margin_35_40 */
			15 01 00 00 00 00 02 35 40
			/* jdi_driver_ic_margin_36_40 */
			15 01 00 00 00 00 02 36 40
			/* jdi_driver_ic_margin_37_00 */
			15 01 00 00 00 00 02 37 00
			/* jdi_write_payload_ff_10 */
			15 01 00 00 00 00 02 FF 10
			/* set_display_on */
			05 01 00 00 14 00 01 29
			];
		qcom,mdss-dsi-on-command-state = "dsi_lp_mode";
		qcom,mdss-dsi-off-command = [
			05 01 00 00 14 00 02 28 00
			05 01 00 00 3C 00 02 10 00
			];
		qcom,mdss-dsi-off-command-state = "dsi_hs_mode";
		/* SRE cmds set START*/
		qcom,sre-control-dsi-state = "dsi_lp_mode";
		jdi,sre-cmds-off = [
			15 01 00 00 00 00 02 FF 10
			15 01 00 00 00 00 02 55 82
		];
		jdi,sre-cmds-on = [
			15 01 00 00 00 00 02 FF 10
			15 01 00 00 00 00 02 55 42
		];
		/* SRE cmds set END*/
		qcom,blmap-size = <256>;
		qcom,blmap = <
			  0
			  34 34 34 34 34 34 34 34 34 34
			  34 34 34 35 35 35 36 36 36 37
			  37 37 38 39 40 42 43 45 46 47
			  49 50 52 53 55 57 59 61 63 65
			  67 70 72 74 76 78 80 82 85 89
			  94 98 103 107 112 116 121 125 130 134
			  139 143 148 153 157 162 167 171 176 181
			  185 190 195 201 207 213 220 226 232 238
			  245 251 257 263 270 277 284 291 298 305
			  312 320 327 334 341 348 355 363 373 383
			  393 403 413 424 434 444 454 464 475 484
			  494 503 513 523 532 542 551 561 571 580
			  590 600 614 628 642 656 670 685 699 713
			  727 741 755 770 796 822 849 875 901 928
			  954 980 1007 1033 1060 1065 1070 1076 1081 1086
			  1092 1097 1103 1108 1113 1119 1124 1130 1145 1161
			  1177 1193 1209 1225 1240 1256 1272 1288 1304 1320
			  1338 1356 1375 1393 1412 1430 1449 1467 1486 1504
			  1523 1541 1560 1581 1602 1623 1645 1666 1687 1708
			  1730 1751 1772 1793 1815 1840 1865 1890 1915 1940
			  1965 1990 2015 2040 2065 2090 2115 2140 2164 2189
			  2213 2238 2262 2287 2311 2336 2360 2385 2410 2435
			  2461 2487 2513 2538 2564 2590 2616 2641 2667 2693
			  2719 2745 2775 2805 2836 2866 2897 2927 2957 2988
			  3018 3049 3079 3110 3147 3184 3221 3258 3295 3332
			  3369 3406 3443 3480 3518
		>;
		qcom,mdss-pan-physical-width-dimension = <68>;
		qcom,mdss-pan-physical-height-dimension = <121>;
	};
};

