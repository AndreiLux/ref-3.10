/dts-v1/;

#include "tegra132-flounder64-generic.dtsi"

/ {
	compatible = "google,flounder64", "nvidia,tegra132";
	hw-revision = "xd";

	i2c@7000c000 {
		bq2419x: bq2419x@6b {
			charger {
				ti,charge-suspend-polling-time-sec = <3600>;
				charge-full-by-monitor-full-threshold;
			};
		};
	};
};

