## arch/arm/mach-hisi/Kconfig
```kconfig
config SECURE_EXTENSION
        bool "security extension support"
        default n
        help
          Include Security Extension.

config ARCH_HISI
	bool "Hisilicon family"
	select ARCH_HAS_CPUFREQ
	select ARCH_REQUIRE_GPIOLIB
	select ARM_AMBA
	select ARM_GIC
	select CLKDEV_LOOKUP
	select COMMON_CLK
	select GENERIC_CLOCKEVENTS
	select HAVE_CLK
	select HAVE_SMP
	select NO_IOPORT
	select PINCTRL
	select PINCTRL_SINGLE
	select ARCH_HAS_OPP
	select STAGING
	select ARCH_HAS_PASR

	help
	  Support for Hislicon Hi36xx/Hi37xx processor family

config HW_CMDLINE_PARSE
	bool "cmdline parse"
	default y

	help
	  Say 'Y' here if you want to support the cmdline parse

if ARCH_HISI

config ARCH_HI3630FPGA
	bool "Hisilicon Development Board"
	default n

	select ARM_CCI
	select CPU_V7
	select ARM_TIMER_SP804
	help
	  Say 'Y' here if you want to support the Hisilicon Development
	  Board.

config ARCH_HI3630EMULATOR
	bool "Hisilicon Emulator Board"
	default n

	select ARM_CCI
	select CPU_V7
	select ARM_TIMER_SP804
	help
	  Say 'Y' here if you want to support the Hisilicon Development
	  Board.

config ARCH_HI3630
	bool "Hisilicon UDP Board"
	default n

	select ARM_CCI
	select CPU_V7
	select ARM_TIMER_SP804
	help
	  Say 'Y' here if you want to support the Hisilicon Development
	  Board.

config HISI_BUS_SWITCH
	bool "Hisilicon bus switch"
	default n
	help
	  Say 'Y' here if you wanna enable BUS SWITCH Feature.

config HISI_AXI
	bool "Hisilicon axierr irq"
	default n
	help
	Hi3630 axierr irq support


menu "Hisilicon NoC Support"
config HISI_NOC
	bool "Hisilicon NoC support"
	default n
	help
	  NoC driver for Hi36xx

config HISI_NOC_ERR_PROBE
	depends on HISI_NOC
	bool "Hisilicon NoC Error Probe support"
	default n
	help
	  NoC Error Probe driver

config HISI_NOC_TIMEOUT
	depends on HISI_NOC
	bool "Hisilicon NoC Timeout support"
	default n
	help
	  NoC Timeout driver
endmenu

config HI6421_OCP
	bool "Hisilicon chip over current protect"
	default n
	help
	  Say 'Y' here if you want to support the Hisilicon OCP.

config HISI_SIM_HOTPLUG
	bool "support sim hotplug function"
	default n
	help
	  Say 'Y' here if you want to support the SIM HOTPLUG.

config HI3630_LPM3_IPC
	bool "InterProcessor Communication Support"
	default n
	help
          support Acore communication with LPM3

config HISI_LPM3
	bool "Hisilicon LPM3"
	default n
	help
	  Hi3630 lpm3 watchdog driver

config HISI_LPM3_DEBUG
	depends on HISI_LPM3
	depends on HISI_MAILBOX
	bool "Hisilicon LPM3 DEBUG"
	default n
	help
	  Hi3630 lpm3 debug driver

config HISI_REBOOT_TYPE
	bool "Hisilicon reboot type"
	default n
	help
	  Hi3630 reboot type
endif

config EASY_SHELL
       bool "Balong easy shell driver"
       default y
       ---help---
        Driver which call kernel function directly

config HISI_EFUSE
	bool "Hisilicon efuse driver"
	default n
	help
	Hi3630 efuse driver support

config HISI_UDP_BOARDID
	bool "Hisilicon udp board id driver"
	default y
	help
	Hi3630 udp board id driver support
config HIDE_PRODUCT_INFO
	bool "Hide chipset name if not officially announced"
	default n
	help
	Hide chipset name if not officially announced

config HISI_SR_DEBUG
	bool "hisi suspend-resume debug interface"
	depends on PM
	default n
	help
	suspend-resume debug for hisi platform

config HISI_SR_DEBUG_SLEEP
	bool "hisi suspend-resume debug sleep"
	depends on PM
	default n
	help
	suspend-resume debug sleep for hisi platform

config HISI_BALONG_MODEM
	bool "Hisilicon ap+modem config"
	default n
	help
	Hisilicon ap+modem config support.

config HISI_EXTERN_WDT
	bool "Hisilicon extern watchdog"
	default n
	help
	Hi3630 lpm3 extern watchdog driver

config HISI_LPM3_VIEWER
	bool "Hisilicon lpm3 log viewer"
	default n
	help
	Hi3630 lpm3 log viewer driver

config HISI_IRQ_AFFINITY
	bool "Hisilicon irq affinity"
	depends on SMP
	default n
	help
	  Driver for irq affinity recovery in smp system
```

## arch/arm/mach-mt8135/Kconfig
```kconfig
if ARCH_MT8135

menu "MT8135 Board Support Package"

choice
	bool "Board"

config MT8135_FPGA
	bool "MT8135 FPGA"
	select ARM_GIC
	select ARM_L1_CACHE_SHIFT_6
	select MULTI_IRQ_HANDLER
	help
	  Select if you are using the FPGA board.

config MT8135_EVB_GENERIC
	bool "MT8135 generic EVB"
	select MT8135_EVB_BOARD
	help
	  Select this is you are using mt8135_evb*, with MTK legacy
	  customize methods.

config MT8135_EVBP1_V2_WSVGA
	bool "MT8135 evbp1_v2_wsvga EVB"
	select MT8135_EVB_BOARD
	help
	  Select this is you are using mt8135_evbp1_v2_wsvga board

config MT8135_EVBP1_V2_WUXGA_CPT
	bool "MT8135 evbp1_v2_wuxga_cpt EVB"
	select MT8135_EVB_BOARD
	help
	  Select this is you are using mt8135_evbp1_v2_wuxga_cpt board

config MT8135_STINGRAY
	bool "MT8135 Stingray board"
	select MT8135_EVB_BOARD
	help
	  Select this for Stingray board

config MT8135_ARIEL
	bool "MT8135 Ariel board"
	select MT8135_EVB_BOARD
	help
	  Select this for Ariel board

config MT8135_ASTON
	bool "MT8135 Aston board"
	select MT8135_EVB_BOARD
	help
	  Select this for Aston board
endchoice

config MT8135_EVB_BOARD
	bool
	default n
	select ARM_GIC
	select ARM_L1_CACHE_SHIFT_6
	select COMMON_CLK
	help
		Generic support for MT8135 chipset.
		Select this for non-FPGA boards,
		to select common options.
		If you don't use MT8135, say no

config MT8135_FPGA_CA7
	tristate "MT8135 FPGA CA7"
	depends on MT8135_FPGA
	default n
	help
	    Select if you are using the CA7 FPGA board.

config MAX_DRAM_SIZE_SUPPORT
	hex "The maximum size of the DRAM can be supported in the kernel"
	default 0x10000000
	depends on ARCH_MT8135
	help
		Define the maximum size of the kernel can be supported.
	        If will modify the memory size if it size is smaller than
                the memory size passed by the boot loader to the MAX_DRAM_SIZE_SUPPORT.
		Notice that the maximum DRAM size is including the memory size
	        reserved for the modem and the PMEM.



endmenu


endif
```

## arch/arm/mach-odin/Kconfig
```kconfig
config ARCH_ODIN
	bool "LG Electronics Odin" if ARCH_MULTI_V7
    select ARCH_HAS_CPUFREQ
    select ARCH_HAS_OPP
	select HAVE_SCHED_CLOCK
	select CPU_V7
	select ARM_AMBA
	select ARM_GIC
	select ARM_CCI
	select COMMON_CLK
	select GENERIC_CLOCKEVENTS
	select PM_GENERIC_DOMAINS if PM_RUNTIME
	select ARM_TIMER_SP804
	select HAVE_SMP
	select ARCH_REQUIRE_GPIOLIB
	select MAILBOX
	select ODIN_PL320_MBOX

config ARCH_ODIN_REVISION
	int "Odin revision number"
	range 0 2
	depends on ARCH_ODIN
	default 1
	help
		Odin SoC revision number

menu "Odin Platform Type"
	depends on ARCH_ODIN

config MACH_ODIN
	bool "Odin Platform Board"
	depends on ARCH_ODIN
	help
		Odin Platform Board in official.

config MACH_ODIN_FPGA
	bool "Odin FPGA Board"
	depends on ARCH_ODIN
	help
		Evaluation Odin Board.

# LGE_CHANGE_S
config MACH_ODIN_LIGER
	bool "Odin MC Board"
	depends on ARCH_ODIN
	help
		Evaluation Odin Board for MC Lab.
# LGE_CHANGE_E

choice
	prompt "Odin FPGA type"
	default MACH_CLAIR_FPAG
	depends on MACH_ODIN_FPGA

config MACH_CLAIR_FPGA
	bool "Odin Clair"

config MACH_HUINS_FPGA
	bool "Odin Huins"

endchoice

config PRE_SELF_DIAGNOSIS
	tristate "Support LGE self diagnosis for factory"
	default n
	depends on MACH_ODIN
	help
	  LGE self diagnosis

endmenu

config ODIN_BL_POWEROPS
	bool "Odin big.LITTLE Power Ops support"
	depends on ARCH_ODIN && MCPM
	default y
	help
		Support for big.LITTLE Power Ops.

config ODIN_BL_POWEROPS_WORKAROUND
	bool "Odin big.LITTLE Power Ops workaround"
	depends on ODIN_BL_POWEROPS && ARCH_ODIN_REVISION=2
	default y
	help
		In case of CA7, do not control cluster PM.

config ODIN_OPTIMIZE_BOOTING_TIME
	bool "Odin booting time optimization"
	depends on ARCH_ODIN
	default n
	help
		Optimize booting time on Odin.

config DSP_LPA_ENABLE
	bool "Odin DSP Development"
	depends on ARCH_ODIN
	default n
	help
		Say yes here to support odin Low Power Audio(LPA) control

config CPU_IDLE_ODIN_WORKAROUND
	boolean "CPU idle disable when some devices try to reduce system latency"
	depends on CPU_IDLE_ODIN
	default y
	help
		CPU idle disable when some devices try to reduce system latency

config ARABICA_CHECK_REV
	depends on ARCH_ODIN
	bool "Arabica revision check"
	help
		Say yes here to support arabica revision check.

config ODIN_PD_OPS
	depends on ARCH_ODIN
    bool "Odin power domain control ops support"
    help
      Say yes here to support odin power domain control.

config ODIN_LPA_OPS
	depends on ARCH_ODIN && DSP_LPA_ENABLE
	default y
    bool "Odin Low Power Audio(LPA) control ops support"
    help
      Say yes here to support odin Low Power Audio(LPA) control.

config ODIN_PMIC_OPS
	depends on ARCH_ODIN
    bool "Odin pmic control ops support"
    help
      Say yes here to support odin pmic control.

config ARCH_NR_GPIO
	int "Odin ARCH_NR_GPIOS"
	default 512 if ARCH_ODIN
	default 0

# LGE_CHANGE_S
config LGE_CRASH_HANDLER
	tristate "Support LGE Kernel Panic Handler"
	default n
	depends on PSTORE_RAM
	help
	  LGE crash handler

 config LGE_LAST_KMSG
	bool "Support /proc/last_kmsg for backward compatibility"
	default n
	depends on PSTORE_RAM
	depends on LGE_CRASH_HANDLER
	help
	  LGE crash handler
# LGE_CHANGE_E

config ODIN_TEE
	bool "Odin TrustZone Configuration"
	depends on ARCH_ODIN
	select MOBICORE_DRIVER
	select MOBICORE_API
	help
		Enable TrustZone and independent Secure OS.
		Linux Kernel cannot access Secure hardware resources.

config ODIN_SECURE_SMMU
	bool "Odin SMMU Secure Init"
	depends on ODIN_TEE
	help
		Enable SMMU Initialization in Secure Domain.

config LGE_BOOT_TIME_CHECK
	tristate "Support LGE BOOT TIME CHECK"
	default y
	depends on MACH_ODIN
	help
		LGE bootloader Time Checker.

config ODIN_PSTORE
	bool "Support Pstore for Odin"
	depends on ARCH_ODIN
	select PSTORE_CONSOLE
	select PSTORE_RAM
	default y
	help
		Enable pstore for Odin

config LGE_AUTO_SUSPEND_TEST
	bool "Support Auto Suspend Test"
	depends on ARCH_ODIN
	default y
	help
		Enable pstore for Odin

config ODIN_SYS_FS
	depends on ARCH_ODIN
    bool "Odin sysfs information"
    help
      Say yes here to support odin information view.

config LGE_KSWITCH
    tristate "Support LGE Kill Switch"
    default n
    depends on MACH_ODIN
    help
      LGE Kill Switch
```

## arch/arm64/mach-tegra/Kconfig
```kconfig
source drivers/devfreq/Kconfig

source arch/arm/mach-tegra/Kconfig

config ARCH_TEGRA_13x_SOC
	bool "Tegra 13x family SOC"
	select ARCH_TEGRA_HAS_PCIE
	select CPU_V8
	select DENVER_CPU
	select ARM_GIC
	select ARCH_REQUIRE_GPIOLIB
	select USB_ARCH_HAS_EHCI if USB_SUPPORT
	select USB_EHCI_TEGRA if USB_SUPPORT
	select USB_ULPI if USB_SUPPORT
	select USB_ULPI_VIEWPORT if USB_SUPPORT
	select REPORT_PRESENT_CPUS if TEGRA_AUTO_HOTPLUG
	select ARCH_SUPPORTS_MSI if TEGRA_PCI
	select PCI_MSI if TEGRA_PCI
	select NVMAP_CACHE_MAINT_BY_SET_WAYS if TEGRA_NVMAP
	select NVMAP_CACHE_MAINT_BY_SET_WAYS_ON_ONE_CPU if TEGRA_NVMAP
	select ARCH_TEGRA_HAS_CL_DVFS
	select TEGRA_DYNAMIC_CBUS
	select TEGRA_DUAL_CBUS
	select ARCH_TEGRA_VIC
	select SOC_BUS
	select THERMAL
	select PM_GENERIC_DOMAINS if PM
	select MACH_HAS_SND_SOC_TEGRA_MAX98090 if SND_SOC
	select MACH_HAS_SND_SOC_TEGRA_RT5639 if SND_SOC
	select ARM64_SIMPLE_SPINLOCK
	help
	  Support for NVIDIA Tegra 13x family of SoCs, based upon the
	  NVIDIA Denver CPU

config MACH_EXUMA
	bool "Exuma board"
	depends on ARCH_TEGRA_13x_SOC
	select TEGRA_FPGA_PLATFORM
	help
	  Support for NVIDIA Exuma FPGA development platform

config MACH_T132REF
	bool "T132REF board"
	depends on ARCH_TEGRA_13x_SOC
	select SYSEDP_FRAMEWORK
	help
	  Support for NVIDIA Exuma FPGA development platform

config DENVER_CPU
	bool "Denver CPU"
	help
	  Support for NVIDIA Denver CPU

config TEGRA_CPU_FREQ_GOVERNOR_KERNEL_START
	bool "Initialize CPU governor to a performance after DVFS initialization"
	default 0
	help
		During a boot up, once DVFS is initialized, there is a period of
		time in which the frequency could adjusted higher before the userspace
		configures the governor by using a more performance governor for
		a faster boot up. Selecting this option will make the system to choose
		a performance governor once the DVFS initialization is complete. Userspace
		or init script can override the governor chosen here.
```

## drivers/broadcast/Kconfig
```kconfig
# LGE Broadcast Device Driver Support

menu "LGE Broadcast Device Support"

config LGE_BROADCAST_TDMB
    bool "LGE broadcast TDMB device Driver"
    depends on (MACH_MSM8992_P1_KR)
    default y
    help
      Select this if you want to use TDMB broadcast service


config LGE_BROADCAST_ISDBT_JAPAN
	bool "Japan full-seg Broadcast service"
	depends on (MACH_MSM8992_P1_KDDI_JP)
	default y
	help
	  Select this if you want to use Japanese FullSeg mobile broadcast service

source "drivers/broadcast/oneseg/Kconfig"
source "drivers/broadcast/tdmb/Kconfig"
endmenu
```

## drivers/broadcast/tdmb/Kconfig
```kconfig
#menu "BROADCAST_DEVICE"

#
# Broadcast Device Driver Support
#

#menu "BROADCAST_DEVICE"

config LGE_BROADCAST_TDMB_FC8080
    bool "LGE broacast TDMB FC8080 device"
    depends on (LGE_BROADCAST_TDMB && MACH_MSM8992_P1_KR)
    default y
    help
      Select this if you want to use broadcast service
#endmenu
```

## drivers/char/pppoesta/Kconfig
```kconfig
# DTS2013032504265 zhangxianfeng 00186749 20130322 create
#
# pppoesta device configuration
#

config PPPOESTA
           tristate "pppoe status Driver"
           default n
           help
           This is used to record the pppoe status.
```

## drivers/clk/hisilicon/Kconfig
```kconfig
config HI3xxx_CLK_CORE
	bool "Core clock driver of Hi3xxx Soc"
	default n if COMMON_CLK

config HI3620_CLK_MIPI_DSI
	bool "MIPI DSI clock driver of Hi3620 SoC"
	default y if COMMON_CLK && FB_HI3620

config HI3630_CLK
	bool "clock driver of Hi3630 Soc"
	default n

config HI3630_CLK_DEBUG
	depends on COMMON_CLK_DEBUG
	bool "debug optinon for clock driver of Hi3630 Soc"
	default n

config HI3630_CLK_ALWAYS_ON
	depends on HI3630_CLK
	bool "all clocks of Hi3630 Soc are always on"
	default n

config HI3630_CLK_MAILBOX_SUPPORT
	depends on HI3630_CLK
	depends on HISI_MAILBOX
	bool "clk driver support mailbox communication"
	default n
```

## drivers/cpuhotplug/Kconfig
```kconfig
menu "CPU Hotplug governor"

config SCHED_RQ_AVG_INFO
	bool "rq average support"
	default n
	help
	  'CONFIG_SCHED_RQ_AVG_INFO' is used to enable rq average.

config CPU_HOTPLUG
	bool "hotplug policy governor"
	default n
	help
	  'hotplug' - This driver adds a dynamic cpu hotplug policy governor.
	  The governor does a periodic polling and changes hotplug based on
	  the CPU utilization.
	  The support for this governor depends on CPU capability to do fast
	  hotplug switching (i.e, very low latency hotplug transitions).

config USE_BIG_CORE_DEPTH
	bool "set down threshold when big core plug in"
	depends on CPU_HOTPLUG
	depends on SCHED_HMP
	default n
	help
	  'USE_BIG_CORE_DEPTH' is used to set down threshold when big core online.

endmenu
```
