## arch/arm/configs/mt8135_stingray_debug_defconfig
```kconfig
# CONFIG_ARM_PATCH_PHYS_VIRT is not set
# CONFIG_LOCALVERSION_AUTO is not set
CONFIG_SYSVIPC=y
CONFIG_AUDIT=y
CONFIG_NO_HZ=y
CONFIG_HIGH_RES_TIMERS=y
CONFIG_IKCONFIG=y
CONFIG_IKCONFIG_PROC=y
CONFIG_CGROUPS=y
CONFIG_CGROUP_CPUACCT=y
CONFIG_CGROUP_SCHED=y
CONFIG_RT_GROUP_SCHED=y
CONFIG_BLK_DEV_INITRD=y
CONFIG_PANIC_TIMEOUT=5
CONFIG_EMBEDDED=y
CONFIG_PROFILING=y
CONFIG_OPROFILE=y
CONFIG_KPROBES=y
CONFIG_JUMP_LABEL=y
CONFIG_MODULES=y
CONFIG_MODULE_UNLOAD=y
# CONFIG_BLK_DEV_BSG is not set
CONFIG_ARCH_MT8135=y
CONFIG_MT8135_STINGRAY=y
CONFIG_MAX_DRAM_SIZE_SUPPORT=0x80000000
CONFIG_ARM_THUMBEE=y
CONFIG_ARM_ERRATA_798181=y
CONFIG_SMP=y
CONFIG_SCHED_MC=y
CONFIG_SCHED_SMT=y
CONFIG_DISABLE_CPU_SCHED_DOMAIN_BALANCE=y
CONFIG_SCHED_HMP=y
CONFIG_SCHED_HMP_PRIO_FILTER=y
CONFIG_HMP_FAST_CPU_MASK="2-3"
CONFIG_HMP_SLOW_CPU_MASK="0-1"
CONFIG_HMP_VARIABLE_SCALE=y
CONFIG_HMP_FREQUENCY_INVARIANT_SCALE=y
CONFIG_SCHED_HMP_ENHANCEMENT=y
CONFIG_HMP_TRACER=y
CONFIG_HMP_DYNAMIC_THRESHOLD=y
CONFIG_HMP_GLOBAL_BALANCE=y
CONFIG_HMP_TASK_ASSIGNMENT=y
CONFIG_HMP_DISCARD_CFS_SELECTION_RESULT=y
CONFIG_HMP_PACK_SMALL_TASK=y
CONFIG_HMP_LAZY_BALANCE=y
CONFIG_HMP_POWER_AWARE_CONTROLLER=y
CONFIG_HEVTASK_INTERFACE=y
CONFIG_PREEMPT=y
CONFIG_AEABI=y
# CONFIG_OABI_COMPAT is not set
CONFIG_HIGHMEM=y
CONFIG_CC_STACKPROTECTOR=y
CONFIG_USE_OF=y
CONFIG_BUILD_ARM_APPENDED_DTB_IMAGE=y
CONFIG_BUILD_ARM_APPENDED_DTB_IMAGE_NAMES="mt8135-stingray"
CONFIG_CMDLINE="console=tty0 console=ttyMT3,921600n1 root=/dev/ram vmalloc=496M slub_max_order=0 slub_debug=O"
# CONFIG_RESTART_DISABLE_CACHE is not set
CONFIG_CPU_FREQ=y
CONFIG_CPU_FREQ_STAT_DETAILS=y
CONFIG_CPU_FREQ_DEFAULT_GOV_INTERACTIVEPLUS=y
CONFIG_CPU_FREQ_GOV_POWERSAVE=y
CONFIG_CPU_FREQ_GOV_USERSPACE=y
CONFIG_CPU_FREQ_GOV_ONDEMAND=y
CONFIG_CPU_FREQ_GOV_INTERACTIVE=y
CONFIG_VFP=y
CONFIG_NEON=y
# CONFIG_CORE_DUMP_DEFAULT_ELF_HEADERS is not set
CONFIG_PM_AUTOSLEEP=y
CONFIG_PM_WAKELOCKS=y
CONFIG_PM_RUNTIME=y
CONFIG_PM_DEBUG=y
CONFIG_PM_ADVANCED_DEBUG=y
CONFIG_PM_TEST_SUSPEND=y
CONFIG_SUSPEND_TIME=y
CONFIG_NET=y
CONFIG_PACKET=y
CONFIG_UNIX=y
CONFIG_XFRM_MIGRATE=y
CONFIG_NET_KEY=y
CONFIG_INET=y
# CONFIG_IP_WOW is not set
CONFIG_IP_MULTICAST=y
CONFIG_IP_ADVANCED_ROUTER=y
CONFIG_IP_MULTIPLE_TABLES=y
CONFIG_IP_PNP=y
CONFIG_IP_PNP_DHCP=y
CONFIG_IP_PNP_BOOTP=y
CONFIG_NET_IPIP=y
CONFIG_IP_MROUTE=y
CONFIG_IP_MROUTE_MULTIPLE_TABLES=y
CONFIG_IP_PIMSM_V1=y
CONFIG_IP_PIMSM_V2=y
CONFIG_ARPD=y
CONFIG_SYN_COOKIES=y
CONFIG_INET_AH=y
CONFIG_INET_ESP=y
CONFIG_INET_IPCOMP=y
# CONFIG_INET_LRO is not set
CONFIG_IPV6=y
CONFIG_IPV6_PRIVACY=y
CONFIG_IPV6_ROUTER_PREF=y
CONFIG_IPV6_ROUTE_INFO=y
CONFIG_IPV6_OPTIMISTIC_DAD=y
CONFIG_INET6_AH=y
CONFIG_INET6_ESP=y
CONFIG_INET6_IPCOMP=y
CONFIG_IPV6_MIP6=y
CONFIG_INET6_XFRM_MODE_ROUTEOPTIMIZATION=y
CONFIG_IPV6_SIT_6RD=y
CONFIG_IPV6_TUNNEL=y
CONFIG_IPV6_MULTIPLE_TABLES=y
CONFIG_IPV6_SUBTREES=y
CONFIG_IPV6_MROUTE=y
CONFIG_IPV6_PIMSM_V2=y
CONFIG_MTK_TETHERINGIPV6_SUPPORT=y
CONFIG_MTK_DHCPV6C_WIFI=y
CONFIG_NETFILTER=y
CONFIG_NF_CONNTRACK=y
CONFIG_NF_CONNTRACK_EVENTS=y
CONFIG_NF_CT_PROTO_UDPLITE=y
CONFIG_NF_CONNTRACK_FTP=y
CONFIG_NF_CONNTRACK_PPTP=y
CONFIG_NF_CONNTRACK_SIP=y
CONFIG_NF_CONNTRACK_TFTP=y
CONFIG_NF_CT_NETLINK=y
CONFIG_NETFILTER_TPROXY=y
CONFIG_NETFILTER_XT_CONNMARK=y
CONFIG_NETFILTER_XT_TARGET_CLASSIFY=y
CONFIG_NETFILTER_XT_TARGET_IDLETIMER=y
CONFIG_NETFILTER_XT_TARGET_MARK=y
CONFIG_NETFILTER_XT_TARGET_NFLOG=y
CONFIG_NETFILTER_XT_TARGET_NFQUEUE=y
CONFIG_NETFILTER_XT_MATCH_CONNBYTES=y
CONFIG_NETFILTER_XT_MATCH_IPRANGE=y
CONFIG_NETFILTER_XT_MATCH_LENGTH=y
CONFIG_NETFILTER_XT_MATCH_LIMIT=y
CONFIG_NETFILTER_XT_MATCH_MAC=y
CONFIG_NETFILTER_XT_MATCH_MARK=y
CONFIG_NETFILTER_XT_MATCH_MULTIPORT=y
CONFIG_NETFILTER_XT_MATCH_POLICY=y
CONFIG_NETFILTER_XT_MATCH_PHYSDEV=y
CONFIG_NETFILTER_XT_MATCH_QTAGUID=y
CONFIG_NETFILTER_XT_MATCH_QUOTA=y
CONFIG_NETFILTER_XT_MATCH_QUOTA2=y
CONFIG_NETFILTER_XT_MATCH_QUOTA2_LOG=y
CONFIG_NETFILTER_XT_MATCH_REALM=y
CONFIG_NETFILTER_XT_MATCH_RECENT=y
CONFIG_NETFILTER_XT_MATCH_SOCKET=y
CONFIG_NETFILTER_XT_MATCH_STATE=y
CONFIG_NETFILTER_XT_MATCH_STATISTIC=y
CONFIG_NETFILTER_XT_MATCH_STRING=y
CONFIG_NETFILTER_XT_MATCH_TIME=y
CONFIG_NETFILTER_XT_MATCH_U32=y
CONFIG_NF_CONNTRACK_IPV4=y
CONFIG_IP_NF_IPTABLES=y
CONFIG_IP_NF_FILTER=y
CONFIG_IP_NF_TARGET_REJECT=y
CONFIG_NF_NAT_IPV4=y
CONFIG_IP_NF_TARGET_MASQUERADE=y
CONFIG_IP_NF_TARGET_NETMAP=y
CONFIG_IP_NF_TARGET_REDIRECT=y
CONFIG_IP_NF_MANGLE=y
CONFIG_IP_NF_RAW=y
CONFIG_IP_NF_ARPTABLES=y
CONFIG_NF_CONNTRACK_IPV6=y
CONFIG_IP6_NF_IPTABLES=y
CONFIG_IP6_NF_MATCH_FRAG=y
CONFIG_IP6_NF_MATCH_IPV6HEADER=y
CONFIG_IP6_NF_TARGET_HL=y
CONFIG_IP6_NF_FILTER=y
CONFIG_IP6_NF_TARGET_REJECT=y
CONFIG_IP6_NF_TARGET_REJECT_SKERR=y
CONFIG_IP6_NF_MANGLE=y
CONFIG_IP6_NF_RAW=y
CONFIG_NF_NAT_IPV6=y
CONFIG_BRIDGE=y
CONFIG_VLAN_8021Q=y
CONFIG_NET_SCHED=y
CONFIG_NET_SCH_HTB=y
CONFIG_NET_SCH_INGRESS=y
CONFIG_NET_CLS_FW=y
CONFIG_NET_CLS_U32=y
CONFIG_CLS_U32_PERF=y
CONFIG_CLS_U32_MARK=y
CONFIG_NET_CLS_FLOW=y
CONFIG_NET_CLS_ACT=y
CONFIG_NET_ACT_POLICE=y
CONFIG_NET_ACT_MIRRED=y
CONFIG_NET_ACT_IPT=y
CONFIG_NET_CLS_IND=y
CONFIG_CFG80211=y
CONFIG_NL80211_TESTMODE=y
CONFIG_CFG80211_DEVELOPER_WARNINGS=y
# CONFIG_CFG80211_DEFAULT_PS is not set
CONFIG_CFG80211_DEBUGFS=y
CONFIG_CFG80211_WEXT=y
# CONFIG_FW_LOADER_USER_HELPER is not set
CONFIG_ARM_CCI=y
CONFIG_MTD=y
# CONFIG_MTD_OF_PARTS is not set
CONFIG_MTD_BLOCK=y
CONFIG_MTD_NAND=y
CONFIG_MTD_NAND_PLATFORM=y
CONFIG_BLK_DEV_LOOP=y
CONFIG_UID_STAT=y
CONFIG_SLIMPORT_ANX3618=y
CONFIG_SCSI=y
CONFIG_SCSI_TGT=m
CONFIG_BLK_DEV_SD=y
CONFIG_SCSI_MULTI_LUN=y
CONFIG_SCSI_SCAN_ASYNC=y
# CONFIG_SCSI_LOWLEVEL is not set
CONFIG_MD=y
CONFIG_BLK_DEV_DM=y
CONFIG_DM_DEBUG=y
CONFIG_DM_CRYPT=y
CONFIG_DM_UEVENT=y
CONFIG_NETDEVICES=y
CONFIG_IFB=y
CONFIG_TUN=y
# CONFIG_ETHERNET is not set
CONFIG_PHYLIB=y
CONFIG_PPP=y
CONFIG_PPP_BSDCOMP=y
CONFIG_PPP_DEFLATE=y
CONFIG_PPP_FILTER=y
CONFIG_PPP_MPPE=y
CONFIG_PPP_MULTILINK=y
CONFIG_PPPOE=y
CONFIG_PPPOLAC=y
CONFIG_PPPOPNS=y
CONFIG_PPP_ASYNC=y
CONFIG_PPP_SYNC_TTY=y
CONFIG_USB_USBNET=y
# CONFIG_USB_NET_AX8817X is not set
# CONFIG_USB_NET_AX88179_178A is not set
CONFIG_USB_NET_CDC_EEM=y
CONFIG_USB_NET_CDC_MBIM=y
CONFIG_USB_NET_DM9601=y
# CONFIG_USB_NET_NET1080 is not set
CONFIG_USB_NET_RNDIS_HOST=y
# CONFIG_USB_NET_CDC_SUBSET is not set
# CONFIG_USB_NET_ZAURUS is not set
CONFIG_MTK_COMBO_WIFI=m
CONFIG_MTK_WAPI_SUPPORT=y
CONFIG_INPUT_EVDEV=y
CONFIG_MTK_KEYPAD=y
# CONFIG_KEYBOARD_ATKBD is not set
# CONFIG_INPUT_MOUSE is not set
CONFIG_INPUT_JOYSTICK=y
# CONFIG_JOYSTICK_ANALOG is not set
# CONFIG_JOYSTICK_A3D is not set
# CONFIG_JOYSTICK_ADI is not set
# CONFIG_JOYSTICK_COBRA is not set
# CONFIG_JOYSTICK_GF2K is not set
# CONFIG_JOYSTICK_GRIP is not set
# CONFIG_JOYSTICK_GRIP_MP is not set
# CONFIG_JOYSTICK_GUILLEMOT is not set
# CONFIG_JOYSTICK_INTERACT is not set
# CONFIG_JOYSTICK_SIDEWINDER is not set
# CONFIG_JOYSTICK_TMDC is not set
# CONFIG_JOYSTICK_IFORCE is not set
CONFIG_JOYSTICK_WARRIOR=y
# CONFIG_JOYSTICK_MAGELLAN is not set
# CONFIG_JOYSTICK_SPACEORB is not set
# CONFIG_JOYSTICK_SPACEBALL is not set
# CONFIG_JOYSTICK_STINGER is not set
# CONFIG_JOYSTICK_TWIDJOY is not set
# CONFIG_JOYSTICK_ZHENHUA is not set
# CONFIG_JOYSTICK_AS5011 is not set
# CONFIG_JOYSTICK_JOYDUMP is not set
CONFIG_JOYSTICK_XPAD=y
# CONFIG_JOYSTICK_XPAD_FF is not set
# CONFIG_JOYSTICK_XPAD_LEDS is not set
CONFIG_INPUT_TOUCHSCREEN=y
CONFIG_TOUCHSCREEN_MTK_SUPPORT=y
CONFIG_TOUCHSCREEN_MTK_ATMEL_MXT=y
CONFIG_INPUT_MISC=y
CONFIG_INPUT_HALL_BU520=y
CONFIG_INPUT_TEMPERATURE_TMP103=y
CONFIG_INPUT_UINPUT=y
# CONFIG_SERIO is not set
# CONFIG_VT is not set
CONFIG_LEGACY_PTY_COUNT=16
# CONFIG_HW_RANDOM is not set
CONFIG_I2C=y
CONFIG_SPI=y
CONFIG_GPIO_MT8135=y
CONFIG_POWER_SUPPLY=y
# CONFIG_HWMON is not set
CONFIG_THERMAL=y
CONFIG_THERMAL_DEFAULT_GOV_BACKWARD_COMPATIBLE=y
CONFIG_MTK_THERMAL_STATUS_COLLECTION=y
CONFIG_ION=y
CONFIG_FB=y
CONFIG_FB_MODE_HELPERS=y
CONFIG_FB_TILEBLITTING=y
CONFIG_SOUND=y
CONFIG_SND=y
CONFIG_SND_PCM_OSS=y
# CONFIG_SND_PCM_OSS_PLUGINS is not set
# CONFIG_SND_SUPPORT_OLD_API is not set
# CONFIG_SND_ARM is not set
# CONFIG_SND_SPI is not set
CONFIG_SND_USB_AUDIO=y
CONFIG_SND_SOC=y
CONFIG_SND_SOC_MT8135=y
CONFIG_SND_SOC_MT8135_ARIEL=y
CONFIG_KEYBOARD_HID=y
CONFIG_USB=y
CONFIG_USB_DEBUG=y
# CONFIG_USB_DEFAULT_PERSIST is not set
CONFIG_USB_ACM=y
CONFIG_USB_PRINTER=y
CONFIG_USB_STORAGE=y
CONFIG_USB_STORAGE_DATAFAB=y
CONFIG_USB_STORAGE_FREECOM=y
CONFIG_USB_STORAGE_ISD200=y
CONFIG_USB_STORAGE_USBAT=y
CONFIG_USB_STORAGE_SDDR09=y
CONFIG_USB_STORAGE_SDDR55=y
CONFIG_USB_STORAGE_JUMPSHOT=y
CONFIG_USB_STORAGE_ALAUDA=y
CONFIG_USB_STORAGE_ONETOUCH=y
CONFIG_USB_STORAGE_KARMA=y
CONFIG_USB_STORAGE_CYPRESS_ATACB=y
CONFIG_USB_TRANCEVIBRATOR=y
CONFIG_USB_PHY=y
CONFIG_NOP_USB_XCEIV=y
CONFIG_USB_GADGET=y
CONFIG_USB_GADGET_VBUS_DRAW=500
CONFIG_USB_G_ANDROID=y
CONFIG_MTK_MULTI_STORAGE_SUPPORT=y
CONFIG_MTK_BICR_SUPPORT=y
CONFIG_MMC=y
CONFIG_MMC_UNSAFE_RESUME=y
CONFIG_MMC_SAMSUNG_SMART=y
CONFIG_MMC_BLOCK_MINORS=32
CONFIG_NEW_LEDS=y
CONFIG_LEDS_CLASS=y
CONFIG_LEDS_LP855X=y
CONFIG_LEDS_TRIGGERS=y
CONFIG_LEDS_TRIGGER_TIMER=y
CONFIG_SWITCH=y
CONFIG_RTC_CLASS=y
CONFIG_STAGING=y
CONFIG_ZSMALLOC=y
CONFIG_ZRAM=y
CONFIG_ZRAM_DEBUG=y
CONFIG_ANDROID=y
CONFIG_ANDROID_BINDER_IPC=y
CONFIG_ASHMEM=y
CONFIG_ANDROID_LOGGER=y
CONFIG_ANDROID_LOW_MEMORY_KILLER=y
CONFIG_ANDROID_INTF_ALARM_DEV=y
CONFIG_SYNC=y
CONFIG_SW_SYNC=y
CONFIG_SW_SYNC_USER=y
# CONFIG_IOMMU_SUPPORT is not set
CONFIG_IIO=y
CONFIG_IIO_BUFFER=y
CONFIG_IIO_KFIFO_BUF=y
CONFIG_INV_MPU_IIO=y
CONFIG_INV_TESTING=y
CONFIG_EXT3_FS=y
# CONFIG_EXT3_DEFAULTS_TO_ORDERED is not set
CONFIG_EXT3_FS_POSIX_ACL=y
CONFIG_EXT4_FS=y
# CONFIG_EXT4_USE_FOR_EXT23 is not set
CONFIG_EXT4_FS_SECURITY=y
CONFIG_JBD_DEBUG=y
CONFIG_FUSE_FS=y
CONFIG_ISO9660_FS=y
CONFIG_JOLIET=y
CONFIG_ZISOFS=y
CONFIG_MSDOS_FS=y
CONFIG_VFAT_FS=y
CONFIG_TMPFS=y
CONFIG_TMPFS_POSIX_ACL=y
CONFIG_NLS_CODEPAGE_437=y
CONFIG_NLS_CODEPAGE_950=y
CONFIG_NLS_ASCII=y
CONFIG_NLS_ISO8859_1=y
CONFIG_NLS_UTF8=y
CONFIG_PRINTK_TIME=y
CONFIG_FRAME_WARN=1400
CONFIG_PANIC_ON_OOPS=y
CONFIG_SCHEDSTATS=y
CONFIG_SLUB_DEBUG_ON=y
CONFIG_PROVE_LOCKING=y
CONFIG_DEBUG_LOCKDEP=y
CONFIG_DEBUG_INFO=y
CONFIG_RCU_CPU_STALL_TIMEOUT=60
CONFIG_DYNAMIC_DEBUG=y
CONFIG_KGDB=y
CONFIG_KGDB_KDB=y
# CONFIG_ARM_UNWIND is not set
CONFIG_SECURITY=y
CONFIG_SECURITY_NETWORK=y
CONFIG_SECURITY_SELINUX=y
CONFIG_SECURITY_SELINUX_BOOTPARAM=y
CONFIG_CRYPTO_SHA1_ARM=y
CONFIG_CRYPTO_SHA256=y
CONFIG_CRYPTO_AES_ARM=y
CONFIG_CRYPTO_TWOFISH=y
# CONFIG_CRYPTO_ANSI_CPRNG is not set
# CONFIG_CRYPTO_HW is not set
CONFIG_LIBCRC32C=y
CONFIG_ARCH_MTK_PROJECT="mt8135_stingray"
CONFIG_MTK_INTERNAL=y
CONFIG_HAVE_XLOG_FEATURE=y
CONFIG_MTK_IN_HOUSE_TEE_SUPPORT=y
CONFIG_MTK_SEC_VIDEO_PATH_SUPPORT=y
CONFIG_MTK_OVERLAY_ENGINE_SUPPORT=y
CONFIG_MTK_DRM_KEY_MNG_SUPPORT=y
CONFIG_MTK_MMPROFILE_SUPPORT=y
CONFIG_MTK_EMMC_SUPPORT=y
CONFIG_CUSTOM_KERNEL_FLASHLIGHT="dummy_flashlight"
CONFIG_CUSTOM_KERNEL_IMGSENSOR="ov2722_mipi_raw hi704_yuv"
CONFIG_CUSTOM_KERNEL_LCM="cm_n070ice_dsi_vdo"
CONFIG_CUSTOM_KERNEL_TOUCHPANEL="GT927"
CONFIG_MTK_SCHED_TRACERS=y
# CONFIG_MTK_MET is not set
# CONFIG_MTK_MET_PLF is not set
CONFIG_MTPROF_CPUTIME=y
CONFIG_MTPROF_IRQ_DURATION=y
CONFIG_MTK_AEE_FEATURE=y
# CONFIG_MTK_AEE_KDUMP is not set
# CONFIG_ANDROID_VMEM is not set
CONFIG_MTK_RAM_CONSOLE=y
CONFIG_MTK_RAM_CONSOLE_USING_DRAM=y
CONFIG_MTK_RAM_CONSOLE_SIZE=0x20000
CONFIG_MTK_RAM_CONSOLE_ADDR=0xF900DC00
CONFIG_MTK_RAM_CONSOLE_DRAM_SIZE=0x20000
CONFIG_MTK_RAM_CONSOLE_DRAM_ADDR=0x82F00000
CONFIG_PREEMPT_MONITOR=y
CONFIG_ISR_MONITOR=y
CONFIG_MT_SCHED_MONITOR=y
CONFIG_MT_CHRDEV_REG=y
CONFIG_MT_DEBUG_MUTEXES=y
CONFIG_PRINTK_PROCESS_INFO=y
CONFIG_MT_ENG_BUILD=y
CONFIG_MTK_MEMCFG=y
CONFIG_MT_SCHED=y
CONFIG_MT_LOAD_BALANCE_ENHANCEMENT=y
CONFIG_MT_RT_SCHED_CRIT=y
CONFIG_MT_RT_SCHED=y
CONFIG_MT_RT_SCHED_LOG=y
CONFIG_MT_RT_SCHED_NOTICE=y
CONFIG_MTK_CIRQ=y
CONFIG_MTK_WQ_DEBUG=y
CONFIG_MT_PRIO_TRACER=y
# CONFIG_MTK_LEGACY_GPIO_DRIVER is not set
CONFIG_MD1_SMEM_SIZE="0x00200000"
CONFIG_MD2_SMEM_SIZE="0x00200000"
CONFIG_MTK_FB=y
CONFIG_MTK_M4U_SUPPORT=y
CONFIG_MTK_DITHERING_SUPPORT=y
CONFIG_CM_N070ICE_DSI_VDO=y
CONFIG_MTK_LCM_PHYSICAL_ROTATION="0"
CONFIG_LCM_WIDTH="800"
CONFIG_LCM_HEIGHT="1280"
# CONFIG_MTK_GPS_SUPPORT is not set
CONFIG_MTK_BT_SUPPORT=y
CONFIG_MTK_COMBO=m
CONFIG_MTK_COMBO_PLAT_PATH="alps"
CONFIG_MTK_COMBO_COMM=m
CONFIG_MTK_COMBO_COMM_UART=m
CONFIG_MTK_COMBO_COMM_SDIO=m
CONFIG_MTK_COMBO_BT=m
CONFIG_MTK_COMBO_GPS=m
CONFIG_MTK_COMBO_PSM_RX_TH="1600"
CONFIG_MTK_COMBO_PSM_TX_TH="280"
CONFIG_MTK_MERGE_INTERFACE_SUPPORT=y
CONFIG_MTK_VIDEOCODEC_DRIVER=m
CONFIG_MTK_HDMI_SUPPORT=y
CONFIG_MTK_INTERNAL_HDMI_SUPPORT=y
CONFIG_MTK_LEDS=y
CONFIG_MTK_MMC=y
CONFIG_MTK_PMIC_RF2_26M_ALWAYS_ON=y
# CONFIG_MTK_BQ24196_SUPPORT is not set
CONFIG_MTK_BQ24297_SUPPORT=y
CONFIG_MTK_DISABLE_POWER_ON_OFF_VOLTAGE_LIMITATION=y
CONFIG_MTK_KERNEL_POWER_OFF_CHARGING=y
CONFIG_MTK_BATTERY_THROTTLING=y
CONFIG_MTK_ENABLE_AGING_ALGORITHM=y
CONFIG_MTK_BATTERY_LIFETIME_DATA_SUPPORT=y
CONFIG_SOC_BY_HW_FG=y
CONFIG_SWCHR_POWER_PATH=y
CONFIG_CUST_DISABLE_CAPACITY_OCV2CV_TRANSFORM=y
CONFIG_CONFIG_DIS_CHECK_BATTERY=y
CONFIG_MTK_SIM1_SOCKET_TYPE="1"
CONFIG_MTK_SIM2_SOCKET_TYPE="1"
CONFIG_MTK_TOUCHPANEL=y
CONFIG_USB_MTK_HDRC_GADGET=y
CONFIG_USB_MTK_OTG=y
CONFIG_USB_MTK_DEBUG_FS=y
CONFIG_USB_MTK_DEBUG=y
CONFIG_USB_MTK_HDRC_HCD=y
CONFIG_MTK_MULTIBRIDGE_SUPPORT=y
CONFIG_ION_MTK=y
CONFIG_MMPROFILE=y
CONFIG_MTK_IMGSENSOR_HI704YUV_SUPPORT=y
CONFIG_MTK_IMGSENSOR_OV2722MIPIRAW_SUPPORT=y
CONFIG_MTK_EEPROM_DUMMYEEPROM_SUPPORT=y
CONFIG_MTK_CAMCAL_DUMMYCAMCAL_SUPPORT=y
CONFIG_MTK_FLASHLIGHT_DUMMYFLASHLIGHT_SUPPORT=y
CONFIG_MTK_LENS_DUMMYLENS_SUPPORT=y
CONFIG_HID_SUPPORT=y
CONFIG_HID=y
# CONFIG_HID_BATTERY_STRENGTH is not set
# CONFIG_HIDRAW is not set
CONFIG_UHID=y
CONFIG_HID_APPLE=y
CONFIG_HID_APPLEIR=y
CONFIG_HID_MAGICMOUSE=y
CONFIG_HID_MICROSOFT=y
CONFIG_HID_BELKIN=y
CONFIG_HID_KENSINGTON=y
CONFIG_HID_LOGITECH=y
CONFIG_HID_SONY=y
CONFIG_HID_STEELSERIES=y
CONFIG_HID_GENERIC=y
CONFIG_HID_ACRUX=y
CONFIG_HID_DRAGONRISE=y
CONFIG_HID_PANTHERLORD=y
CONFIG_HID_GREENASIA=y
CONFIG_HID_ZEROPLUS=y
```
