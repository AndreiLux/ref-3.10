## arch/arm/configs/apq8084_sec_eng_defconfig
```kconfig
CONFIG_DEVMEM=y
CONFIG_DEVKMEM=y
CONFIG_MSM_CACHE_DUMP=y
CONFIG_MSM_CACHE_DUMP_ON_PANIC=y
CONFIG_NET_VENDOR_ATHEROS=y
CONFIG_ATL1C=m
CONFIG_DM_REQ_CRYPT=y
CONFIG_MSM_IOMMU_PMON=y
CONFIG_CORESIGHT=y
CONFIG_CORESIGHT_FUSE=y
CONFIG_CORESIGHT_TMC=y
CONFIG_CORESIGHT_TPIU=y
CONFIG_CORESIGHT_FUNNEL=y
CONFIG_CORESIGHT_REPLICATOR=y
CONFIG_CORESIGHT_STM=y
CONFIG_CORESIGHT_HWEVENT=y
CONFIG_CORESIGHT_ETM=y
CONFIG_CORESIGHT_ETM_PCSAVE_DEFAULT_ENABLE=y
CONFIG_CORESIGHT_AUDIO_ETM=y
CONFIG_CORESIGHT_RPM_ETM=y
CONFIG_CORESIGHT_EVENT=y
CONFIG_LOCKUP_DETECTOR=y
# CONFIG_DETECT_HUNG_TASK is not set
CONFIG_DEBUG_KMEMLEAK=y
CONFIG_DEBUG_KMEMLEAK_EARLY_LOG_SIZE=4000
CONFIG_DEBUG_KMEMLEAK_DEFAULT_OFF=y
CONFIG_DEBUG_SPINLOCK=y
CONFIG_DEBUG_MUTEXES=y
CONFIG_DEBUG_ATOMIC_SLEEP=y
CONFIG_DEBUG_STACK_USAGE=y
CONFIG_DEBUG_LIST=y
CONFIG_SLUB_DEBUG=y
CONFIG_SLUB_DEBUG_ON=y
CONFIG_SLABINFO=y
CONFIG_FAULT_INJECTION=y
CONFIG_FAIL_PAGE_ALLOC=y
CONFIG_UFS_FAULT_INJECTION=y
CONFIG_FAULT_INJECTION_DEBUG_FS=y
CONFIG_FAULT_INJECTION_STACKTRACE_FILTER=y
CONFIG_DEBUG_PAGEALLOC=y
CONFIG_MSM_RTB=y
CONFIG_MSM_RTB_SEPARATE_CPUS=y
CONFIG_PANIC_ON_DATA_CORRUPTION=y
CONFIG_FORCE_PAGES=y
CONFIG_FREE_PAGES_RDONLY=y
CONFIG_DEBUG_LL=y
CONFIG_EARLY_PRINTK=y
CONFIG_DEBUG_SET_MODULE_RONX=y
CONFIG_CRYPTO_XTS=y
# CONFIG_CRYPTO_DEV_QCRYPTO is not set
CONFIG_PRINTK_PROCESS=y
CONFIG_MSMB_CAMERA_DEBUG is not set
CONFIG_MSM_SENSOR_DRIVER_DEBUG is not set
CONFIG_MSM_EEPROM_DEBUG is not set
CONFIG_MSM_CPP_DEBUG is not set
CONFIG_MSM_CAMERA_DT_DEBUG is not set
CONFIG_MSM_ISP_DEBUG is not set
CONFIG_MSM_CC_SPI_TRANS_DEBUG is not set
CONFIG_MSM_CC_DEBUG is not set
CONFIG_BLOCK=y
CONFIG_BLK_DEV_IO_TRACE=y
CONFIG_IKCONFIG=y

# GPIO DVS feature
CONFIG_SEC_GPIO_DVS=y

# NOC Debug
CONFIG_MSM_BUSPM_DEV=y

# CONFIG_SEC_RESTRICT_ROOTING is not set
# CONFIG_SEC_RESTRICT_SETUID is not set
# CONFIG_SEC_RESTRICT_FORK is not set
# CONFIG_SEC_RESTRICT_ROOTING_LOG is not set

#QCA6174 fw log
CONFIG_FW_LOGS_BASED_ON_INI=y
```

## arch/arm/configs/apq8084_sec_lentislte_ktt_defconfig
```kconfig
CONFIG_SEC_LENTIS_PROJECT=y
CONFIG_MACH_LENTISLTE_KTT=y
#
#Debug
#
CONFIG_SEC_DEBUG_NOCACHE_LOG_IN_LEVEL_LOW=y
#
# MAX77828 IC
#
CONFIG_EXTCON=y
CONFIG_EXTCON_MAX77828=y
CONFIG_MFD_MAX77828=y
CONFIG_MOTOR_DRV_MAX77828=y
CONFIG_TACTILE_ASSIST=y
CONFIG_VIBETONZ=y
CONFIG_LEDS_MAX77828=y
#
# MAX77804K IC
#
CONFIG_MFD_MAX77804K=y
CONFIG_EXTCON_MAX77804K=y
CONFIG_MOTOR_DRV_MAX77804K=y
#
#
# Supprot MDM(SDS)
#
CONFIG_USB_LOCK_SUPPORT_FOR_MDM=y
#
# IDCHIP
#
#CONFIG_INPUT_HALLIC=y
CONFIG_SENSORS_HALL=y
CONFIG_W1=y
CONFIG_W1_MASTER_GPIO_MSM=y
CONFIG_W1_SLAVE_DS28E15=y
CONFIG_W1_WORKQUEUE=y
CONFIG_W1_FAST_CHECK=y
CONFIG_W1_SN=y
CONFIG_OF_SUBCMDLINE_PARSE=y
#
# Battery & Charger
#
# CONFIG_SMB350_CHARGER is not set
# CONFIG_BATTERY_BQ28400 is not set
# CONFIG_BATTERY_MSM is not set
# CONFIG_FUELGAUGE_DUMMY is not set
#
# MAX77823 Charger
#
# CONFIG_QPNP_CHARGER is not set
# CONFIG_QPNP_BMS is not set
CONFIG_MFD_MAX77823=y
CONFIG_FUELGAUGE_MAX77823=y
CONFIG_FUELGAUGE_MAX77823_COULOMB_COUNTING=y
CONFIG_CHARGER_MAX77823=y
CONFIG_CHARGER_MAX77804K=y
CONFIG_FUELGAUGE_MAX17048=y
CONFIG_SAMSUNG_LPM_MODE=y
CONFIG_BATTERY_SAMSUNG=y
CONFIG_SAMSUNG_BATTERY_DISALLOW_DEEP_SLEEP=y
#
# NFC
#
CONFIG_NFC_PN547=y
CONFIG_NFC_PN547_8084_USE_BBCLK2=y

#
#TSP, TKEY, Booster
#
CONFIG_TOUCHSCREEN_SYNAPTICS_I2C_RMI_G=y
CONFIG_KEYBOARD_CYPRESS_TOUCHKEY=y
CONFIG_INPUT_BOOSTER=y

#
# LCD PANEL INFO
#
CONFIG_FB_MSM_MIPI_SAMSUNG_OCTA_CMD_WQHD_PT_PANEL=y
CONFIG_FB_MSM_CMD_MODE_PANEL=y
CONFIG_FB_MSM_DUAL_DSI_MODE=y
CONFIG_FB_MSM_MDSS_DSI_DBG=y

#
# Finger print sensor
#
CONFIG_SENSORS_FINGERPRINT=y
CONFIG_SENSORS_FINGERPRINT_SYSFS=y
CONFIG_SENSORS_VFS61XX=y
CONFIG_SENSORS_VFS61XX_KO=y

# SensorHub
CONFIG_SENSORS_SSP=y
CONFIG_SENSORS_SYSFS=y
CONFIG_SENSORS_SSP_ATMEL=y
CONFIG_SENSORS_SSP_SENSORHUB=y
CONFIG_SENSORS_SSP_FACTORY=y
CONFIG_SENSORS_SSP_MPU6500=y
CONFIG_SENSORS_SSP_LPS25H=y
CONFIG_SENSORS_SSP_YAS532=y
CONFIG_SENSORS_SSP_TMG399X=y
CONFIG_SENSORS_SSP_MOBEAM=y
CONFIG_SENSORS_SSP_ATUC128L5HAR=y
CONFIG_IIO=y
CONFIG_IIO_BUFFER=y
CONFIG_IIO_KFIFO_BUF=y
CONFIG_IIO_TRIGGER=y
CONFIG_SENSORS_SSP_ACC_CHECK=y

# Hrm Sensor
CONFIG_SENSORS_MAX86900=y

#B10
CONFIG_USER_RESET_DEBUG=y

#
# CAMERA
#
CONFIG_S5K2P2XX=y
CONFIG_COMPANION=y
CONFIG_LEDS_MAX77828=y
CONFIG_LEDS_MAX77804K=y
CONFIG_DEBUG_FLASH is not set

CONFIG_LEDS_MAX77828_RGB=y
#CONFIG IR LED
CONFIG_SEC_FPGA_ICE40XX=y
# DMB
CONFIG_TDMB=y
CONFIG_TDMB_VENDOR_FCI=y
CONFIG_TDMB_FC8080=y
CONFIG_TDMB_SPI=y
CONFIG_TDMB_QUALCOMM=y

#HDMI
CONFIG_SEC_MHL_SII8240=y
CONFIG_MHL_VERSION=0x21

CONFIG_LEDS_AN30259A=y

CONFIG_CMA_PAGE_COUNTING=y
CONFIG_EXCLUDE_LRU_LIVING_IN_CMA=y

# SSWAP
CONFIG_SWAP=y
CONFIG_FRONTSWAP=y
CONFIG_ZSMALLOC_NEW=y
CONFIG_PGTABLE_MAPPING=y
CONFIG_ZSWAP=y
CONFIG_DIRECT_RECLAIM_FILE_PAGES_ONLY=n
CONFIG_INCREASE_MAXIMUM_SWAPPINESS=y
CONFIG_FIX_INACTIVE_RATIO=y
CONFIG_TIGHT_PGDAT_BALANCE=y
CONFIG_VNSWAP=y
CONFIG_SWAP_ENABLE_READAHEAD=n
```
