## drivers/cpuidle/Kconfig
```kconfig
config CPU_IDLE
	bool "CPU idle PM support"
	default y if ACPI || PPC_PSERIES
	help
	  CPU idle is a generic framework for supporting software-controlled
	  idle processor power management.  It includes modular cross-platform
	  governors that can be swapped during runtime.

	  If you're using an ACPI-enabled platform, you should say Y here.

config CPU_IDLE_MULTIPLE_DRIVERS
        bool "Support multiple cpuidle drivers"
        depends on CPU_IDLE
        default n
        help
         Allows the cpuidle framework to use different drivers for each CPU.
         This is useful if you have a system with different CPU latencies and
         states. If unsure say N.

config CPU_IDLE_GOV_LADDER
	bool
	depends on CPU_IDLE
	default y

config CPU_IDLE_GOV_MENU
	bool
	depends on CPU_IDLE && NO_HZ
	default y

config ARCH_NEEDS_CPU_IDLE_COUPLED
	def_bool n

config OF_IDLE_STATES
        bool "Idle states DT support"
	depends on ARM || ARM64
	default n
	help
	 Allows the CPU idle framework to initialize CPU idle drivers
	 state data by using DT provided nodes compliant with idle states
	 device tree bindings.

if CPU_IDLE

config CPU_IDLE_CALXEDA
	bool "CPU Idle Driver for Calxeda processors"
	depends on ARCH_HIGHBANK
	help
	  Select this to enable cpuidle on Calxeda processors.

menu "ARM64 CPU Idle Drivers"
depends on ARM64
source "drivers/cpuidle/Kconfig.arm64"
endmenu

config CPU_IDLE_ODIN
	bool "CPU Idle Driver for Odin processors"
	depends on ARCH_ODIN
	select ARM_CPU_SUSPEND
	select CPU_IDLE_MULTIPLE_DRIVERS
	help
	  Select this to enable cpuidle on Odin processors.

config CPU_IDLE_ODIN_SW_WORKAROUND
	bool "SW Workaround for Odin's cpuidle"
	depends on ARCH_ODIN_REVISION=0 || ARCH_ODIN_REVISION=1
	default y
	help
	  ES1 of Odin needs SW workaround for cpuidle.

endif
```

## drivers/cryptodev-linux/Kconfig
```kconfig
#lg-security@lge.com 2015.02

comment "LGE CryptoDev selection"

config CRYPTODEV
	bool "Crypto device"
	default n
	---help---
	Kernel crypto API for userspace processes.
```

## drivers/dsp/Kconfig
```kconfig
menuconfig DSP
	bool "Audio DSP Driver Support"
	help
	  Audio DSP Driver supports tensilica DSP as LPA(Low Power Audio), OMX(OpenMAX), 
	  and ALSA(Advanced Linux Sound Architecture)-DSP interface.
	  Say Y if you want for Audio DSP Driver.

if DSP

config WODEN_DSP
	bool "Audio DSP Driver for the Woden"
	depends on ARCH_WODEN
    help
      Say Y or M here if you want support for DSP Driver on Woden.

config ODIN_DSP
	bool "Audio DSP Driver for the Odin"
	depends on ARCH_ODIN
	help
      Say Y or M here if you want support for DSP Driver on Odin.

endif	
```

## drivers/gpu/arm_r3p0/t6xx/kbase/src/platform/k3v3/Kconfig
```kconfig
config MALI_PLATFORM_K3V3
	bool "Enable k3v3 platform config"
	depends on MALI_T6XX && MALI_EXPERT
	default y
	help
	   You can config this for k3v3 chip.
```

## drivers/gpu/rgx/Kconfig
```kconfig
menu "Graphics Processing Unit"
config POWERVR_RGX
	bool "Imagination PowerVR Series6 Rogue"
	default n
	select FB
	help
	  Choose this option if you wish to use PowerVR GPU.

choice
    prompt "Target for Imagination PowerVR Series6 Rogue"
	depends on POWERVR_RGX

config RGX_WODEN
	bool "Woden"
	select FB
	depends on !ARCH_ODIN
	help
	  Choose this option if you wish to use PowerVR Serise6 HOOD.

config RGX_ODIN
	bool "Odin"
	depends on (ARCH_ODIN_REVISION=0) || (ARCH_ODIN_REVISION=1)
	select FB
	help
	  Choose this option if you wish to use PowerVR Serise6 HOOD.

config RGX_ODIN_ES2
	bool "Odin_ES2"
	depends on ARCH_ODIN_REVISION=2
	select FB
	help
	  Choose this option if you wish to use PowerVR Serise6 HOOD.
endchoice

config RGX_ION
	bool "Enable RGX HOOD support ION memory driver"
	depends on ION && POWERVR_RGX
	default y
	help
	  Choose this option if you wish to use ION memory driver support.

config RGX_APM_RASCALDUST
	bool "RGX HOOD Active Power Management for RD"
	depends on PM && POWERVR_RGX
	default n
	help
	  Choose this option if you wish to use Active Power Management Phase RASCAL and DUST.

config RGX_APM_TLA
	bool "RGX HOOD Active Power Management for TLA"
	depends on PM && POWERVR_RGX
	default n
	help
	  Choose this option if you wish to use Active Power Management Phase TLA.

config RGX_DVFS
	bool "RGX HOOD Dynamic Voltage Frequency Scaling"
	depends on PM && POWERVR_RGX
	default n
	help
	  Choose this option if you wish to use Dynamic Voltage Frequency Scaling.

config AVOID_LOCKDEP_FALSE_POSITIVE_WARN
	bool "RGX HOOD avoid LOCKDEP false positive warning"
	depends on DEBUG_LOCKDEP && POWERVR_RGX
	default y
	help
	  Prevent CONFIG_LOCKDEP false positive detection.
endmenu
```

## drivers/hisi/Kconfig
```kconfig
source "drivers/hisi/rproc/Kconfig"
source "drivers/hisi/rdr/Kconfig"
source "drivers/hisi/socp/Kconfig"
source "drivers/hisi/ipcm/Kconfig"
source "drivers/hisi/mailbox/Kconfig"
source "drivers/hisi/hifidsp/Kconfig"
source "drivers/hisi/hmpthresholds/Kconfig"
source "drivers/hisi/irq/Kconfig"
source "drivers/hisi/hkadc/Kconfig"
```

## drivers/hisi/hifidsp/Kconfig
```kconfig
menu "Hifimisc driver serve HIFI dsp"

config SND_HIFI_LPP
     bool "hifi low power play device support"
     default n
     help
          hifi lpp device provide service for HIFI and AP, in case of HIFI ultra-low power audio play.
config SND_HIFI_LOAD
     bool "hifi low power play device loae section in kernel"
     default n
     help
          load hifi image in hifi driver.
config SND_HIFI_SEC_LOAD
     bool "hifi low power play device support"
     default n
     help
          hifi lpp device provide service for HIFI and AP, in case of HIFI ultra-low power audio play.
	  load hifi image in security os

endmenu
```

## drivers/hisi/irq/Kconfig
```kconfig
comment "kernel/driver/hisi/irq/irq_affinity_debugfs.c"
config HISI_IRQ_AFFINITY_DEBUGFS
	bool "Hisilicon irq affinity debugfs"
	depends on HISI_IRQ_AFFINITY
	default n
	help
	  Debug code for HISI irq affinity recovery in smp system
```

## drivers/hisi/rproc/Kconfig
```kconfig
comment "HiIPCV230 ipc MailBox driver"
config HISI_MAILBOX
	bool "HiIPCV230 ipc MailBox driver"
	default n
	help
	  HiIPCV230 ipc MailBox driver

comment "HiIPCV230 ipc mailboxes debugfs user"
config HISI_MAILBOX_DEBUGFS
	bool "HiIPCV230 ipc mailboxes debugfs user"
	depends on HISI_MAILBOX && DEBUG_FS
	default n
	help
	  HiIPCV230 ipc mailboxes debugfs user

comment "HiIPCV230 ipc MailBox driver performance debug"
config HISI_MAILBOX_PERFORMANCE_DEBUG
	bool "HiIPCV230 ipc MailBox driver performance debug"
	depends on HISI_MAILBOX
	default n
	help
	  Print tts of sending task, if config is set y

comment "HISI K3V3 kernel API about remote processor communication"
config HISI_RPROC
	bool "HISI K3V3 ipc kernel API"
	default n
	help
	  Packet complex mailbox interfaces & provide simple kernel API

comment "HISI K3V3 rproc kernel API debugfs"
config HISI_RPROC_DEBUGFS
	bool "HISI K3V3 rproc kernel API debugfs"
	depends on HISI_RPROC && DEBUG_FS
	default n
	help
	  debug for hisi_rproc
```

## drivers/huawei/Kconfig
```kconfig
menu "huawei linux device driver support package"

source "drivers/huawei/inputhub/Kconfig"
source "drivers/huawei/nfc/Kconfig"
source "drivers/huawei/log/Kconfig"
source "drivers/huawei/gps/Kconfig"
source "drivers/huawei/touchscreen/Kconfig"
source "drivers/huawei/wifi/Kconfig"
source "drivers/huawei/tp_color/Kconfig"
source "drivers/huawei/sensor/Kconfig"
source "drivers/huawei/irda/Kconfig"
source "drivers/huawei/hw_kstate/Kconfig"
source "drivers/huawei/dsm/Kconfig"
source "drivers/huawei/ext_modem/Kconfig"
endmenu
```
