/*
 * LG Electronics Odin
 */

/dts-v1/;

/include/ "odin-madk-es2.dtsi"

/ {
	model = "LG Electronics ODIN";
	compatible = "lge,odin";
	hwversion = <0x0B 0x0>;
	option = "DEFAULT";

	memory@80000000 {
		device_type = "memory";
		/* 3G DRAM, enable MEMC #0 & #1 both, interleaving on */
/*		reg = <0x0 0x80000000 0x0 0x5B000000 0x1 0x00000000 0x0 0x60000000>;*/
		/* (for I-tuner only) 3G DRAM, enable MEMC #0 & #1 both, interleaving on */
		/* reg = <0x0 0x80000000 0x0 0x53000000 0x1 0x00000000 0x0 0x60000000>; */
		/* 25nm 2GB DDR3, enable MEMC #0 & #1 both, interleaving on */
		reg = <0x0 0x80000000 0x0 0x5C000000 0x0 0xDF000000 0x0 0x21000000>;
	};

	aliases {
		odin,sys_timer = &s_timer;
		serial0 = &s_uart;
		serial1 = &bluetooth;
                serial2 = &gps;
                serial3 = &irrc;
		si2s0 = &si2s_0;
		si2s1 = &si2s_1;
		si2s2 = &si2s_2;
		si2s3 = &si2s_3;
	};

	chosen {
		bootargs = "init=/init vmalloc=600M console=ttyS0,115200n8 androidboot.hardware=liger no_console_suspend earlyprintk lge.rev=rev_i boot.mode=normal lge.signed_image=false lge.r=normal trace_event=irq,timer";
		linux,initrd-start = <0x83000000>;
		linux,initrd-end = <0x84000000>;
	};

};

/include/ "./liger/clocks.dtsi"
/include/ "./liger/connectivity_reva.dtsi"
/include/ "./liger/i2c_uart_gpio_spi_reva.dtsi"
/include/ "./liger/audio_revb.dtsi"
/include/ "./liger/css.dtsi"
/include/ "./liger/iommu_dma_2g.dtsi"
/include/ "./liger/display.dtsi"
/include/ "./liger/storage_reva.dtsi"
/include/ "./liger/power_etc_reva.dtsi"
/include/ "./liger/tdmb_reva.dtsi"
/include/ "./liger/usb2.dtsi"
