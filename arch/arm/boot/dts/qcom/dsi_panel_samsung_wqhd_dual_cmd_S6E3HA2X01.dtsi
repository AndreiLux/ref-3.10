/* Copyright (c) 2012, Samsung Electronics Corporation. All rights reserved.
 *
 * This program is free software; you can redistribute it and/or modify
 * it under the terms of the GNU General Public License version 2 and
 * only version 2 as published by the Free Software Foundation.
 *
 * This program is distributed in the hope that it will be useful,
 * but WITHOUT ANY WARRANTY; without even the implied warranty of
 * MERCHANTABILITY or FITNESS FOR A PARTICULAR PURPOSE.  See the
 * GNU General Public License for more details.
 */

&mdss_mdp {
	dsi_dual_samsung_cmd_S6E3HA2X01_0: wqhd_cmd0 {
		qcom,mdss-dsi-panel-name = "samsung,mdss-amoled-dual_dsi-panel";
		label = "samsung amoled wqhd command mode dis0 S6E3HA2X01 panel";
		status = "disable";

		qcom,mdss-dsi-panel-controller = <&mdss_dsi0>;
		qcom,mdss-dsi-panel-type = "dsi_cmd_mode";
		qcom,mdss-pan-dest = "display_1";

		qcom,enable-gpio = <&pma8084_gpios 6 0>;
		qcom,rst-gpio = <&pma8084_gpios 21 0>;
		qcom,te-gpio = <&msmgpio 12 0>;

		qcom,cont-splash-enabled;
		qcom,partial-update-enabled;
		qcom,partial-update-roi-merge;
		qcom,mdss-dsi-panel-broadcast-mode;
		qcom,panel-roi-alignment = <8 8 1 1 1 2>;

		qcom,mdss-pan-res = <720 2560>;
		qcom,mdss-pan-size = <65 115>; /* <Width> <Height> real size of panel in mm */
		qcom,mdss-pan-bpp = <24>;

		qcom,mdss-clk-rate=<898000000>;

		qcom,mdss-vsync-enable=<1>;
		qcom,mdss-hw-vsync-mode=<1>;
		qcom,mdss-pan-insert-dcs-cmd=<1>;
		qcom,mdss-pan-wr-mem-continue=<0x3c>;
		qcom,mdss-pan-wr-mem-start=<0x2c>;
		qcom,mdss-pan-te-sel=<1>;
		qcom,mdss-pan-clk-rate=<898000000>;

		qcom,mdss-pan-porch-values = <108 15 212 4 2 10>; /* <HBP> <HPW> <HFP> <VBP> <VPW> <VFP> */

		qcom,mdss-pan-underflow-clr = <0xff>;
		qcom,mdss-pan-bl-ctrl = "bl_ctrl_dcs_cmds";
		qcom,mdss-pan-bl-levels = <1 255>;
		qcom,mdss-pan-dsi-mode = <1>;
		qcom,mdss-pan-dsi-h-pulse-mode = <0>;
		qcom,mdss-pan-dsi-h-power-stop = <0 0 0>;
		qcom,mdss-pan-dsi-bllp-power-stop = <1 1>;
		qcom,mdss-pan-dsi-traffic-mode = <2>;
		qcom,mdss-pan-dsi-dst-format = <8>;
		qcom,mdss-pan-dsi-vc = <0>;
		qcom,mdss-pan-dsi-rgb-swap = <0>;
		qcom,mdss-force-clk-lane-hs = <0>;
		samsung,mdss-early-lcd-on = <1>;
		qcom,mdss-pan-dsi-data-lanes = <1 1 1 1>;
		qcom,mdss-pan-dsi-dlane-swap = <0>;
		qcom,mdss-pan-dsi-t-clk = <0x30 0x04>;
		qcom,mdss-pan-dsi-stream = <0>;
		qcom,mdss-pan-dsi-mdp-tr = <0x0>;
		qcom,mdss-pan-dsi-dma-tr = <0x04>;
		qcom,mdss-pan-dsi-tx-eot-append = <1>;
		qcom,mdss-pan-dsi-frame-rate = <60>;
		qcom,panel-phy-regulatorSettings = [07 09 03 00  /* Regualotor settings */
						    20 00 01];
		qcom,panel-phy-timingSettings = [FA 4B 41 00 66 81 34 4C 41 03 04 A0];

		qcom,panel-phy-strengthCtrl = [ff 06];		/*!!!! */
		qcom,panel-phy-bistCtrl = [00 00 b1 ff 
                                              00 00];   /*!!!! BIST Ctrl settings */
		qcom,panel-phy-laneConfig = [
			00 00 00 00 00 00 00 01 97 /* lane0 config */
			00 00 00 00 05 00 00 01 97 /* lane1 config */
			00 00 00 00 0a 00 00 01 97 /* lane2 config */
			00 00 00 00 0f 00 00 01 97 /* lane3 config */
			00 c0 00 00 00 00 00 01 bb]; /* Clk ln config */

		qcom,mdss-dsi-on-command= [
				
				05 01 00 00 05 00 02 11 00 			/* Sleep out, wait 120ms(0x78) */

				29 01 00 00 00 00 03 F0 5A 5A 		/* TEST KEY Enable */
				29 01 00 00 78 00 03 F2 63 41		/* DUAL DSI */

				05 01 00 00 00 00 02 35 00			/* TE Vsync ON */
				29 01 00 00 00 00 07 BD 30 22 02 16 02 16 /*TSP TE*/
				29 01 00 00 00 00 05 C0 30 00 D8 D8	/* Pentile setting */

				29 01 00 00 00 00 24				/* Brightness condition set */
					CA 
					01 00 01 00 01 00 
					80 80 80
					80 80 80
					80 80 80
					80 80 80
					80 80 80
					80 80 80
					80 80 80
					80 80 80
					00 00 00
					00 00
				29 01 00 00 00 00 03 B2 03 10		/* AID 10% */
				29 01 00 00 00 00 03 B6 8C 0A		/* ELVSS Setting */
				29 01 00 00 00 00 02 F7 03		/* Gamma, LTPS(AID) update */

				29 01 00 00 00 00 03 F0 A5 A5		/* TEST KEY key Disable  */
			];
		qcom,mdss-dsi-on-command-state = "dsi_lp_mode";
		qcom,mdss-dsi-off-command = [
				05 01 00 00 0A 00 02 28 00			/* wait 10ms(0x0A) */
				05 01 00 00 78 00 02 10 00			/* wait 120ms(0x78) */
		];
		qcom,mdss-dsi-off-command-state = "dsi_hs_mode";
		/*
			the last byte in read commands  represent READ LENGH,
			like below  READ LENGH = 0x21
		 */
		 	samsung,panel-test-key-enable-cmds 	= [ 29 01 00 00 00 00 03 F0 5A 5A];
		 	samsung,panel-test-key-disable-cmds = [ 29 01 00 00 00 00 03 F0 A5 A5];

			samsung,panel-nv-mtp-read-cmds		= [ 06 01 00 00 00 00 01 c8 23 00];

			samsung,panel-nv-mdnie-read-cmds	= [ 06 01 00 00 00 00 01 A1 04 00];
			samsung,panel-nv-mtp-read-elvss-cmds	= [ 06 01 00 00 00 00 01 b6 01 14];	/* read C6 21th , 20=0x14*/
			samsung,panel-nv-read-cmds			= [ 06 01 00 00 00 00 01 c8 21 00];
			samsung,panel-nv-read-enable-cmds = [
								29 01 00 00 00 00 03 f0 5a 5a
								29 01 00 00 00 00 03 F2 63 41];		/* DUAL DSI */
			samsung,panel-nv-read-disable-cmds = [ 29 01 00 00 00 00 03 f0 a5 a5 ];

			/* the last byte in all read commands will represent READ LENGH */
			samsung,panel-manufacture-id-read-cmds = [
								06 01 00 00 00 00 01 da 01 00
								06 01 00 00 00 00 01 db 01 00
								06 01 00 00 00 00 01 dc 01 00];

			samsung,panel-manufacture-date-read-cmds = [ 06 01 00 00 00 00 01 c8 02 28];	/* read C8 41~42th , 40=0x28*/

			samsung,panel-ddi-id-read-cmds = [ 06 01 00 00 00 00 01 d6 05 00];	/* read D6 1~5th */

			samsung,panel-ldi-debug-read-cmds = [
								06 01 00 00 00 00 01 0A 01 00
								06 01 00 00 00 00 01 0E 01 00
								06 01 00 00 00 00 01 EA 08 00];

			samsung,panel-ldi-fps-write-cmds = [
								29 01 00 00 00 00 02 B0 1A    /* Global Para. (27para) */
								29 01 00 00 00 00 02 D7 00];

			samsung,panel-ldi-fps-read-cmds = [
								06 01 00 00 00 00 01 D7 01 1A]; /* read D7 27th , 27=0x1B*/
			samsung,panel-ldi-partial-disp-on = [	
								29 01 00 00 00 00 05 30 00 C8 03 20
								29 01 00 00 00 00 02 12 00 ];
			samsung,panel-ldi-partial-disp-off = [29 01 00 00 00 00 02 13 00];

			qcom,panel-display-on-cmds	= [05 01 00 00 32 00 02 29 00];
			qcom,panel-display-off-cmds	= [05 01 00 00 32 00 02 28 00];

			samsung,panel-elvss-lowtemp-cmds-list = [
								29 01 00 00 00 00 02 B0 07
								29 01 00 00 00 00 02 B8 00];	/* Low Temperature Command */

			samsung,panel-elvss-lowtemp2-cmds-list = [
								29 01 00 00 00 00 02 B0 14
								29 01 00 00 00 00 02 B6 00];	/* Low Temperature Command: default */

			samsung,panel-gamma-cmds-list = [
					29 01 00 00 00 00 24            /* Brightness Condition Set - Gamma 2.2 Setting*/
						CA 01 00 01 00 01 00 80
						80 80 80 80 80 80 80 80
						80 80 80 80 80 80 80 80
						80 80 80 80 80 80 80 00
						00 00 00 00
					29 01 00 00 00 00 02 F7 03		/* Gamma, LTPS(AID) update */
				];

			samsung,panel-hbm-cmds-list = [
					29 01 00 00 00 00 03 B6 8C 0A		/* ELVSS Setting */
					29 01 00 00 00 00 02 53 C0		/* HBM on*/
				];

			samsung,panel-hbm-off-cmds = [
					29 01 00 00 00 00 02 53 00		/* HBM off*/
				];

			/*
			 * ************************************************************************************************************************
			 * AID command list and mappings
			 * ************************************************************************************************************************
			 */
			samsung,panel-aid-cmds-revA-list = [
				29 01 00 00 00 00 05 B2 E9 90 03 10 /* 0  samsung_brightness_aor_98.49cd_2 */
				29 01 00 00 00 00 05 B2 D5 90 03 10 /* 1  samsung_brightness_aor_97.71cd_3 */
				29 01 00 00 00 00 05 B2 C1 90 03 10 /* 2  samsung_brightness_aor_96.93cd_4*/
				29 01 00 00 00 00 05 B2 AD 90 03 10 /* 3  samsung_brightness_aor_96.16cd_5*/
				29 01 00 00 00 00 05 B2 99 90 03 10 /* 4  samsung_brightness_aor_95.38cd_6*/
				29 01 00 00 00 00 05 B2 85 90 03 10 /* 5  samsung_brightness_aor_94.60cd_7*/
				29 01 00 00 00 00 05 B2 71 90 03 10 /* 6  samsung_brightness_aor_93.83cd_8*/
				29 01 00 00 00 00 05 B2 5D 90 03 10 /* 7  samsung_brightness_aor_93.05cd_9*/
				29 01 00 00 00 00 05 B2 49 90 03 10 /* 8  samsung_brightness_aor_92.27cd_10*/
				29 01 00 00 00 00 05 B2 35 90 03 10 /* 9  samsung_brightness_aor_91.50cd_11*/
				29 01 00 00 00 00 05 B2 20 90 03 10 /* 10 samsung_brightness_aor_90.68cd_12*/
				29 01 00 00 00 00 05 B2 0C 90 03 10 /* 11 samsung_brightness_aor_89.91cd_13*/
				29 01 00 00 00 00 05 B2 F9 80 03 10 /* 12 samsung_brightness_aor_89.17cd_14*/
				29 01 00 00 00 00 05 B2 E4 80 03 10 /* 13 samsung_brightness_aor_88.35cd_15*/
				29 01 00 00 00 00 05 B2 CF 80 03 10 /* 14 samsung_brightness_aor_87.54cd_16*/
				29 01 00 00 00 00 05 B2 BB 80 03 10 /* 15 samsung_brightness_aor_86.76cd_17*/
				29 01 00 00 00 00 05 B2 90 80 03 10 /* 16 samsung_brightness_aor_85.09cd_19*/
				29 01 00 00 00 00 05 B2 7E 80 03 10 /* 17 samsung_brightness_aor_84.39cd_20*/
				29 01 00 00 00 00 05 B2 69 80 03 10 /* 18 samsung_brightness_aor_83.58cd_21*/
				29 01 00 00 00 00 05 B2 54 80 03 10 /* 19 samsung_brightness_aor_82.76cd_22*/
				29 01 00 00 00 00 05 B2 2A 80 03 10 /* 20 samsung_brightness_aor_81.13cd_24*/
				29 01 00 00 00 00 05 B2 16 80 03 10 /* 21 samsung_brightness_aor_80.36cd_25*/
				29 01 00 00 00 00 05 B2 EC 70 03 10 /* 22 samsung_brightness_aor_78.73cd_27*/
				29 01 00 00 00 00 05 B2 C3 70 03 10 /* 23 samsung_brightness_aor_77.14cd_29*/
				29 01 00 00 00 00 05 B2 AF 70 03 10 /* 24 samsung_brightness_aor_76.36cd_30*/
				29 01 00 00 00 00 05 B2 83 70 03 10 /* 25 samsung_brightness_aor_74.65cd_32*/
				29 01 00 00 00 00 05 B2 59 70 03 10 /* 26 samsung_brightness_aor_73.02cd_34*/
				29 01 00 00 00 00 05 B2 1A 70 03 10 /* 27 samsung_brightness_aor_70.57cd_37*/
				29 01 00 00 00 00 05 B2 EE 60 03 10 /* 28 samsung_brightness_aor_68.87cd_39*/
				29 01 00 00 00 00 05 B2 C3 60 03 10 /* 29 samsung_brightness_aor_67.20cd_41*/
				29 01 00 00 00 00 05 B2 82 60 03 10 /* 30 samsung_brightness_aor_64.67cd_44*/
				29 01 00 00 00 00 05 B2 42 60 03 10 /* 31 samsung_brightness_aor_62.19cd_47*/
				29 01 00 00 00 00 05 B2 01 60 03 10 /* 32 samsung_brightness_aor_59.67cd_50*/
				29 01 00 00 00 00 05 B2 BE 50 03 10 /* 33 samsung_brightness_aor_57.07cd_53*/
				29 01 00 00 00 00 05 B2 7D 50 03 10 /* 34 samsung_brightness_aor_54.54cd_56*/
				29 01 00 00 00 00 05 B2 24 50 03 10 /* 35 samsung_brightness_aor_51.09cd_60*/
				29 01 00 00 00 00 05 B2 C9 40 03 10 /* 36 samsung_brightness_aor_47.55cd_64*/
				29 01 00 00 00 00 05 B2 6C 40 03 10 /* 37 samsung_brightness_aor_43.94cd_68*/
				29 01 00 00 00 00 05 B2 06 40 03 10 /* 38 samsung_brightness_aor_39.98cd_72*/
				29 01 00 00 00 00 05 B2 06 40 03 10 /* 39 samsung_brightness_aor_39.98cd_77*/
				29 01 00 00 00 00 05 B2 06 40 03 10 /* 40 samsung_brightness_aor_39.98cd_82*/
				29 01 00 00 00 00 05 B2 06 40 03 10 /* 41 samsung_brightness_aor_39.98cd_87*/
				29 01 00 00 00 00 05 B2 06 40 03 10 /* 42 samsung_brightness_aor_39.98cd_93*/
				29 01 00 00 00 00 05 B2 06 40 03 10 /* 43 samsung_brightness_aor_39.98cd_98*/
				29 01 00 00 00 00 05 B2 06 40 03 10 /* 44 samsung_brightness_aor_39.98cd_105*/
				29 01 00 00 00 00 05 B2 06 40 03 10 /* 45 samsung_brightness_aor_39.98cd_110*/
				29 01 00 00 00 00 05 B2 06 40 03 10 /* 46 samsung_brightness_aor_39.98cd_119*/
				29 01 00 00 00 00 05 B2 06 40 03 10 /* 47 samsung_brightness_aor_39.98cd_126*/
				29 01 00 00 00 00 05 B2 06 40 03 10 /* 48 samsung_brightness_aor_39.98cd_134*/
				29 01 00 00 00 00 05 B2 06 40 03 10 /* 49 samsung_brightness_aor_39.98cd_143*/
				29 01 00 00 00 00 05 B2 06 40 03 10 /* 50 samsung_brightness_aor_39.98cd_152*/
				29 01 00 00 00 00 05 B2 06 40 03 10 /* 51 samsung_brightness_aor_39.98cd_162*/
				29 01 00 00 00 00 05 B2 06 40 03 10 /* 52 samsung_brightness_aor_39.98cd_172*/
				29 01 00 00 00 00 05 B2 AE 30 03 10 /* 53 samsung_brightness_aor_36.57cd_183*/
				29 01 00 00 00 00 05 B2 31 30 03 10 /* 54 samsung_brightness_aor_31.72cd_195*/
				29 01 00 00 00 00 05 B2 BB 20 03 10 /* 55 samsung_brightness_aor_27.14cd_207*/
				29 01 00 00 00 00 05 B2 2A 20 03 10 /* 56 samsung_brightness_aor_21.51cd_220*/
				29 01 00 00 00 00 05 B2 90 10 03 10 /* 57 samsung_brightness_aor_15.53cd_234*/
				29 01 00 00 00 00 05 B2 03 10 03 10 /* 58 samsung_brightness_aor_10.05cd_249*/
				29 01 00 00 00 00 05 B2 03 10 03 10 /* 59 samsung_brightness_aor_10.05cd_265*/
				29 01 00 00 00 00 05 B2 03 10 03 10 /* 60 samsung_brightness_aor_10.05cd_282*/
				29 01 00 00 00 00 05 B2 03 10 03 10 /* 61 samsung_brightness_aor_10.05cd_300*/
				29 01 00 00 00 00 05 B2 03 10 03 10 /* 62 samsung_brightness_aor_10.05cd_316*/
				29 01 00 00 00 00 05 B2 03 10 03 10 /* 63 samsung_brightness_aor_10.05cd_333*/
				29 01 00 00 00 00 05 B2 03 10 03 10 /* 64 samsung_brightness_aor_10.05cd_350*/
			];

			/* bl_level, Index in acl command list */
			samsung,panel-aid-map-revA-table = <
				2	0
				4	2		5	3		6	4		8	6		9	7
				10	8		12	10		13	11		15	13		16	14
				17	15		19	16		20	17		21	18		24	20
				25	21		27	22		29	23		30	24		32	25
				34	26		37	27		39	28		41	29		44	30
				47	31		50	32		53	33		56	34		60	35
				64	36		68	37		72	38		77	39		82	40
				87	41		93	42		98	43		105	44		110	45
				119	46		126	47		134	48		143	49		152	50
				162	51		172	52		183	53		195	54		207	55
				220	56		234	57		249	58		265	59		282	60
				300	61		316	62		333	63		350	64
			>;


			/*
			 * ************************************************************************************************************************
			 * ACL command list and mappings
			 * ************************************************************************************************************************
			 */
			 samsung,panel-aclcont-cmds-list = [
					29 01 00 00 00 00 02 B5 50]; /* ACL on, B5 <- 0x50 */			 

			samsung,panel-acl-cmds-list = [
					29 01 00 00 00 00 02 55 00
					29 01 00 00 00 00 02 55 01		/* ACL 30% */
					29 01 00 00 00 00 02 55 02		/* default ACL 15% */
					29 01 00 00 00 00 02 55 03];	/* ACL 50% */

			samsung,panel-acl-off-cmds = [
								29 01 00 00 00 00 02 B5 40   /* ACL OFF - 40 (16Frame Averaging) */
								29 01 00 00 00 00 02 55 00];/*off, b5<-0x40*/
					
			/* bl_level , Index in acl command list */
			samsung,panel-acl-map-table =  <
					2    2
					4    2	5    2	6   2		8   2		9   2
					10   2	12   2	13   2	15   2	16   2
					17   2	19   2	20   2	21   2	24   2
					25   2	27   2	29   2	30   2	32   2
					34   2	37   2	39   2	41   2	44   2
					47   2	50   2	53   2	56   2	60   2
					64   2	68   2	72   2	77   2	 82   2
					87   2	93   2	98   2	105  2	110  2
					119  2	126  2	134  2	143  2	152  2
					162  2	172  2	183  2	195  2	207  2
					220  2	234  2	249  2	265  2	282  2
					300  2	316  2	333  2	350  2
				>;
			/*
			 * ************************************************************************************************************************
			 * ELVSS(ACL Off) command list and mappings
			 * ************************************************************************************************************************
			 */
			samsung,panel-elvss-cmds-list = [
				29 01 00 00 00 00 03 b6 8C 16 /* 0 */
				29 01 00 00 00 00 03 b6 8C 16 /* 1 */
				29 01 00 00 00 00 03 b6 8C 15 /* 2 */
				29 01 00 00 00 00 03 b6 8C 15 /* 3 */
				29 01 00 00 00 00 03 b6 8C 15 /* 4 */
				29 01 00 00 00 00 03 b6 8C 15 /* 5 */
				29 01 00 00 00 00 03 b6 8C 14 /* 6 */
				29 01 00 00 00 00 03 b6 8C 14 /* 7 */
				29 01 00 00 00 00 03 b6 8C 14 /* 8 */
				29 01 00 00 00 00 03 b6 8C 13 /* 9 */
				29 01 00 00 00 00 03 b6 8C 13 /* 10 */
				29 01 00 00 00 00 03 b6 8C 13 /* 11 */
				29 01 00 00 00 00 03 b6 8C 12 /* 12 */
				29 01 00 00 00 00 03 b6 8C 12 /* 13 */
				29 01 00 00 00 00 03 b6 8C 0F /* 14 */
				29 01 00 00 00 00 03 b6 8C 0F /* 15 */
				29 01 00 00 00 00 03 b6 8C 0E /* 16 */
				29 01 00 00 00 00 03 b6 8C 0E /* 17 */
				29 01 00 00 00 00 03 b6 8C 0E /* 18 */
				29 01 00 00 00 00 03 b6 8C 0D /* 19 */
				29 01 00 00 00 00 03 b6 8C 0D /* 20 */
				29 01 00 00 00 00 03 b6 8C 0C /* 21 */
				29 01 00 00 00 00 03 b6 8C 0C /* 22 */
				29 01 00 00 00 00 03 b6 8C 0B /* 23 */
				29 01 00 00 00 00 03 b6 8C 0B /* 24 */
				29 01 00 00 00 00 03 b6 8C 0A /* 25 */
			];

			/*
			 * ************************************************************************************************************************
			 * SMART ACL(ACL On) ELVSS command list and mappings
			 * ************************************************************************************************************************
			 */
			samsung,panel-smart-acl-elvss-cmds-list = [
				29 01 00 00 00 00 03 b6 8C 16 /* 0 */
				29 01 00 00 00 00 03 b6 8C 16 /* 1 */
				29 01 00 00 00 00 03 b6 8C 15 /* 2 */
				29 01 00 00 00 00 03 b6 8C 15 /* 3 */
				29 01 00 00 00 00 03 b6 8C 15 /* 4 */
				29 01 00 00 00 00 03 b6 8C 15 /* 5 */
				29 01 00 00 00 00 03 b6 8C 14 /* 6 */
				29 01 00 00 00 00 03 b6 8C 14 /* 7 */
				29 01 00 00 00 00 03 b6 8C 14 /* 8 */
				29 01 00 00 00 00 03 b6 8C 13 /* 9 */
				29 01 00 00 00 00 03 b6 8C 13 /* 10 */
				29 01 00 00 00 00 03 b6 8C 13 /* 11 */
				29 01 00 00 00 00 03 b6 8C 12 /* 12 */
				29 01 00 00 00 00 03 b6 8C 12 /* 13 */
				29 01 00 00 00 00 03 b6 8C 0F /* 14 */
				29 01 00 00 00 00 03 b6 8C 0F /* 15 */
				29 01 00 00 00 00 03 b6 8C 0E /* 16 */
				29 01 00 00 00 00 03 b6 8C 0E /* 17 */
				29 01 00 00 00 00 03 b6 8C 0E /* 18 */
				29 01 00 00 00 00 03 b6 8C 0D /* 19 */
				29 01 00 00 00 00 03 b6 8C 0D /* 20 */
				29 01 00 00 00 00 03 b6 8C 0C /* 21 */
				29 01 00 00 00 00 03 b6 8C 0C /* 22 */
				29 01 00 00 00 00 03 b6 8C 0B /* 23 */
				29 01 00 00 00 00 03 b6 8C 0B /* 24 */
				29 01 00 00 00 00 03 b6 8C 0A /* 25 */
			];

			/* bl_level, Index in elvss command list */
			samsung,panel-smart-acl-elvss-map-table = <
					2    0
					4    0	5    0		6   0            8   0       9   0
					10   0      12   0		13   0		15   0	16   0
					17   0	19   0		20   0		21   0      24   0
					25   0      27   0		29   0		30   0	32   0
					34   0      37   0		39   0		41   0	44   0
					47  0      50   0		53   0		56   0	60   0
					64   0      68   0		72   0		77   0	82   1
					87   2      93   3		98   4		105  5	110  6
					119  7      126  8		134  9		143  10	152  11
					162  12     172  13		183  14		195  15	207  16
					220  17     234  18		249  19		265  20	282  21
					300  22	  316  23		333	 24		350  25
					>;
			/*
			 * ************************************************************************************************************************
			 * candela to index mappings
			 * ************************************************************************************************************************
			 */
			samsung,panel-candella-mapping-table = <
			/*<idx><PMSL range> <candella> *//*linear map*/
				0	2	2	2
				1	3	3	4
				2	4	4	5
				3	5	5	6
				4	6	6	8
				5	7	7	9
				6	8	8	10
				7	9	9	12
				8	10	10	13
				9	11	11	15
				10	12	12	16
				11	13	13	17
				12	14	14	19
				13	15	15	20
				14	16	16	21
				15	17	17	24
				16	18	18	25
				17	19	19	27
				18	20	21	29
				19	22	23	30
				20	24	24	32
				21	25	26	34
				22	27	28	37
				23	29	29	39
				24	30	32	41
				25	33	34	44
				26	35	36	47
				27	37	38	50
				28	39	40	53
				29	41	43	56
				30	44	46	60
				31	47	49	64
				32	50	52	68
				33	53	56	72
				34	57	59	77
				35	60	63	82
				36	64	67	87
				37	68	71	93
				38	72	76	98
				39	77	80	105
				40	81	86	110
				41	87	91	119
				42	92	97	126
				43	98	104	134
				44	105	110	143
				45	111	118	152
				46	119	125	162
				47	126	133	172
				48	134	142	183
				49	143	150	195
				50	151	160	207
				51	161	170	220
				52	171	181	234
				53	182	193	249
				54	194	205	265
				55	206	218	282
				56	219	230	300
				57	231	242	316
				58	243	254	333
				59	255	255	350
				>;
	};

	dsi_dual_samsung_cmd_S6E3HA2X01_1: wqhd_cmd1{
		qcom,mdss-dsi-panel-name = "samsung,mdss-amoled-dual_dsi-panel";
		label = "samsung amoled wqhd command mode dsi1 S6E3HA2X01 panel";
		status = "disable";

		qcom,mdss-dsi-panel-controller = <&mdss_dsi1>;
		qcom,mdss-dsi-panel-type = "dsi_cmd_mode";
		qcom,mdss-pan-dest = "display_2";

		qcom,enable-gpio = <&pma8084_gpios 6 0>;
		qcom,rst-gpio = <&pma8084_gpios 21 0>;
		qcom,te-gpio = <&msmgpio 12 0>;

		qcom,cont-splash-enabled;
		qcom,partial-update-enabled;
		qcom,partial-update-roi-merge;
		qcom,mdss-dsi-panel-broadcast-mode; 
		qcom,panel-roi-alignment = <8 8 1 1 1 2>;

		qcom,mdss-pan-res = <720 2560>;
		qcom,mdss-pan-size = <65 115>; /* <Width> <Height> real size of panel in mm */
		qcom,mdss-pan-bpp = <24>;

		qcom,mdss-clk-rate=<898000000>;

		qcom,mdss-vsync-enable=<1>;
		qcom,mdss-hw-vsync-mode=<1>;
		qcom,mdss-pan-insert-dcs-cmd=<1>;
		qcom,mdss-pan-wr-mem-continue=<0x3c>;
		qcom,mdss-pan-wr-mem-start=<0x2c>;
		qcom,mdss-pan-te-sel=<1>;
		qcom,mdss-pan-clk-rate=<898000000>;

		qcom,mdss-pan-porch-values = <108 15 212 4 2 10>; /* <HBP> <HPW> <HFP> <VBP> <VPW> <VFP> */

		qcom,mdss-pan-underflow-clr = <0xff>;
		qcom,mdss-pan-bl-ctrl = "bl_ctrl_dcs_cmds";
		qcom,mdss-pan-bl-levels = <1 255>;
		qcom,mdss-pan-dsi-mode = <1>;
		qcom,mdss-pan-dsi-h-pulse-mode = <0>;
		qcom,mdss-pan-dsi-h-power-stop = <0 0 0>;
		qcom,mdss-pan-dsi-bllp-power-stop = <1 1>;
		qcom,mdss-pan-dsi-traffic-mode = <2>;
		qcom,mdss-pan-dsi-dst-format = <8>;
		qcom,mdss-pan-dsi-vc = <0>;
		qcom,mdss-pan-dsi-rgb-swap = <0>;
		qcom,mdss-force-clk-lane-hs = <0>;
		samsung,mdss-early-lcd-on = <1>;
		qcom,mdss-pan-dsi-data-lanes = <1 1 1 1>;
		qcom,mdss-pan-dsi-dlane-swap = <0>;
		qcom,mdss-pan-dsi-t-clk = <0x30 0x04>;
		qcom,mdss-pan-dsi-stream = <0>;
		qcom,mdss-pan-dsi-mdp-tr = <0x0>;
		qcom,mdss-pan-dsi-dma-tr = <0x04>;
		qcom,mdss-pan-dsi-tx-eot-append = <1>;
		qcom,mdss-pan-dsi-frame-rate = <60>;
		qcom,panel-phy-regulatorSettings = [07 09 03 00  /* Regualotor settings */
						    20 00 01];
		qcom,panel-phy-timingSettings = [FA 4B 41 00 66 81 34 4C 41 03 04 A0];

		qcom,panel-phy-strengthCtrl = [ff 06];		/*!!!! */
		qcom,panel-phy-bistCtrl = [00 00 b1 ff 
                                              00 00];   /*!!!! BIST Ctrl settings */
		qcom,panel-phy-laneConfig = [
			00 00 00 00 00 00 00 01 97 /* lane0 config */
			00 00 00 00 05 00 00 01 97 /* lane1 config */
			00 00 00 00 0a 00 00 01 97 /* lane2 config */
			00 00 00 00 0f 00 00 01 97 /* lane3 config */
			00 c0 00 00 00 00 00 01 bb]; /* Clk ln config */

		qcom,mdss-dsi-on-command = [
				
				05 01 00 00 05 00 02 11 00 			/* Sleep out, wait 120ms(0x78) */

				29 01 00 00 00 00 03 F0 5A 5A 		/* TEST KEY Enable */
				29 01 00 00 78 00 03 F2 63 41		/* DUAL DSI */

				05 01 00 00 00 00 02 35 00			/* TE Vsync ON */
				29 01 00 00 00 00 07 BD 30 22 02 16 02 16 /*TSP TE*/
				29 01 00 00 00 00 05 C0 30 00 D8 D8	/* Pentile setting */

				29 01 00 00 00 00 24				/* Brightness condition set */
					CA 
					01 00 01 00 01 00 
					80 80 80
					80 80 80
					80 80 80
					80 80 80
					80 80 80
					80 80 80
					80 80 80
					80 80 80
					00 00 00
					00 00
				29 01 00 00 00 00 03 B2 03 10		/* AID 10% */
				29 01 00 00 00 00 03 B6 8C 0A		/* ELVSS Setting */
				29 01 00 00 00 00 02 F7 03		/* Gamma, LTPS(AID) update */

				29 01 00 00 00 00 03 F0 A5 A5		/* TEST KEY key Disable  */
			];
		qcom,mdss-dsi-on-command-state = "dsi_lp_mode";
		qcom,mdss-dsi-off-command = [
				05 01 00 00 0A 00 02 28 00			/* wait 10ms(0x0A) */
				05 01 00 00 78 00 02 10 00			/* wait 120ms(0x78) */
		];
		qcom,mdss-dsi-off-command-state = "dsi_hs_mode";
		/*
			the last byte in read commands  represent READ LENGH,
			like below  READ LENGH = 0x21
		 */
		 	samsung,panel-test-key-enable-cmds 	= [ 29 01 00 00 00 00 03 F0 5A 5A];
		 	samsung,panel-test-key-disable-cmds = [ 29 01 00 00 00 00 03 F0 A5 A5];

			samsung,panel-nv-mtp-read-cmds		= [ 06 01 00 00 00 00 01 c8 23 00];

			samsung,panel-nv-mdnie-read-cmds	= [ 06 01 00 00 00 00 01 A1 04 00];
			samsung,panel-nv-mtp-read-elvss-cmds	= [ 06 01 00 00 00 00 01 b6 01 14];	/* read C6 21th , 20=0x14*/
			samsung,panel-nv-read-cmds			= [ 06 01 00 00 00 00 01 c8 21 00];
			samsung,panel-nv-read-enable-cmds = [
								29 01 00 00 00 00 03 f0 5a 5a
								29 01 00 00 00 00 03 F2 63 41];		/* DUAL DSI */
			samsung,panel-nv-read-disable-cmds = [ 29 01 00 00 00 00 03 f0 a5 a5 ];

			/* the last byte in all read commands will represent READ LENGH */
			samsung,panel-manufacture-id-read-cmds = [
								06 01 00 00 00 00 01 da 01 00
								06 01 00 00 00 00 01 db 01 00
								06 01 00 00 00 00 01 dc 01 00];

			samsung,panel-manufacture-date-read-cmds = [ 06 01 00 00 00 00 01 c8 02 28];	/* read C8 41~42th , 40=0x28*/

			samsung,panel-ddi-id-read-cmds = [ 06 01 00 00 00 00 01 d6 05 00];	/* read D6 1~5th */
	
			samsung,panel-ldi-debug-read-cmds = [
								06 01 00 00 00 00 01 0A 01 00
								06 01 00 00 00 00 01 0E 01 00
								06 01 00 00 00 00 01 EA 08 00];

			samsung,panel-ldi-fps-write-cmds = [
								29 01 00 00 00 00 02 B0 1A    /* Global Para. (27para) */
								29 01 00 00 00 00 02 D7 00];

			samsung,panel-ldi-fps-read-cmds = [
								06 01 00 00 00 00 01 D7 01 1A]; /* read D7 27th , 27=0x1B*/
			samsung,panel-ldi-partial-disp-on = [	
								29 01 00 00 00 00 05 30 00 C8 03 20
								29 01 00 00 00 00 02 12 00 ];
			samsung,panel-ldi-partial-disp-off = [29 01 00 00 00 00 02 13 00];

			qcom,panel-display-on-cmds	= [05 01 00 00 32 00 02 29 00];
			qcom,panel-display-off-cmds	= [05 01 00 00 32 00 02 28 00];

			samsung,panel-elvss-lowtemp-cmds-list = [
								29 01 00 00 00 00 02 B0 07
								29 01 00 00 00 00 02 B8 00];	/* Low Temperature Command */

			samsung,panel-elvss-lowtemp2-cmds-list = [
								29 01 00 00 00 00 02 B0 14
								29 01 00 00 00 00 02 B6 00];	/* Low Temperature Command: default */

			samsung,panel-gamma-cmds-list = [
					29 01 00 00 00 00 24            /* Brightness Condition Set - Gamma 2.2 Setting*/
						CA 01 00 01 00 01 00 80
						80 80 80 80 80 80 80 80
						80 80 80 80 80 80 80 80
						80 80 80 80 80 80 80 00
						00 00 00 00
					29 01 00 00 00 00 02 F7 03		/* Gamma, LTPS(AID) update */
				];

			samsung,panel-hbm-cmds-list = [
					29 01 00 00 00 00 03 B6 8C 0A		/* ELVSS Setting */
					29 01 00 00 00 00 02 53 C0		/* HBM on*/
				];

			samsung,panel-hbm-off-cmds = [
					29 01 00 00 00 00 02 53 00		/* HBM off*/
				];

			/*
			 * ************************************************************************************************************************
			 * AID command list and mappings
			 * ************************************************************************************************************************
			 */
			samsung,panel-aid-cmds-revA-list = [
				29 01 00 00 00 00 05 B2 E9 90 03 10 /* 0  samsung_brightness_aor_98.49cd_2 */
				29 01 00 00 00 00 05 B2 D5 90 03 10 /* 1  samsung_brightness_aor_97.71cd_3 */
				29 01 00 00 00 00 05 B2 C1 90 03 10 /* 2  samsung_brightness_aor_96.93cd_4*/
				29 01 00 00 00 00 05 B2 AD 90 03 10 /* 3  samsung_brightness_aor_96.16cd_5*/
				29 01 00 00 00 00 05 B2 99 90 03 10 /* 4  samsung_brightness_aor_95.38cd_6*/
				29 01 00 00 00 00 05 B2 85 90 03 10 /* 5  samsung_brightness_aor_94.60cd_7*/
				29 01 00 00 00 00 05 B2 71 90 03 10 /* 6  samsung_brightness_aor_93.83cd_8*/
				29 01 00 00 00 00 05 B2 5D 90 03 10 /* 7  samsung_brightness_aor_93.05cd_9*/
				29 01 00 00 00 00 05 B2 49 90 03 10 /* 8  samsung_brightness_aor_92.27cd_10*/
				29 01 00 00 00 00 05 B2 35 90 03 10 /* 9  samsung_brightness_aor_91.50cd_11*/
				29 01 00 00 00 00 05 B2 20 90 03 10 /* 10 samsung_brightness_aor_90.68cd_12*/
				29 01 00 00 00 00 05 B2 0C 90 03 10 /* 11 samsung_brightness_aor_89.91cd_13*/
				29 01 00 00 00 00 05 B2 F9 80 03 10 /* 12 samsung_brightness_aor_89.17cd_14*/
				29 01 00 00 00 00 05 B2 E4 80 03 10 /* 13 samsung_brightness_aor_88.35cd_15*/
				29 01 00 00 00 00 05 B2 CF 80 03 10 /* 14 samsung_brightness_aor_87.54cd_16*/
				29 01 00 00 00 00 05 B2 BB 80 03 10 /* 15 samsung_brightness_aor_86.76cd_17*/
				29 01 00 00 00 00 05 B2 90 80 03 10 /* 16 samsung_brightness_aor_85.09cd_19*/
				29 01 00 00 00 00 05 B2 7E 80 03 10 /* 17 samsung_brightness_aor_84.39cd_20*/
				29 01 00 00 00 00 05 B2 69 80 03 10 /* 18 samsung_brightness_aor_83.58cd_21*/
				29 01 00 00 00 00 05 B2 54 80 03 10 /* 19 samsung_brightness_aor_82.76cd_22*/
				29 01 00 00 00 00 05 B2 2A 80 03 10 /* 20 samsung_brightness_aor_81.13cd_24*/
				29 01 00 00 00 00 05 B2 16 80 03 10 /* 21 samsung_brightness_aor_80.36cd_25*/
				29 01 00 00 00 00 05 B2 EC 70 03 10 /* 22 samsung_brightness_aor_78.73cd_27*/
				29 01 00 00 00 00 05 B2 C3 70 03 10 /* 23 samsung_brightness_aor_77.14cd_29*/
				29 01 00 00 00 00 05 B2 AF 70 03 10 /* 24 samsung_brightness_aor_76.36cd_30*/
				29 01 00 00 00 00 05 B2 83 70 03 10 /* 25 samsung_brightness_aor_74.65cd_32*/
				29 01 00 00 00 00 05 B2 59 70 03 10 /* 26 samsung_brightness_aor_73.02cd_34*/
				29 01 00 00 00 00 05 B2 1A 70 03 10 /* 27 samsung_brightness_aor_70.57cd_37*/
				29 01 00 00 00 00 05 B2 EE 60 03 10 /* 28 samsung_brightness_aor_68.87cd_39*/
				29 01 00 00 00 00 05 B2 C3 60 03 10 /* 29 samsung_brightness_aor_67.20cd_41*/
				29 01 00 00 00 00 05 B2 82 60 03 10 /* 30 samsung_brightness_aor_64.67cd_44*/
				29 01 00 00 00 00 05 B2 42 60 03 10 /* 31 samsung_brightness_aor_62.19cd_47*/
				29 01 00 00 00 00 05 B2 01 60 03 10 /* 32 samsung_brightness_aor_59.67cd_50*/
				29 01 00 00 00 00 05 B2 BE 50 03 10 /* 33 samsung_brightness_aor_57.07cd_53*/
				29 01 00 00 00 00 05 B2 7D 50 03 10 /* 34 samsung_brightness_aor_54.54cd_56*/
				29 01 00 00 00 00 05 B2 24 50 03 10 /* 35 samsung_brightness_aor_51.09cd_60*/
				29 01 00 00 00 00 05 B2 C9 40 03 10 /* 36 samsung_brightness_aor_47.55cd_64*/
				29 01 00 00 00 00 05 B2 6C 40 03 10 /* 37 samsung_brightness_aor_43.94cd_68*/
				29 01 00 00 00 00 05 B2 06 40 03 10 /* 38 samsung_brightness_aor_39.98cd_72*/
				29 01 00 00 00 00 05 B2 06 40 03 10 /* 39 samsung_brightness_aor_39.98cd_77*/
				29 01 00 00 00 00 05 B2 06 40 03 10 /* 40 samsung_brightness_aor_39.98cd_82*/
				29 01 00 00 00 00 05 B2 06 40 03 10 /* 41 samsung_brightness_aor_39.98cd_87*/
				29 01 00 00 00 00 05 B2 06 40 03 10 /* 42 samsung_brightness_aor_39.98cd_93*/
				29 01 00 00 00 00 05 B2 06 40 03 10 /* 43 samsung_brightness_aor_39.98cd_98*/
				29 01 00 00 00 00 05 B2 06 40 03 10 /* 44 samsung_brightness_aor_39.98cd_105*/
				29 01 00 00 00 00 05 B2 06 40 03 10 /* 45 samsung_brightness_aor_39.98cd_110*/
				29 01 00 00 00 00 05 B2 06 40 03 10 /* 46 samsung_brightness_aor_39.98cd_119*/
				29 01 00 00 00 00 05 B2 06 40 03 10 /* 47 samsung_brightness_aor_39.98cd_126*/
				29 01 00 00 00 00 05 B2 06 40 03 10 /* 48 samsung_brightness_aor_39.98cd_134*/
				29 01 00 00 00 00 05 B2 06 40 03 10 /* 49 samsung_brightness_aor_39.98cd_143*/
				29 01 00 00 00 00 05 B2 06 40 03 10 /* 50 samsung_brightness_aor_39.98cd_152*/
				29 01 00 00 00 00 05 B2 06 40 03 10 /* 51 samsung_brightness_aor_39.98cd_162*/
				29 01 00 00 00 00 05 B2 06 40 03 10 /* 52 samsung_brightness_aor_39.98cd_172*/
				29 01 00 00 00 00 05 B2 AE 30 03 10 /* 53 samsung_brightness_aor_36.57cd_183*/
				29 01 00 00 00 00 05 B2 31 30 03 10 /* 54 samsung_brightness_aor_31.72cd_195*/
				29 01 00 00 00 00 05 B2 BB 20 03 10 /* 55 samsung_brightness_aor_27.14cd_207*/
				29 01 00 00 00 00 05 B2 2A 20 03 10 /* 56 samsung_brightness_aor_21.51cd_220*/
				29 01 00 00 00 00 05 B2 90 10 03 10 /* 57 samsung_brightness_aor_15.53cd_234*/
				29 01 00 00 00 00 05 B2 03 10 03 10 /* 58 samsung_brightness_aor_10.05cd_249*/
				29 01 00 00 00 00 05 B2 03 10 03 10 /* 59 samsung_brightness_aor_10.05cd_265*/
				29 01 00 00 00 00 05 B2 03 10 03 10 /* 60 samsung_brightness_aor_10.05cd_282*/
				29 01 00 00 00 00 05 B2 03 10 03 10 /* 61 samsung_brightness_aor_10.05cd_300*/
				29 01 00 00 00 00 05 B2 03 10 03 10 /* 62 samsung_brightness_aor_10.05cd_316*/
				29 01 00 00 00 00 05 B2 03 10 03 10 /* 63 samsung_brightness_aor_10.05cd_333*/
				29 01 00 00 00 00 05 B2 03 10 03 10 /* 64 samsung_brightness_aor_10.05cd_350*/
			];

			/* bl_level, Index in acl command list */
			samsung,panel-aid-map-revA-table = <
				2	0
				4	2		5	3		6	4		8	6		9	7
				10	8		12	10		13	11		15	13		16	14
				17	15		19	16		20	17		21	18		24	20
				25	21		27	22		29	23		30	24		32	25
				34	26		37	27		39	28		41	29		44	30
				47	31		50	32		53	33		56	34		60	35
				64	36		68	37		72	38		77	39		82	40
				87	41		93	42		98	43		105	44		110	45
				119	46		126	47		134	48		143	49		152	50
				162	51		172	52		183	53		195	54		207	55
				220	56		234	57		249	58		265	59		282	60
				300	61		316	62		333	63		350	64
			>;


			/*
			 * ************************************************************************************************************************
			 * ACL command list and mappings
			 * ************************************************************************************************************************
			 */
			 samsung,panel-aclcont-cmds-list = [
					29 01 00 00 00 00 02 B5 50]; /* ACL on, B5 <- 0x50 */			 

			samsung,panel-acl-cmds-list = [
					29 01 00 00 00 00 02 55 00
					29 01 00 00 00 00 02 55 01		/* ACL 30% */
					29 01 00 00 00 00 02 55 02		/* default ACL 15% */
					29 01 00 00 00 00 02 55 03];	/* ACL 50% */

			samsung,panel-acl-off-cmds = [
								29 01 00 00 00 00 02 B5 40   /* ACL OFF - 40 (16Frame Averaging) */
								29 01 00 00 00 00 02 55 00];/*off, b5<-0x40*/

			/* bl_level , Index in acl command list */
			samsung,panel-acl-map-table =  <
					2    2
					4    2	5    2	6   2		8   2		9   2
					10   2	12   2	13   2	15   2	16   2
					17   2	19   2	20   2	21   2	24   2
					25   2	27   2	29   2	30   2	32   2
					34   2	37   2	39   2	41   2	44   2
					47   2	50   2	53   2	56   2	60   2
					64   2	68   2	72   2	77   2	 82   2
					87   2	93   2	98   2	105  2	110  2
					119  2	126  2	134  2	143  2	152  2
					162  2	172  2	183  2	195  2	207  2
					220  2	234  2	249  2	265  2	282  2
					300  2	316  2	333  2	350  2
				>;
			/*
			 * ************************************************************************************************************************
			 * ELVSS(ACL Off) command list and mappings
			 * ************************************************************************************************************************
			 */
			samsung,panel-elvss-cmds-list = [
				29 01 00 00 00 00 03 b6 8C 16 /* 0 */
				29 01 00 00 00 00 03 b6 8C 16 /* 1 */
				29 01 00 00 00 00 03 b6 8C 15 /* 2 */
				29 01 00 00 00 00 03 b6 8C 15 /* 3 */
				29 01 00 00 00 00 03 b6 8C 15 /* 4 */
				29 01 00 00 00 00 03 b6 8C 15 /* 5 */
				29 01 00 00 00 00 03 b6 8C 14 /* 6 */
				29 01 00 00 00 00 03 b6 8C 14 /* 7 */
				29 01 00 00 00 00 03 b6 8C 14 /* 8 */
				29 01 00 00 00 00 03 b6 8C 13 /* 9 */
				29 01 00 00 00 00 03 b6 8C 13 /* 10 */
				29 01 00 00 00 00 03 b6 8C 13 /* 11 */
				29 01 00 00 00 00 03 b6 8C 12 /* 12 */
				29 01 00 00 00 00 03 b6 8C 12 /* 13 */
				29 01 00 00 00 00 03 b6 8C 0F /* 14 */
				29 01 00 00 00 00 03 b6 8C 0F /* 15 */
				29 01 00 00 00 00 03 b6 8C 0E /* 16 */
				29 01 00 00 00 00 03 b6 8C 0E /* 17 */
				29 01 00 00 00 00 03 b6 8C 0E /* 18 */
				29 01 00 00 00 00 03 b6 8C 0D /* 19 */
				29 01 00 00 00 00 03 b6 8C 0D /* 20 */
				29 01 00 00 00 00 03 b6 8C 0C /* 21 */
				29 01 00 00 00 00 03 b6 8C 0C /* 22 */
				29 01 00 00 00 00 03 b6 8C 0B /* 23 */
				29 01 00 00 00 00 03 b6 8C 0B /* 24 */
				29 01 00 00 00 00 03 b6 8C 0A /* 25 */
			];

			/*
			 * ************************************************************************************************************************
			 * SMART ACL(ACL On) ELVSS command list and mappings
			 * ************************************************************************************************************************
			 */
			samsung,panel-smart-acl-elvss-cmds-list = [
				29 01 00 00 00 00 03 b6 8C 16 /* 0 */
				29 01 00 00 00 00 03 b6 8C 16 /* 1 */
				29 01 00 00 00 00 03 b6 8C 15 /* 2 */
				29 01 00 00 00 00 03 b6 8C 15 /* 3 */
				29 01 00 00 00 00 03 b6 8C 15 /* 4 */
				29 01 00 00 00 00 03 b6 8C 15 /* 5 */
				29 01 00 00 00 00 03 b6 8C 14 /* 6 */
				29 01 00 00 00 00 03 b6 8C 14 /* 7 */
				29 01 00 00 00 00 03 b6 8C 14 /* 8 */
				29 01 00 00 00 00 03 b6 8C 13 /* 9 */
				29 01 00 00 00 00 03 b6 8C 13 /* 10 */
				29 01 00 00 00 00 03 b6 8C 13 /* 11 */
				29 01 00 00 00 00 03 b6 8C 12 /* 12 */
				29 01 00 00 00 00 03 b6 8C 12 /* 13 */
				29 01 00 00 00 00 03 b6 8C 0F /* 14 */
				29 01 00 00 00 00 03 b6 8C 0F /* 15 */
				29 01 00 00 00 00 03 b6 8C 0E /* 16 */
				29 01 00 00 00 00 03 b6 8C 0E /* 17 */
				29 01 00 00 00 00 03 b6 8C 0E /* 18 */
				29 01 00 00 00 00 03 b6 8C 0D /* 19 */
				29 01 00 00 00 00 03 b6 8C 0D /* 20 */
				29 01 00 00 00 00 03 b6 8C 0C /* 21 */
				29 01 00 00 00 00 03 b6 8C 0C /* 22 */
				29 01 00 00 00 00 03 b6 8C 0B /* 23 */
				29 01 00 00 00 00 03 b6 8C 0B /* 24 */
				29 01 00 00 00 00 03 b6 8C 0A /* 25 */
			];

			/* bl_level, Index in elvss command list */
			samsung,panel-smart-acl-elvss-map-table = <
					2    0
					4    0	5    0		6   0            8   0       9   0
					10   0      12   0		13   0		15   0	16   0
					17   0	19   0		20   0		21   0      24   0
					25   0      27   0		29   0		30   0	32   0
					34   0      37   0		39   0		41   0	44   0
					47  0      50   0		53   0		56   0	60   0
					64   0      68   0		72   0		77   0	82   1
					87   2      93   3		98   4		105  5	110  6
					119  7      126  8		134  9		143  10	152  11
					162  12     172  13		183  14		195  15	207  16
					220  17     234  18		249  19		265  20	282  21
					300  22	  316  23		333	 24		350  25
					>;
			/*
			 * ************************************************************************************************************************
			 * candela to index mappings
			 * ************************************************************************************************************************
			 */
			samsung,panel-candella-mapping-table = <
			/*<idx><PMSL range> <candella> *//*linear map*/
				0	2	2	2
				1	3	3	4
				2	4	4	5
				3	5	5	6
				4	6	6	8
				5	7	7	9
				6	8	8	10
				7	9	9	12
				8	10	10	13
				9	11	11	15
				10	12	12	16
				11	13	13	17
				12	14	14	19
				13	15	15	20
				14	16	16	21
				15	17	17	24
				16	18	18	25
				17	19	19	27
				18	20	21	29
				19	22	23	30
				20	24	24	32
				21	25	26	34
				22	27	28	37
				23	29	29	39
				24	30	32	41
				25	33	34	44
				26	35	36	47
				27	37	38	50
				28	39	40	53
				29	41	43	56
				30	44	46	60
				31	47	49	64
				32	50	52	68
				33	53	56	72
				34	57	59	77
				35	60	63	82
				36	64	67	87
				37	68	71	93
				38	72	76	98
				39	77	80	105
				40	81	86	110
				41	87	91	119
				42	92	97	126
				43	98	104	134
				44	105	110	143
				45	111	118	152
				46	119	125	162
				47	126	133	172
				48	134	142	183
				49	143	150	195
				50	151	160	207
				51	161	170	220
				52	171	181	234
				53	182	193	249
				54	194	205	265
				55	206	218	282
				56	219	230	300
				57	231	242	316
				58	243	254	333
				59	255	255	350
				>;
	};
};
