
/dts-v1/;

/include/ "mt6752.dtsi"

/ {
  memory@00000000 {
		device_type = "memory";
		reg = <0 0x40000000 0 0x80000000>;
	};
	
	bus {
		compatible = "simple-bus";
		#address-cells = <1>;
		#size-cells = <1>;
		ranges = <0 0 0 0xffffffff>;
	
  };
		
	MOBICORE {
		compatible = "trustonic,mobicore";
		interrupts = <0 280 0x1>;
	};
};
