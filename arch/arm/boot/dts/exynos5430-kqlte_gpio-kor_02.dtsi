/*
 * SAMSUNG universal5430 board device tree source
 *
 * Copyright (c) 2013 Samsung Electronics Co., Ltd.
 *             http://www.samsung.com
 *
 * This program is free software; you can redistribute it and/or modify
 * it under the terms of the GNU General Public License version 2 as
 * published by the Free Software Foundation.
*/

&pinctrl_5 {
	sleep5: sleep-state {
		PIN_SLP(gpf4-2, INPUT, NONE);	/* CP_PMIC_PWR_HOLD */
	};
};
