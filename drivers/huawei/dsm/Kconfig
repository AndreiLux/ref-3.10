## drivers/huawei/dsm/Kconfig
```kconfig
#
# huawei device state monitor configuration
#

config HUAWEI_DSM
	bool "huawei dsm"
	default n
	help
	  If you say yes here you get support for huawei touchscreen.
```

## drivers/huawei/ext_modem/Kconfig
```kconfig
menu "huawei 3rdmodem linux driver"
source "drivers/huawei/ext_modem/balong/Kconfig"
source "drivers/huawei/ext_modem/viacbp82d/Kconfig"
endmenu
```

## drivers/huawei/ext_modem/balong/Kconfig
```kconfig
config BALONG_EXT_MODEM
	tristate "Balong ext modem boot control support"
    default y
    help
	  This module adds support for balong modem based on
	  Balong V3R3 chipset.
```

## drivers/huawei/gps/Kconfig
```kconfig
menuconfig BCMGPS
	tristate "Bcm4752 gps support"
	default y
	help
	  Say Y here to enable bcm4752 gps support. This allows
	  ap to control this module.
```

## drivers/huawei/inputhub/Kconfig
```kconfig
menuconfig INPUTHUB
	tristate "InputHub feature support"
	help
	  Say Y here to enable input hub feature support. This allows
	  mcu to manage all sensors.
```

## drivers/huawei/irda/Kconfig
```kconfig
config MAXQ616_POWER_SWITCH
	tristate "CONFIG_MAXQ616_POWER_SWITCH feature support"
	default y
	help
	  Say Y here to enable Infrared remote control feature support.
```

## drivers/huawei/sensor/Kconfig
```kconfig
source "drivers/huawei/sensor/hall/Kconfig"

source "drivers/huawei/sensor/fingerprint/Kconfig"
```

## drivers/huawei/sensor/fingerprint/Kconfig
```kconfig
config FINGERPRINT
	tristate "fingerprint"
	default y
	help
		If you say yes here you get support for fingerprint.
```

## drivers/huawei/sensor/hall/Kconfig
```kconfig
#
# hall sensor driver configuration
#
config HUAWEI_FEATURE_AK8789
	tristate "ak8789_hall"
	default y
	help
	  If you say yes here you get support for light hall ak8789.
```

## drivers/huawei/touchscreen/Kconfig
```kconfig
#
# huawei touchscreen driver configuration
#

config HUAWEI_TS
	bool "huawei touchscreen"
	default n
	help
	  If you say yes here you get support for huawei touchscreen.
	  
config HUAWEI_TS_TEST
	bool "huawei touchscreen test"
	default n
	help
	  If you say yes here you get support for huawei touchscreen.

source "drivers/huawei/touchscreen/panel/Kconfig"
```

## drivers/huawei/touchscreen/panel/Kconfig
```kconfig
#
# huawei touchscreen driver configuration
#

config SYNAPTICS_TS
	bool "synaptics touchscreen"
	default n
	help
	  If you say yes here you get support for synaptics touchscreen.
	  
config CYPRESS_TS
	bool "cypress touchscreen"
	default n
	help
	  If you say yes here you get support for cypress touchscreen.
```

## drivers/huawei/tp_color/Kconfig
```kconfig
#sensor unification for differ platform
menu "huawei linux device driver support package"

config HUAWEI_TP_COLOR_INFO
	bool "huawei tp color info"
	default n
	help
		get the huawei tp color information.
endmenu
```

## drivers/huawei/wifi/Kconfig
```kconfig
menu "huawei wifi linux driver"

source "drivers/huawei/wifi/driver/Kconfig"
endmenu
```

## drivers/huawei/wifi/driver/Kconfig
```kconfig
menu "huawei wifi linux driver"

source "drivers/huawei/wifi/driver/bcmdhd/Kconfig"
endmenu
```

## drivers/i2c/chips/Kconfig
```kconfig
#
# Miscellaneous I2C chip drivers configuration
#

menu "Miscellaneous I2C Chip support"

config INPUT_CWSTM32
       tristate "CyWee CWSTM32 Sensor HUB"
       depends on I2C && INPUT
       select INPUT_POLLDEV
       help
         This driver provides support for CWSTM32 Sensor HUB.

endmenu
```

## drivers/jpu/Kconfig
```kconfig
menu "JPEG decode support"

config JPEG_CODEC
    #depends on ANDROID_PMEM
    tristate "Support for hisi k3 Jpeg dec processor"
    default y
    help
        The decode device provides decode function for Jpeg
endmenu
```

## drivers/media/platform/exynos/fimc-is/Kconfig
```kconfig
config VIDEO_EXYNOS_FIMC_IS
	bool "Exynos FIMC-IS (Image Subsystem) driver"
	depends on VIDEO_EXYNOS
	select MEDIA_EXYNOS
	default n
	help
	  This is a v4l2 driver for exynos FIMC-IS device.
config COMPANION_USE
        bool "Enable to companion"
        depends on VIDEO_EXYNOS_FIMC_IS
        default n
        help
          Enable to companion.
config CAMERA_SENSOR_8B1
        bool "Use 8B1 camera sensor"
        depends on VIDEO_EXYNOS_FIMC_IS
        default n
        help
          Use 8B1 camera sensor.
```

## drivers/media/platform/odin-css/Kconfig
```kconfig
menuconfig VIDEO_ODIN
	bool "Mtekvision ODIN platform CSS"
	depends on VIDEO_V4L2
	default y
	---help---
	  Say Y here to enable ODIN Camera Sub-System(CSS) Interface

config VIDEO_ISP_MISC_DRIVER
	depends on VIDEO_ODIN
	bool "support isp misc driver"
	default y
	---help---
	  Say Y here to use isp misc driver

config VIDEO_ODIN_S3DC
	depends on VIDEO_ODIN
	bool "Stereoscopic 3d creator"
	---help---
	  Say Y here to use s3dc h/w driver

config VIDEO_ODIN_SYSFS
	depends on VIDEO_ODIN
	bool "Use sysfs for verification"
	default n
	---help---
	  Say Y here to use sysfs functional test

config VIDEO_ODIN_MIPI
	tristate "MIPI Sensor Logic Interface"
	depends on VIDEO_ODIN

config VIDEO_ODIN_FLASH
	tristate "Odin flash"
	depends on VIDEO_ODIN

config VIDEO_ODIN_OIS_ONE_FPS_TEST
	tristate "OIS Test - One FPS"
	depends on VIDEO_ODIN
	default n

config VIDEO_ODIN_SENSOR_A
	depends on VIDEO_ODIN_MIPI
	bool "Sensor A Module - MIPI Bayer"

config VIDEO_ODIN_SENSOR_IMX132
	depends on VIDEO_ODIN_MIPI
	bool "IMX032 Sensor Module - MIPI Bayer"

config VIDEO_ODIN_SENSOR_IMX111
	depends on VIDEO_ODIN_MIPI
	bool "IMX111 Sensor Module - MIPI Bayer"

config VIDEO_ODIN_SENSOR_IMX091
	depends on VIDEO_ODIN_MIPI
	bool "IMX091 Sensor Module - MIPI Bayer"

config VIDEO_ODIN_SENSOR_IMX135
	depends on VIDEO_ODIN_MIPI
	bool "IMX135 Sensor Module - MIPI Bayer"

config VIDEO_ODIN_SENSOR_IMX208
	depends on VIDEO_ODIN_MIPI
	bool "IMX208 Sensor Module - MIPI Bayer"

config VIDEO_ODIN_SENSOR_DUMMY
	depends on VIDEO_ODIN_MIPI
	bool "Dummy Sensor - FAKE Driver"

config VIDEO_ODIN_LASER_VL6180
	bool "VL6180 Proximity sensing module"
	depends on VIDEO_ODIN

source "drivers/media/platform/odin-css/jpegenc/Kconfig"
```

## drivers/media/platform/odin-css/jpegenc/Kconfig
```kconfig
config VIDEO_ODIN_JPEG_ENCODER
	tristate "ODIN JPEG encoder platform"
	default y
	depends on VIDEO_ODIN
	---help---
	  ODIN JPEG ENCODER interface 
```

## drivers/media/platform/tegra/nvavp/Kconfig
```kconfig
config TEGRA_NVAVP
	bool "Enable support for Tegra NVAVP driver"
	depends on ARCH_TEGRA && TEGRA_GRHOST
	default n
	help
	  Enables support for the push-buffer mechanism based driver for the Tegra
	  multimedia framework. Exports the Tegra nvavp interface on device node
	  /dev/tegra_avpchannel.

	  If unsure, say N

config TEGRA_NVAVP_AUDIO
	bool "Enable Audio Channel support for Tegra NVAVP driver"
	depends on TEGRA_NVAVP
	default n
	help
	  Enables support for the push-buffer mechanism based driver for the Tegra
	  audio multimedia framework. Exports the Tegra nvavp interface on device node
	  /dev/tegra_audio_avpchannel.

	  If unsure, say N

config TEGRA_NVAVP_REF_DEBUG
	bool "Enable Reference Debugging for Tegra NVAVP driver"
	depends on TEGRA_NVAVP
	default y
	help
	  Enables debugging reference to the NVAVP device in event that NVAVP driver
	  prevents system from going to sleep.

	  If unsure, say N
```

## drivers/misc/analogix/Kconfig
```kconfig
config SLIMPORT_ANX3618
	tristate  "Analogix slimport driver support"
	default n
	help
	  This enables support for Slimport device.
```

## drivers/misc/headset/Kconfig
```kconfig
# Copyright Statement:
#
#  Read-Copy Update mechanism for mutual exclusion
#
#  This program is free software; you can redistribute it and/or modify
#  it under the terms of the GNU General Public License as published by
#  the Free Software Foundation; either version 2 of the License, or
#  (at your option) any later version.
#
#  This program is distributed in the hope that it will be useful,
#  but WITHOUT ANY WARRANTY; without even the implied warranty of
#  MERCHANTABILITY or FITNESS FOR A PARTICULAR PURPOSE.  See the
#  GNU General Public License for more details.
#
#  Copyright MediaTek Corporation, 2010
#
#  Authors: Hua Fu <Hua.Fu@mediatek.com>
#         Yongqing Han <yongqing.han@mediatek.com>

config HTC_HEADSET_MGR
	tristate "HTC headset manager driver"
	default n
	help
	  Provides support of HTC headset manager.

config HTC_HEADSET_PMIC
	tristate "HTC PMIC headset detection driver"
	depends on HTC_HEADSET_MGR
	default n
	help
	  Provides support of HTC PMIC headset detection.

config HTC_HEADSET_ONE_WIRE
	tristate "HTC 1-wire headset detection driver"
	depends on HTC_HEADSET_MGR
	default n
	help
	  Provides support of HTC 1-wire headset detection.
```

## drivers/misc/mediatek/Kconfig
```kconfig
menuconfig MEDIATEK_SOLUTION
        bool "MediaTek Properitary Configuration"
        help
            Check this to enable MediaTek properity configuration.

if MEDIATEK_SOLUTION

config MTK_PLATFORM
	string
	default "mt8135" if ARCH_MT8135
	default "mt6582" if ARCH_MT6582

config ARCH_MTK_PROJECT
	string "MTK project name"

config MTK_INTERNAL
	bool "Enable MTK internal debug feature"
	help
	   Identify if codebase is built with MTK internal debug
	   (Don't modify this feature option setting.)

config HAVE_AEE_FEATURE
	bool "HAVE_AEE_FEATURE"
	help
	   AEE (Android Exception Engine) that designed by  Mediatek is an
	   exception catching and debugging information generation mechanism.
	   It can collect and dump information to filesystem
	   (/sdcard/mtklog/aee_exp)  when fatel occur(E.g. kernel
	   panic/android system server crash and ..) HAVE_AEE_FEATURE will
	   decide this feature enable or not.

config HAVE_XLOG_FEATURE
	bool "HAVE_XLOG_FEATURE"
	help
	   It decide whether the system has XLOG mechanism. XLOG is a log
	   filter mechanism which can filter the logs by tag before they are
	   written to log buffer

config HAVE_MTK_IN_HOUSE_TEE_SUPPORT
	def_bool n

config MTK_IN_HOUSE_TEE_SUPPORT
	bool "Enable MTK In House TEE Support"
	depends on HAVE_MTK_IN_HOUSE_TEE_SUPPORT
	default n
	help
	  This enable MTK TEE support.

config MTK_SEC_VIDEO_PATH_SUPPORT
	bool "Enable MTK Secure Video Path Support"
	depends on MTK_IN_HOUSE_TEE_SUPPORT
	default n
	help
	  This enable MTK Secure Video Path Support. (depending on MTK In-House TEE Support)

config MTK_OVERLAY_ENGINE_SUPPORT
    bool "Enable MTK Overlay Engine Support"
    default n
    help
      This enable MTK Video Path Overlay Engine Support.

config MTK_SEC_WFD_VIDEO_PATH_SUPPORT
    bool "Enable MTK Secure WFD Video Path Support"
    depends on MTK_SEC_VIDEO_PATH_SUPPORT
    depends on MTK_IN_HOUSE_TEE_SUPPORT
    default n
    help
      This enable MTK WFD Secure Video Path Support.

config MTK_SEC_HDMI_VIDEO_PATH_SUPPORT
    bool "Enable MTK Secure HDMI Video Path Support"
    depends on MTK_SEC_VIDEO_PATH_SUPPORT
    depends on MTK_IN_HOUSE_TEE_SUPPORT
    default n
    help
      This enable MTK HDMI Secure Video Path Support.

config MTK_DRM_KEY_MNG_SUPPORT
	bool "MTK_DRM_KEY_MNG_SUPPORT"
	depends on MTK_IN_HOUSE_TEE_SUPPORT
	default n
	help
	   support MTK DRM Key Management


config MTK_MMPROFILE_SUPPORT
	bool "Multimedia profiling mechanism"

config MTK_SECURITY_SW_SUPPORT
	bool "MTK_SECURITY_SW_SUPPORT"
	help
	   MTK_SECURITY_SW_SUPPORT=yes==> All security function in pre-
	   loader/LK/kernel/android will be built into software images

config MTK_EMMC_SUPPORT
	bool "MTK_EMMC_SUPPORT"
	help
	   eMMC feature enable/disable

config MTK_SHARED_SDCARD
	bool "MTK_SHARED_SDCARD"
	help
	   sdcard will be a folder of /data

config MTK_DT_SUPPORT
	bool "MTK_DT_SUPPORT"
	help
	   support dual talk

config EVDO_DT_SUPPORT
	bool "EVDO_DT_SUPPORT"
	help
	   To support GSM+CDMA dual talk feature

config MTK_SENSOR_SUPPORT
	bool "MTK_SENSOR_SUPPORT"
	help
	   sensor config to sensor port sensor feature in project

config MTK_AUTO_DETECT_ACCELEROMETER
	bool "MTK_AUTO_DETECT_ACCELEROMETER"
	depends on MTK_SENSOR_SUPPORT
	help
	   one load to support different accelerometer sensor

config MTK_AUTO_DETECT_MAGNETOMETER
	bool "MTK_AUTO_DETECT_MAGNETOMETER"
	depends on MTK_SENSOR_SUPPORT
	help
	   one load to support different magnetometer sensor

# Custom
config CUSTOM_KERNEL_ACCELEROMETER
	bool "CUSTOM_KERNEL_ACCELEROMETER"
	help
	   accelerometer sensor to detect accelerometer from x y z axis.

config CUSTOM_KERNEL_ALSPS
	bool "CUSTOM_KERNEL_ALSPS"
	help
	   ALSPS sensor driverto detect ambint light and the object is close
	   or far awary from device

config CUSTOM_KERNEL_EXTMD
	string "CUSTOM_KERNEL_EXTMD"

config CUSTOM_KERNEL_FLASHLIGHT
	string "CUSTOM_KERNEL_FLASHLIGHT"
	help
	   Kernel space cameara flashlight driver. You can use this driver
	   choose cameara flashlight type.

config CUSTOM_KERNEL_GYROSCOPE
	bool "CUSTOM_KERNEL_GYROSCOPE"
	help
	   gyro driver

config CUSTOM_KERNEL_HDMI
	string "CUSTOM_KERNEL_HDMI"
	help
	   Specify HDMI external IC type.

config CUSTOM_KERNEL_IMGSENSOR
	string "CUSTOM_KERNEL_IMGSENSOR"
	help
           Kernel space image sensor driver. Define  project used all image
           sensors .The value is combination of CUSTOM_KERNEL_MAIN_IMGSENSOR,
           CUSTOM_KERNEL_MAIN_BACKUP_IMGSENSOR, CUSTOM_KERNEL_SUB_IMGSENSOR,
           and CUSTOM_KERNEL_SUB_BACKUP_IMGSENSOR

config CUSTOM_KERNEL_LCM
	string "CUSTOM_KERNEL_LCM"
	help
	   To choose kernel LCM driver name

config CUSTOM_KERNEL_MAGNETOMETER
	bool "CUSTOM_KERNEL_MAGNETOMETER"
	help
	   compass driver to detect compass raw data and report orientatino
	   data

config CUSTOM_KERNEL_OFN
	bool "CUSTOM_KERNEL_OFN"

config CUSTOM_KERNEL_TOUCHPANEL
	string "CUSTOM_KERNEL_TOUCHPANEL"
	help
	   touch driver  need to report correct touch axes

config CUSTOM_SEC_AUTH_SUPPORT
	bool "CUSTOM_SEC_AUTH_SUPPORT"
	help
	   Support customer to implement and apply their own RSA security
	   functions


source "drivers/misc/mediatek/Kconfig.kernel"
source "drivers/misc/mediatek/Kconfig.drivers"

config MTK_THERMAL_STATUS_COLLECTION
        bool "MTK Thermal Status Information Collection"
        default n

config MD32_SUPPORT
	bool "Specifiy If Platform Support MD32"
	default n

endif
```
