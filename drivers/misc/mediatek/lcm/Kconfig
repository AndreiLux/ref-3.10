## drivers/soc/qcom/lge/Kconfig
```kconfig
config MACH_LGE
	bool

menu "LGE Board Selection"

config MACH_MSM8994_S3
	bool "MSM8994 S3"
	depends on ARCH_MSM8994
	select MACH_LGE
	help
	  Support for the Qualcomm MSM8994 S3 device.

config MACH_MSM8994_Z2
	bool "MSM8994 Z2"
	depends on ARCH_MSM8994
	select MACH_LGE
	help
		Support for the Qualcomm MSM8994 Z2 device.

config MACH_MSM8994_G4
	bool "MSM8994 G4"
	depends on ARCH_MSM8994
	select MACH_LGE
	help
		Support for the Qualcomm MSM8994 G4 device.

config MACH_MSM8994_Z2_SPR_US
	bool "MSM8994 Z2_SPR_US"
	depends on MACH_MSM8994_Z2
	select MACH_LGE
	help
	  Support for the Qualcomm MSM8994 Z2 SPR US device.

config MACH_MSM8994_Z2_KR
	bool "MSM8994 Z2_KR"
	depends on MACH_MSM8994_Z2
	select MACH_LGE
	help
	  Support for the Qualcomm MSM8994 Z2 KR device.
	  
config MACH_MSM8994_Z2_GLOBAL_COM
	bool "MSM8994 Z2_GLOBAL_COM"
	depends on MACH_MSM8994_Z2
	select MACH_LGE
	help
	  Support for the Qualcomm MSM8994 Z2 GLOBAL COM device.

config MACH_MSM8994_Z2_GLOBAL_ESA
	bool "MSM8994 Z2_GLOBAL_ESA"
	depends on MACH_MSM8994_Z2
	select MACH_LGE
	help
	  Support for the Qualcomm MSM8994 Z2 GLOBAL ESA device.

config MACH_MSM8994_Z2_USC_US
	bool "MSM8994 Z2_USC_US"
	depends on MACH_MSM8994_Z2
	select MACH_LGE
	help
	  Support for the Qualcomm MSM8994 Z2 USC US device.
	  
config MACH_MSM8994_Z2_ATT_US
	bool "MSM8994 Z2_ATT_US"
	depends on MACH_MSM8994_Z2
	select MACH_LGE
	help
	  Support for the Qualcomm MSM8994 Z2 ATT US device.

config MACH_MSM8994_G4_KR
    bool "MSM8994 G4_KR"
    depends on MACH_MSM8994_G4
    select MACH_LGE
    help
      Support for the Qualcomm MSM8994 G4 KR device.

config MACH_MSM8994_G4_LGU_KR
    bool "MSM8994 G4_LGU_KR"
    depends on MACH_MSM8994_G4_KR
    help
      Support for the Qualcomm MSM8994 G4 LGU KR device.

config MACH_MSM8994_G4_SKT_KR
    bool "MSM8994 G4_SKT_KR"
    depends on MACH_MSM8994_G4_KR
    help
      Support for the Qualcomm MSM8994 G4 SKT KR device.

config MACH_MSM8994_G4_KT_KR
    bool "MSM8994 G4_KT_KR"
    depends on MACH_MSM8994_G4_KR
    help
      Support for the Qualcomm MSM8994 G4 KT KR device.

config MACH_MSM8994_G4_ATT_US
    bool "MSM8994 G4_ATT_US"
    depends on MACH_MSM8994_G4
	select MACH_LGE
    help
      Support for the Qualcomm MSM8994 G4 ATT US device.

config MACH_MSM8994_G4_GLOBAL_COM
	bool "MSM8994 G4_GLOBAL_COM"
	depends on MACH_MSM8994_G4
	select MACH_LGE
	help
	  Support for the Qualcomm MSM8994 G4 GLOBAL COM device.

config MACH_MSM8994_G4_VZW
	bool "MSM8994 G4_VZW"
	depends on MACH_MSM8994_G4
	select MACH_LGE
	help
	  Support for the Qualcomm MSM8994 G4 VZW device.

config MACH_MSM8994_G4_SPR_US
	bool "MSM8994 G4_SPR_US"
	depends on MACH_MSM8994_G4
	select MACH_LGE
	help
	  Support for the Qualcomm MSM8994 G4 SPR US device.

config MACH_MSM8994_G4_USC_US
	bool "MSM8994 G4_USC_US"
	depends on MACH_MSM8994_G4
	select MACH_LGE
	help
	  Support for the Qualcomm MSM8994 G4 USC US device.

config MACH_MSM8994_G4_TMO_US
    bool "MSM8994 G4_TMO_US"
    depends on MACH_MSM8994_G4
	select MACH_LGE
    help
      Support for the Qualcomm MSM8994 G4 TMO US device.

config MACH_MSM8994_G4_CN
    bool "MSM8994 G4_CN"
    depends on MACH_MSM8994_G4
    select MACH_LGE
    help
      Support for the Qualcomm MSM8994 G4 CN device.

config MACH_MSM8994_G4_CMO_CN
    bool "MSM8994 G4_CMO_CN"
    depends on MACH_MSM8994_G4_CN
    select MACH_LGE
    help
      Support for the Qualcomm MSM8994 G4 CMO CN device.

config MACH_MSM8994_G4_CTO_CN
    bool "MSM8994 G4_CTO_CN"
    depends on MACH_MSM8994_G4_CN
    select MACH_LGE
    help
      Support for the Qualcomm MSM8994 G4 CTO CN device

config MACH_MSM8994_G4_KDDI_JP
    bool "MSM8994 G4_KDDI_JP"
    depends on MACH_MSM8994_G4
    select MACH_LGE
    help
      Support for the Qualcomm MSM8994 G4 KDDI JP device

endmenu

menu "LGE Specific Patches"

config LGE_PM
	tristate "Support LGE power-management"
	default n
	depends on MACH_LGE
	help
	  Global feature of LGE power-management

config LGE_PM_BCL
	tristate "Support LGE BCL Interface"
	default n
	depends on MACH_LGE
	help
	  LGE PM BCL Interface

config LGE_PM_USB_ID
	tristate "Support LGE PM USB ID feature"
	default n
	depends on MACH_LGE
	help
	  LGE PM USB ID about cable detection, etc

config LGE_PM_DEBUG
	tristate "Support LGE PM Debug Feature"
	default n
	depends on MACH_LGE
	help
	  LGE PM Debug Feature

config LGE_BOOTLOADER_LOG
	tristate "Support LGE bootloader log"
	default n
	depends on MACH_LGE
	help
	  LGE bootloader log

config LGE_PM_COMMON
	tristate "Support LGE PM common code"
	default n
	depends on MACH_LGE
	help
	  LGE PM common codes and temporary implementation codes

config LGE_PM_CHARGING_TEMP_SCENARIO
	tristate "Support LGE PM Charging temperature Scenario"
	default n
	depends on MACH_LGE
	help
	  LGE PM Charging temperature Scenario

config LGE_PM_SPR_OTP_SCENARIO
        tristate "Support Sprint OTP Scenario"
        default n
        depends on MACH_LGE
        help
          Support Sprint OTP(Over Temperature Proctection) Scenario

config LGE_PM_FACTORY_PSEUDO_BATTERY
	tristate "Support LGE PM pseudo battery mode"
	default n
	depends on MACH_LGE
	help
	  LGE PM pseudo battery mode

config LGE_PM_FACTORY_TESTMODE
	tristate "Support LGE PM pseudo battery mode"
	default n
	depends on MACH_LGE
	help
	  LGE PM pseudo battery mode

config LGE_HANDLE_PANIC
	tristate "Support LGE Kernel Panic Handler"
	default n
	depends on MACH_LGE
	help
	  LGE Crash Handler

config LGE_EARJACK_DEBUGGER
    bool "Earjack UART debugger support"
    default n
    help
      Support earjack type UART debugger cable

config LGE_KSWITCH
	bool "Support LGE Kill Switch"
	default n
	depends on MAC_LGE
	help
		LGE Kill Switch

config PRE_SELF_DIAGNOSIS
	tristate "Support LGE self diagnosis for factory"
	default n
	depends on MACH_LGE
	help
	  LGE self diagnosis

config LGE_BOOTLOADER_TIME_CHECKER
	bool "Show bootloader(LK, SBL) time"
	default n
	depends on MACH_LGE
	help
	  This shows the lk and sbl1 booting time in MSM8974.
	  If this feature is enabled, it should be check by adb shell.
	  Device Node : sys/module/lge_bootloader_time_checker/

config LGE_QSDL_SUPPORT
    tristate "Support for Quality Statistics Data Logging"
    default n
    depends on MACH_LGE
    help
       QSDL is a feature which notify infomation for quality statistics
       data logging of device.

config LGE_USER_MODE
    bool "User mode only"
    default n
	depends on MACH_LGE
    help
      Support for user mode only.
      If you need feature for user, use this.

endmenu

menu "LGE QFPROM Values"

config LGE_QFPROM_INTERFACE
	bool "Support qfprom interface"
	default n
	depends on MACH_LGE
	help
	  LGE QFPROM DRIVER.

config LGE_QFPROM_SECHASH
	string "Support qfprom sec hash"
	default 0x0
	depends on LGE_QFPROM_INTERFACE
	help
	  LGE QFPROM DRIVER-SEC partition's hash value.

endmenu
```

## drivers/staging/pasr/Kconfig
```kconfig
config ARCH_HAS_PASR
	bool

config PASR
	bool "DDR Partial Array Self-Refresh"
	depends on ARCH_HAS_PASR
	---help---
	  PASR consists on masking the refresh of unused segments or banks
	  when DDR is in self-refresh state.

config HI3630_PASR
	bool "HI3630 PASR driver"
	def_bool n
	depends on (PASR && ARCH_HISI)
	---help---
	  PASR support for Hi4511 board.

config PASR_DEBUG
	bool "Add PASR debug prints"
	def_bool n
	depends on PASR
```

## drivers/staging/trapz/Kconfig
```kconfig
config TRAPZ
	bool "Tracing and Profiling for Zpeed"
	default n
	help
		enable
		TRAPZ tool
		- Tracing and Profilling
		for Zpeed



config TRAPZ_TP
	bool "Globally enable trapz trace points in kernel"
	default n
	depends on TRAPZ
	help
		This enables trapz tracepoints.
		If this is disabled,
		and CONFIG_TRAPZ is enabled,
		userspace trapz tracing is still functional.

config TRAPZ_TRIGGER
	bool "Include ability to trigger events based on latency"
	default n
	depends on TRAPZ
	help
		This feature issues uevents if a trigger is fired.  The uevents can then
		be trapped in user space to react

config TRAPZ_PVA
       bool "Include PVA trace points"
       default n
       depends on TRAPZ
       help
       Include PVA features including Membo
```

## drivers/tzdriver/Kconfig
```kconfig
config  TZDRIVER
    tristate "Secure Execution Communicator driver"
    default n
    depends on SECURE_EXTENSION
    help
      Provides a communication interface between userspace and
      TrustZone Operating Environment.
```

## drivers/usb/host/odin_hsusb/Kconfig
```kconfig
#
# ODIN DWC USB Host driver
#

config ODIN_DWC_USB_HOST
	tristate "ODIN DWC USB Host Driver"
	depends on ARCH_ODIN
	help
	  Enable this to support the USB Host transceiver on ODIN.
```

## drivers/vcodec/Kconfig
```kconfig
menu "vcodec support drivers"
source "drivers/vcodec/imgvideo/Kconfig"
source "drivers/vcodec/vdec/Kconfig"
source "drivers/vcodec/venc/Kconfig"
endmenu
```

## drivers/video/exynos/panels/Kconfig
```kconfig
config DECON_LCD
	depends on EXYNOS_DECON
	bool "Select LCD panel driver"

config DECON_MDNIE_LITE
	depends on DECON_LCD && DECON_MIPI_DSI
	tristate "Support MDNIE LITE"
	default n

config DECON_MDNIE_LITE_CHAGALL
	depends on DECON_LCD && DECON_MIPI_DSI
	tristate "Support MDNIE LITE"
	default n

config LCD_HMT
	depends on DECON_LCD
	tristate "Support HMT display"
	default n

config LCD_ALPM
	depends on DECON_LCD
	tristate "Support ALPM mode"
	default n

config LCD_PCD
	depends on DECON_LCD
	tristate "Support PCD detection"
	default n

config DECON_LCD_S6E8AA0
	depends on DECON_LCD && DECON_MIPI_DSI
	tristate "S6E8AA0 AMOLED driver"

config DECON_LCD_S6E3FA0
	depends on DECON_LCD && DECON_MIPI_DSI
	tristate "S6E3FA0 AMOLED driver"

config DECON_LCD_S6E3HA0K
	depends on DECON_LCD && DECON_MIPI_DSI
	tristate "S6E3HA0K AMOLED driver"

config DECON_LCD_S6E3FA2
	depends on DECON_LCD && DECON_MIPI_DSI
	tristate "S6E8FA2 AMOLED driver"

config DECON_LCD_S6E3HA0
	depends on DECON_LCD && DECON_MIPI_DSI
	tristate "S6E3HA0 AMOLED driver"

config DECON_LCD_EA8064G
	depends on DECON_LCD && DECON_MIPI_DSI
	tristate "EA8064G AMOLED driver"

config DECON_LCD_S6E3HA2
	depends on DECON_LCD && DECON_MIPI_DSI
	tristate "S6E3HA2 AMOLED driver"

config DECON_LCD_S6E3HF2
	depends on DECON_LCD && DECON_MIPI_DSI
	tristate "S6E3HA2 AMOLED driver"

config DECON_LCD_S6TNMR7
	depends on DECON_LCD && DECON_MIPI_DSI
	tristate "S6TNMR7 AMOLED driver"
```

## drivers/video/msm/mdss/Kconfig
```kconfig
config FB_MSM_MDSS_WRITEBACK
	bool "MDSS Writeback Panel"
	---help---
	The MDSS Writeback Panel provides support for routing the output of
	MDSS frame buffer driver and MDP processing to memory.

config FB_MSM_MDSS_HDMI_PANEL
	depends on FB_MSM_MDSS
	bool "MDSS HDMI Tx Panel"
	default n
	---help---
	The MDSS HDMI Panel provides support for transmitting TMDS signals of
	MDSS frame buffer data to connected hdmi compliant TVs, monitors etc.

config FB_MSM_MDSS_HDMI_MHL_SII8334
	depends on FB_MSM_MDSS_HDMI_PANEL
	bool 'MHL SII8334 support '
	default n
	---help---
	  Support the HDMI to MHL conversion.
	  MHL (Mobile High-Definition Link) technology
	  uses USB connector to output HDMI content

config FB_MSM_MDSS_MHL3
	depends on FB_MSM_MDSS_HDMI_PANEL
	bool "MHL3 SII8620 Support"
	default n
	---help---
	  Support the SiliconImage 8620 MHL Tx transmitter that uses
	  USB connector to output HDMI content. Transmitter is an
	  i2c device acting as an HDMI to MHL bridge. Chip supports
	  MHL 3.0 standard.

config FB_MSM_MDSS_DSI_CTRL_STATUS
	tristate "DSI controller status check feature"
	---help---
	  Check DSI controller status periodically (default period is 5
	  seconds) by sending Bus-Turn-Around (BTA) command. If DSI controller
	  fails to acknowledge the BTA command, it sends PANEL_ALIVE=0 status
	  to HAL layer to reset the controller.

config FB_MSM_MDSS_EDP_PANEL
	depends on FB_MSM_MDSS
	bool "MDSS eDP Panel"
	---help---
	The MDSS eDP Panel provides support for eDP host controller driver
	which runs in Video mode only and is responsible for transmitting
	frame buffer from host SOC to eDP display panel.

config FB_MSM_MDSS_MDP3
	depends on FB_MSM_MDSS
	bool "MDP3 display controller"
	---help---
	The MDP3 provides support for an older version display controller
	included in latest display sub-system, known as MDSS.

config LGE_MIPI_P1_INCELL_QHD_CMD_PANEL
	bool "LGE_MIPI_P1_INCELL_QHD_CMD_PANEL"
	default n
	help
	  if you say yes here you get support for the JDI Incell Panel.

config LGE_P1_DSV
	bool "P1_DSV Power Management chip"
	default n
	select MACH_LGE
	help
	  if you say yes here you get support for the DW series of Power Management chips.

config FB_MSM_MDSS_XLOG_DEBUG
	depends on FB_MSM_MDSS
	bool "Enable MDSS debugging"
	---help---
	The MDSS debugging provides support to enable display debugging
	features to: Dump MDSS registers during driver errors, panic
	driver during fatal errors and enable some display-driver logging
	into an internal buffer (this avoids logging overhead).

config LGE_LCD_TUNING
       bool "Enable sysfs for LCD TUNING"
       default n

config LGE_LCD_OFF_DIMMING
	bool "Enable LCD DIMMING for FOTA"
	depends on MACH_LGE
	default n
	---help---
	Support for LCD DIMMING (for FOTA)


config LGE_SP_MIRRORING_CTRL_BL
	bool "SP_MIRRORING_CTRL_BL"
	default n
	select MACH_LGE
	help
	  if you say yes here you get support for sp mirroring backlight control

config LGE_PARTIAL_UPDATE
     bool "Enable partail update"
     default n

config LGE_P1_SRE_SUPPORTED
	bool "LGE_P1_SRE_SUPPORTED"
	default n
	help
	  if you say yes here you get support for Display Driver IC SRE function.

config LGE_CAM_PREVIEW_TUNE
    bool "Enable LGE_CAM_PREVIEW_TUNE"
    default n
```

## drivers/video/odin/Kconfig
```kconfig
source "drivers/video/odin/dss/Kconfig"
source "drivers/video/odin/odinfb/Kconfig"
source "drivers/video/odin/s3d/Kconfig"
source "drivers/video/odin/hdmi/Kconfig"
source "drivers/video/odin/xdengine/Kconfig"
source "drivers/video/odin/dsscomp/Kconfig"
source "drivers/video/odin/display/Kconfig"
source "drivers/video/odin/gfx/Kconfig"
source "drivers/video/odin/gfx/dualgfx/Kconfig"
```
