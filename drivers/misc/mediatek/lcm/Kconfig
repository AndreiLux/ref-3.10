## drivers/misc/mediatek/lcm/Kconfig
```kconfig
#
#  Mediatek LCM driver support list
#

menu "Mediatek LCM driver support"

config CM_N070ICE_DSI_VDO
	bool "Support for LCM cm_n070ice_dsi_vdo"
	default n
	help
	    Select this if you are using "cm_n070ice_dsi_vdo"

config CM_N070ICE_DSI_VDO_MT8135
	bool "Support for LCM cm_n070ice_dsi_vdo_mt8135"
	default n
	help
	    Select this if you are using "cm_n070ice_dsi_vdo_mt8135"
			To config mt8135_evbp1_v2 lcm driver. If choose yes
			cm_n070ice_dsi_vdo_mt8135 lcm driver will be used
			This add for half display issue
config HSD070PFW3_8135
	bool "Support for LCM HSD070PFW3_8135"
	default n
	help
	    Select this if you are using "HSD070PFW3_8135"

config CPT_CLAA101FP01_DSI_VDO
	bool "Support for LCM CPT_CLAA101FP01_DSI_VDO"
	default n
	help
	    Select this if you are using "CPT_CLAA101FP01_DSI_VDO"

config NT35521_WXGA_DSI_VDO_HH060IA
	bool "Support for LCM nt35521_wxga_dsi_vdo_hh060ia"
	default n
	help
	    Select this if you are using "nt35521_wxga_dsi_vdo_hh060ia"

config NT51012_WXGA_DSI_VDO
	bool "Support for LCM nt51012_wxga_dsi_vdo"
	default n
	help
	    Select this if you are using "nt51012_wxga_dsi_vdo"

endmenu
```

## drivers/misc/modem_v1/Kconfig
```kconfig
menuconfig SEC_MODEM_V1
	bool "Samsung's Mobile Modem Driver with Memory-type Interface Media"
	default n
	---help---
	  Samsung's mobile modem driver with memory-type interface media

config BOOT_DEVICE_SPI
	bool "boot device: SPI"
	depends on SEC_MODEM_V1
	default n

config LINK_DEVICE_MEMORY
	bool "link device: MIPI-LLI"
	depends on SEC_MODEM_V1
	default y

config LINK_DEVICE_LLI
	bool "link device: MIPI-LLI"
	depends on SEC_MODEM_V1
	select LINK_DEVICE_MEMORY
	select MIPI_LLI
	default n

config UMTS_MODEM_SS300
	bool "modem chip: SEC SS300"
	depends on SEC_MODEM_V1
	select BOOT_DEVICE_SPI
	select LINK_DEVICE_LLI
	default n
```

## drivers/misc/qcom-mdm-9k/Kconfig
```kconfig
menu "Qualcomm Modem Drivers"

if QCT_9K_MODEM

config QCOM_USB_MODEM_POWER
       bool "Qualcomm USB modem power driver"
       depends on USB
       default n
       ---help---
         Say Y if you want to use one of the following modems
         QCT 9x15
         QCT 9x25

         Disabled by default. Choose Y here if you want to build the driver.

config MDM_FTRACE_DEBUG
       bool "Enable ftrace debug support"
       depends on QCOM_USB_MODEM_POWER
       default n
       help
         To enable ftrace debug

config MDM_ERRMSG
       bool "set error message"
       depends on QCOM_USB_MODEM_POWER
       default n
       help
         Print error message in panic

config MDM_POWEROFF_MODEM_IN_OFFMODE_CHARGING
       bool "power off modem in offmode charging"
       depends on QCOM_USB_MODEM_POWER
       default n
       help
         To power off modem in offmode charging

config MSM_SUBSYSTEM_RESTART
       bool "MSM Subsystem Restart Driver"
       depends on QCOM_USB_MODEM_POWER
       default n
       help
         This option enables the MSM subsystem restart driver, which provides
         a framework to handle subsystem crashes.

config MSM_HSIC_SYSMON
       tristate "MSM HSIC system monitor driver"
       depends on USB
       default n
       help
         Add support for bridging with the system monitor interface of MDM
         over HSIC. This driver allows the local system monitor to
         communicate with the remote system monitor interface.

config MSM_SYSMON_COMM
       bool "MSM System Monitor communication support"
       depends on MSM_SUBSYSTEM_RESTART
       default n
       help
         This option adds support for MSM System Monitor library, which
         provides an API that may be used for notifying subsystems within
         the SoC about other subsystems' power-up/down state-changes.

config MDM_SYSEDP
       bool "Modem Sysedp support"
       depends on SYSEDP_FRAMEWORK
       default n
       help
         This option adds support to system EDP to handle the power

endif # QCT_9K_MODEM

endmenu
```

## drivers/misc/slimport_anx7812/Kconfig
```kconfig
config SLIMPORT_ANX7812
	tristate "Analogix Slimport transmitter ANX7812 support"
	help
	  Slimport Transmitter is a HD video transmitter chip
	  over micro-USB connector for smartphone device.
```

## drivers/misc/ts0710mux/Kconfig
```kconfig
config TS0710_MUX
	bool "TS0710 multiplexer"
	default n
	help
	  Say 'Y' to enable TS0710 multiplexer

config LGE_KERNEL_MUX
	bool "LGE KERNEL MUX"
	depends on TS0710_MUX
	default n
	help
	  Say 'Y' to enable LGE KERNEL MUX (?)
```

## drivers/modem/Kconfig
```kconfig
#
# ST-Ericsson Modem driver configuration
#
menuconfig STE
	tristate "ST-Ericsson Modem support"
	---help---

#
# Intel Modem driver configuration
#
menuconfig IMC
	tristate "Intel Mobile Communications Modem support"
	---help---


if STE

source "drivers/modem/m7450/Kconfig"

endif # STE

if IMC

source "drivers/modem/XMM7260/Kconfig"

endif # IMC
```

## drivers/modem/XMM7260/Kconfig
```kconfig
# Flashed [START]
# IMC Modem Control driver

comment "Intel Mobile Communications Modem Device Driver"

config IMC_MODEM
	tristate "IMC device driver"
	depends on IMC
	---help---

config TEGRA_BB_XMM_POWER
	tristate "IMC device power driver"
	depends on IMC_MODEM
# Flashed [END]

# Flashless [START]
# Flashless Modem Control Driver.
# Perform power on/reset/power off on IMC modems

config IMC_DRV
	tristate "Modem control driver"
	depends on IMC
	---help---
	  The modem control driver for IMC modems. This driver will perform any
	  power request on IMC modems. It will create /dev/mdm_ctrl char device
	  by default.
	  Verified for XMM6260, XMM7160, XMM6360 and XMM 6263 modems.

config IMC_LOG_OFF
	tristate "Disable logging for Modem control driver"
	depends on IMC
	---help---
	  Disable logging for Modem control driver and Host controller driver.
# Flashless [END]
```

## drivers/modem/m7450/Kconfig
```kconfig
#
# M7400 Modem HPM driver
#

comment "M7450 HSIC PM Device Driver"

config M7450_HSIC
	tristate "M7450 HPM device driver"
	depends on STE
	---help---
```

## drivers/motor/Kconfig
```kconfig
#
# Immersion TouchSense Player driver configuration
#
menuconfig VIBETONZ
	tristate "Vibetonz"
	default y
	help
	Say Y to enable Vibetonz support.
	-------------
	-------------
	-------------

config TACTILE_ASSIST
	tristate "Auto Haptic"
	default n
	depends on VIBETONZ

config MOTOR_DRV_MAX77828
	tristate "Maxim MAX77828 motor"
	default n
	depends on MFD_MAX77828

config MOTOR_DRV_MAX77843
	tristate "Maxim MAX77843 motor"
	default n
	depends on MFD_MAX77843

config MOTOR_DRV_MAX77804K
	tristate "Maxim MAX77804K motor"
	default n
	depends on MFD_MAX77804K
```

## drivers/muic/Kconfig
```kconfig
#
# MUIC devices
#

comment "MUIC configs"

config USE_MUIC
	bool "Using MUIC device driver"
	depends on I2C
	default n
	help
	  If you say yes here you will get support for
	  the MUIC device driver.

config USE_SAFEOUT
	bool "Using SAFEOUT device driver"
	depends on I2C
	default n
	help
	  If you say yes here you will get support for
	  the SAFEOUT device driver.

config MUIC_NOTIFIER
	bool "MUIC notifier support"
	depends on USE_MUIC
	default n
	help
	  If you say yes here you will get support for
	  the MUIC attached device status change notification.

config SAMSUNG_MUIC
	bool "Using samsung MUIC chip driver"
	depends on USE_MUIC
	default n
	help
	  If you say yes here you will get support for the MUIC chip.

config MUIC_ADCMODE_SWITCH_WA
	bool "Using MUIC chip ADC Mode change W/A"
	depends on USE_MUIC
	default n
	help
	  This feature is for MUIC chip's ADC Mode change
	  chip bug Workaround.

config MUIC_FSA9480
	tristate "FSA9480 USB Switch"
	depends on I2C
	help
	  The FSA9480 is a USB port accessory detector and switch.
	  The FSA9480 is fully controlled using I2C and enables USB data,
	  stereo and mono audio, video, microphone and UART data to use
	  a common connector port.

config MUIC_MAX77804
	bool "Using MAX77804 MUIC"
	depends on MFD_MAX77804 && USE_MUIC
	default n
	help
	  If you say yes here you will get support for
	  for the MAX77804 MUIC chip.

config MUIC_MAX77804K
	bool "Using MAX77804K MUIC"
	depends on MFD_MAX77804K && USE_MUIC
	default n
	help
	  If you say yes here you will get support for
	  for the MAX77804K MUIC chip.

config MUIC_MAX77828
	bool "Using MAX77828 MUIC"
	depends on MFD_MAX77828 && USE_MUIC
	default n
	help
	  If you say yes here you will get support for
	  for the MAX77828 MUIC chip.

config MUIC_MAX77888
	bool "Using MAX77888 MUIC"
	depends on MFD_MAX77888 && USE_MUIC
	default n
	help
	  If you say yes here you will get support for
	  for the MAX77888 MUIC chip.
```

## drivers/net/wireless/mt66xx/Kconfig
```kconfig
menu "MediaTek WLAN Config"

config MTK_COMBO_WIFI
	tristate "MediaTek Combo Chip Wi-Fi support"
	depends on MTK_COMBO
	depends on MMC
	depends on IPV6
	depends on !mt592x
	select WIRELESS_EXT
	select WEXT_PRIV
	select MTK_WLAN_SUPPORT
	help
	  This module adds support for wireless adapters based on
	  MTK MT6620 chipset.

	  This driver uses the kernel's wireless extensions subsystem.

	  If you choose to build a module, it'll be called dhd. Say M if
	  unsure.

config MTK_WLAN_CHIP
	string "MTK_WLAN_CHIP"
	default "MT6620" if MTK_COMBO_CHIP_MT6620
	default "MT6628" if MTK_COMBO_CHIP_MT6628
	help
	   Define the wlan chip type

config MTK_WLAN_SUPPORT
	bool
	help
	   The Wlan switch for the wlan feature in the Android(app,
	   framework, native, kernel).

config MTK_WAPI_SUPPORT
	bool "MTK_WAPI_SUPPORT"
	help
	   if it is set to TRUE: Support WAPI (WLAN Authentication and
	   Privacy Infrastructure) if it is set to FALSE: Does not Support
	   WAPI (WLAN Authentication and Privacy Infrastructure)

endmenu
```

## drivers/nfc/Kconfig
```kconfig
#
# Near Field Communication (NFC) devices
#

menu "Near Field Communication (NFC) devices"
	depends on NFC

config NFC_PN533
	tristate "NXP PN533 USB driver"
	depends on USB
	help
	  NXP PN533 USB driver.
	  This driver provides support for NFC NXP PN533 devices.

	  Say Y here to compile support for PN533 devices into the
	  kernel or say M to compile it as module (pn533).

config NFC_WILINK
	tristate "Texas Instruments NFC WiLink driver"
	depends on TI_ST && NFC_NCI
	help
	  This enables the NFC driver for Texas Instrument's BT/FM/GPS/NFC
	  combo devices. This makes use of shared transport line discipline
	  core driver to communicate with the NFC core of the combo chip.

	  Say Y here to compile support for Texas Instrument's NFC WiLink driver
	  into the kernel or say M to compile it as module.

config NFC_MEI_PHY
	tristate "MEI bus NFC device support"
	depends on INTEL_MEI && NFC_HCI
	help
	  This adds support to use an mei bus nfc device. Select this if you
	  will use an HCI NFC driver for an NFC chip connected behind an
	  Intel's Management Engine chip.

	  If unsure, say N.

source "drivers/nfc/pn544/Kconfig"
source "drivers/nfc/microread/Kconfig"

endmenu

config NFC_QNCI
	bool "Qualcomm NCI based NFC Controller Driver for qca199x"
	depends on I2C
	select CRC_CCITT
	help
	  This enables the NFC driver for QCA199x based devices.
	  This is for i2c connected version. NCI protocol logic
	  resides in the usermode and it has no other NFC dependencies.

config LGE_NFC
	bool "NFC Device Enabled for LGE"
	default n

config LGE_NFC_PN547_C2
	bool "PN547 C2 NFC driver"
	depends on I2C
	select CRC_CCITT
	default n
	---help---
	  Say yes if you want PN547 Near Field Communication driver.
	  This is for i2c connected version. If unsure, say N here.

	  To compile this driver as a module, choose m here. The module will
	  be called pn547.

config LGE_NFC_PRESTANDBY
	bool "NFC STANBY MODE"
	default n
	---help---
	  Say yes if you want to change a power state of pn544 to stanby mode in Kernel.
	  If unsure, say N here.

config LGE_NFC_MULTICORE_FASTBOOT
	bool "NFC MultiThread"
	default n
	---help---
	  Say yes if multi thread is applied for pre-standby.
	  If unsure, say N here.

config LGE_NFC_SET_IRQ_WAKEUP
	bool "NFC Set IRQ wakeup when NFC ON"
	default n
	---help---
	  Say yes if Set IRQ Wakeup NFC ON.
	  If unsure, say N here.

config LGE_NFC_DEBUG_MESSAGE
	bool "NFC Debug Message"
	default n

config LGE_NFC_USE_PMIC
	bool "NFC Using PMIC Clock"
	default n
	---help---
	  Say yes if you want to use PMIC Clock.
	  If use XTAL or unsure, say N here.
	  Please refer to [NFC-367] for more details.

config LGE_NFC_SONY
    bool "CXD2235BGG NFC driver for kddi"
    #depends on I2C && UART
    default n
    ---help---
      Say yes if you want CDX2235AGG Near Field Communication driver.
      This is for i2c & UART connected version. If unsure, say N here.

      To compile this driver as a module, choose m here. The module will
      be called CDX2235AGG.

source "drivers/nfc/snfc/Kconfig"
```

## drivers/power/huawei/Kconfig
```kconfig
config POWER_HUAWEI
        bool "security device module"
        default y
config BATTERY_HISI_HI6421V300
	bool "hisi hi6421v300"
	default y
config BATTERY_HISI_COUL
        bool "hisi coul"
        default y
config BATTERY_HISI_COUL_TEST
        bool "hisi coul test"
        default y
config BQ_BCI_BATTERY
        bool "bq bci bqttery"
        default y
config BQ2419X_CHARGER
        bool "bq2419x charger"
        default y
```

## drivers/sensorhub/atmel/Kconfig
```kconfig
#
# sensor drivers configuration
#
config SENSORS_SYSFS
	tristate "Sensors sysfs"
	help
	  Support sysfs for sensors.
          If you say yes here you get sysfs support for
	  sensor factory test.
	  To compile this driver as a module, choose M here: the
	  module will be called sensors_core.

config SENSORS_SSP
	tristate "Sensors ssp"
	default n
	depends on SPI
	help
	  ssp driver for sensor hub.
          If you say yes here you get ssp support for
	  sensor hub.
	  To compile this driver as a module, choose M here: the
	  module will be called ssp.

config SENSORS_SSP_SENSORHUB
	tristate "Sensors ssp sensorhub"
	default n
	depends on SPI
	help
	  ssp sensor hub driver for sensor hub.
          If you say yes here you get ssp support for
	  sensor hub.
	  To compile this driver as a module, choose M here: the
	  module will be called ssp.

config SENSORS_SSP_FACTORY
	tristate "ssp factory"
	depends on SENSORS_SSP
	default n
	help
	  ssp sensor hub driver for factory test.
          If you say yes here you can enable fatory drvier for
	  factory test.
	  To compile this driver as a module, choose M here: the
	  module will be called ssp.

config SENSORS_MAX86900
	tristate "MAXIM MAX86900 HRM Sensor"
	default n
	depends on I2C && SYSFS
	help
	  If you say yes here you get support for the MAX86900
	  HRM sensor.
	  This driver can also be built as a module.  If so, the module
	  will be called max86900.

config SENSORS_MAX86902
	tristate "MAXIM MAX86902 UV HRM Sensor"
	default n
	depends on I2C
	help
	  If you say yes here you get support for the MAX86902
	  HRM sensor & uv sensor.
	  This driver can also be built as a module.  If so, the module
	  will be called MAX86902.

config SENSOR_SSP_PROXIMTY_FOR_WINDOW_TYPE
	tristate "PROXIMITY THRESHOLD FOR WINDOW_TYPE"
	default n
	depends on SPI
	help
	  If you say yes here you get support for the proximity threshold
	  This threshold is changed by window type.

config SENSORS_SSP_ACC_CHECK
	tristate "Ssp acc check"
	default n
	depends on SPI
	help
	  ssp sensor hub acc sensordata check routine.
	  If you say yes here you enable this routine.

source "drivers/sensorhub/atmel/factory/Kconfig"
```
