## drivers/video/odin/display/Kconfig
```kconfig
menu "ODIN Display Device Drivers"
        depends on ODIN_DSS

config PANEL_XXXXXXXX
        tristate "XXXXXXXX LCD Panel"
	depends on ODIN_DSS
        help
	  XXXXXXXX panel driver
	  
config PANEL_SAMPLE0
	tristate "SAMPLE0 LCD Panel"
	depends on ODIN_DSS
	help
	  SAMPLE0 panel driver
	  
config PANEL_SAMPLE1
        tristate "SAMPLE1 LCD Panel"
        depends on ODIN_DSS
        help
	  SAMPLE1 panel driver

config PANEL_LGLH500WF1
	tristate "LGLH500WF1 mipi panel"
	depends on ODIN_DSS
	help
	  MIPI LHLH500WF1 panel driver

# LGE_CHANGE_S
config PANEL_LGLH600WF2
	tristate "LGLH600WF2 mipi panel"
	depends on ODIN_DSS
	help
	  MIPI LHLH600WF2 panel driver
# LGE_CHANGE_E


config PANEL_LGLH520WF1
	tristate "LGLH520WF1 mipi panel"
	depends on ODIN_DSS
	help
	  MIPI LHLH520WF1 panel driver

config PANEL_AT070TN94
        tristate "Innolux AT070TN94 LCD Panel"
        depends on ODIN_DSS
        help
          AT070TN94 panel driver

config PANEL_LMS480
        tristate "LMS480 LCD Panel"
        depends on ODIN_DSS
        help
          LMS480 panel driver

config PANEL_SLT_DSI
        tristate "SLT DSI Panel"
        depends on ODIN_DSS
        help
          SLT DSI panel driver

config PANEL_SLT_HDMI
        tristate "SLT HDMI Panel"
        depends on ODIN_DSS
        help
          SLT HDMI panel driver

endmenu
```

## drivers/video/odin/dss/Kconfig
```kconfig
menuconfig ODIN_DSS
        tristate "ODIN Display SubSystem Support"
        depends on ARCH_ODIN
        help
	  display subsystem driver for ODIN based boards.

if ODIN_DSS
config ODIN_DSS_DEBUG_SUPPORT
        bool "Debug support for ODIN Display SubSystem"
	default y
	depends on ODIN_DSS
	help
	  Support for debug output. You have to enable the actual printing
	  with 'debug' module parameter.
	  
config ODIN_DSS_FPGA
        bool "ODIN DSS FPGA"
	default y
	depends on MACH_ODIN_FPGA
	help
	  Support for odin dss fpga board only. 	  

	  
config LCD_KCAL 
        bool "LCD KCAL"
	default y
	help
	  Support for lcd kcal. 	  

config LCD_MIPI_SPEED_SET
        bool "LCD_MIPI_SPEED_SET"
	default y
	help
	  Support for LCD MIPI speed setting

endif
```

## drivers/video/odin/dsscomp/Kconfig
```kconfig
menuconfig ODIN_DSSCOMP
        tristate "ODIN DSS Composition Support"
        depends on ARCH_ODIN
        help
	  display subsystem driver for ODIN based boards.

if ODIN_DSSCOMP
config DSSCOMP_DEBUG_LOG
        bool "Debug support for ODIN DSS COMPOSITION"
	default y
	depends on ODIN_DSSCOMP
	help
	  Support for debug output. You have to enable the actual printing
	  with 'debug' module parameter.

endif
```

## drivers/video/odin/gfx/Kconfig
```kconfig
menuconfig ODIN_GFX
        tristate "ODIN GFX support"
        depends on ARCH_ODIN
        help
	  GFX driver for ODIN based boards.

config ODIN_GFX_DEBUG_SUPPORT
        bool "Debug support for ODIN GFX"
	default n 
	depends on ODIN_GFX
	help
	  Support for debug output. You have to enable the actual printing
	  with 'debug' module parameter.
```

## drivers/video/odin/gfx/dualgfx/Kconfig
```kconfig
config ODIN_DUAL_GFX
        bool "Enable ODIN Dual GFX ODIN GFX"
        default y
        depends on ODIN_GFX
        help
          Support for Dual GFX operation.
```

## drivers/video/odin/hdmi/Kconfig
```kconfig
menuconfig ODIN_HDMI
        tristate "ODIN HDMI support"
        depends on ODIN_DSS
        help
	  HDMI driver for ODIN based boards.

config ODIN_HDMI_DEBUG_SUPPORT
        bool "Debug support for ODIN HDMI"
	default y
	depends on ODIN_HDMI
	help
	  Support for debug output. You have to enable the actual printing
	  with 'debug' module parameter.
```

## drivers/video/odin/odinfb/Kconfig
```kconfig
menuconfig ODIN_FB
        tristate "ODIN frame buffer support"
        depends on FB 

        select FB_CFB_FILLRECT
        select FB_CFB_COPYAREA
        select FB_CFB_IMAGEBLIT
        help
	  Frame buffer driver for ODIN based boards.

config ODIN_FB_DEBUG_SUPPORT
        bool "Debug support for ODIN FB"
	default y
	depends on ODIN_FB
	help
	  Support for debug output. You have to enable the actual printing
	  with 'debug' module parameter.

config ODIN_FB_NUM_FBS
	int "Number of framebuffers"
	range 1 10
	default 2
	depends on ODIN_FB
	help
	  Select the number of framebuffers created. ODIN has 3 overlays
	  so normally this would be 3.
```

## drivers/video/odin/s3d/Kconfig
```kconfig
menuconfig ODIN_S3D
        tristate "ODIN 3D Formatter support"
        depends on ODIN_DSS
        help
	  S3D driver for ODIN based boards.

config ODIN_S3D_DEBUG_SUPPORT
        bool "Debug support for ODIN S3D"
	default y
	depends on ODIN_S3D
	help
	  Support for debug output. You have to enable the actual printing
	  with 'debug' module parameter.
```

## drivers/video/odin/xdengine/Kconfig
```kconfig
menuconfig ODIN_XDENGINE
        tristate "ODIN XD Engine support"
        depends on ODIN_DSS
        help
	  S3D driver for ODIN based boards.

config ODIN_XDENGINE_DEBUG_SUPPORT
        bool "Debug support for ODIN XD Engine"
	default y
	depends on ODIN_XDENGINE
	help
	  Support for debug output. You have to enable the actual printing
	  with 'debug' module parameter.
```

## drivers/vpp/Kconfig
```kconfig
config HIK3_VPP
    tristate "vpp driver"
    default y
    ---help---
        This is the vpp driver
```

## fs/exfat/Kconfig
```kconfig
config EXFAT_FS
	tristate "EXFAT filesystem support"
	select NLS
	select NLS_UTF8
	help
	  exFAT filesystem support
```

## sound/soc/hisilicon/Kconfig
```kconfig
menu "SoC Audio support for HI3630"

config SND_SOC_PCM_HI3630
	tristate "SoC Audio support for HI3630"
	help
	  Say y to enable this option for HI3630 I2S audio support.

config SND_HI3630_HI6401
	tristate "Hi3630-Hi6401 sound support"
	help
	  Say y to enable sound support for Hi3630-Hi6401

endmenu
```

## sound/soc/mediatek/Kconfig
```kconfig
config MT_SND_SOC_V1
    bool "MT_SND_SOC_V1"
    default n
    help
        If you say Y, enable MT_SND_SOC_V1_driver.
config MT_SND_SOC_V2
    bool "MT_SND_SOC_V2"
    default y
    help
        If you say Y, enable MT_SND_SOC_V2_driver.
config MTK_SPEAKER
    bool "MTK_SPEAKER"
    default y
    help
        If you say Y, enable MTK_SPEAKER_AMP        
config MTK_NXP_TFA9890
    bool "MTK_NXP_TFA9890"
    default n
    help
        If you say Y, enable MTK_NXP_TFA9890 driver.
config MTK_EXT_DAC
    bool "MTK_EXT_DAC"
   default n
    help                                       
        If you say y, enable MTK_EXT_DAC Fucntion
```

## sound/soc/mediatek/mt8135/Kconfig
```kconfig
choice
    prompt "MT8135 ASOC platform"

config SND_SOC_MT8135_GENERIC
    bool "MT8135 GENERIC"
	  help
	    Say Y if you want to use the default
	    Mediatek SoCs' Audio interfaces for MT8135.
	    It is the turnkey solution.

config SND_SOC_MT8135_ARIEL
	  bool "MT8135 Ariel"
	  select SND_SOC_MAX97236
	  help
	    Say Y if you want to use the Lab126 Ariel
	    Audio interfaces for MT8135.
	    It will also add codec support of MAX97236
endchoice
```

## sound/soc/odin/Kconfig
```kconfig
config SND_SOC_ODIN_AUDIO_POWER_CLOCK
    tristate "SoC Audio of power and clock driver for the Odin System-on-Chip"
    depends on ARCH_ODIN

config SND_SOC_ODIN_HDMI_ASAMPLE
    tristate "Odin HDMI alink driver sample"

config SND_SOC_ODIN_UTILS
    bool "Odin ASoC utils"

config SND_SOC_ODIN_HW_SEMAPHORE_DRIVER
    bool "Odin HW Semaphore driver"

config SND_SOC_ODIN_AUDIO_SEMAPHORE_MODULE
    tristate "Audio Semaphore Mudule device driver"
    select SND_SOC_ODIN_HW_SEMAPHORE_DRIVER

config SND_SOC_ODIN_PCM_DRAM
    tristate "Pcm buffers are located to main ram"

config SND_SOC_ODIN_PCM_SRAM
    tristate "Pcm buffers are located to audio static ram(=dsp ram)"

config SND_SOC_WODEN
    tristate "SoC Audio for the Woden System-on-Chip"
    depends on ARCH_WODEN && WODEN_DMA
    help
      Say Y or M here if you want support for SoC audio on Woden.

config SND_SOC_ODIN
    tristate "SoC Audio for the Odin System-on-Chip"
    depends on ARCH_ODIN
    select SND_SOC_DMAENGINE_PCM
    select SND_SOC_ODIN_PCM_DRAM
    select SND_SOC_ODIN_PCM_SRAM
    select SND_SOC_ODIN_AUDIO_POWER_CLOCK
    help
      Say Y or M here if you want support for SoC audio on Odin.

config SND_SOC_WODEN_I2S
    tristate "Woden I2S driver"
    depends on SND_SOC_WODEN
    help
      Say Y or M if you want to add support for codecs attached to the
      Woden I2S interface. You will also need to select the individual
      machine drivers to support below.

config SND_SOC_ODIN_MI2S
    tristate "Odin Multi I2S driver"
    depends on SND_SOC_ODIN
    help
      Say Y or M if you want to add support for codecs attached to the
      Odin I2S interface. You will also need to select the individual
      machine drivers to support below.

config SND_SOC_ODIN_SI2S
    tristate "Odin Single I2S driver"
    depends on SND_SOC_ODIN
    help
      Say Y or M if you want to add support for codecs attached to the
      Odin I2S interface. You will also need to select the individual
      machine drivers to support below.

config SND_SOC_ODIN_ALSA_DSP
    tristate "SoC Audio for the Odin System-on-Chip with DSP"
    help
      Say Y or M here if you want support for SoC audio on ODIN with DSP

config SND_SOC_ODIN_ALSA_DSP_EXT
    tristate "Odin DSP external driver"
    depends on SND_SOC_ODIN_ALSA_DSP
    help
      Say Y or M here if you want support for DSP external driver

config SND_SOC_WODEN_WM8580
    tristate "SoC Audio support for Woden fpga boards using a WM8580 codec"
    depends on SND_SOC_WODEN && I2C
    select SND_SOC_WODEN_I2S
    select SND_SOC_WM8580
    help
      Say Y or M here if you want to add support for SoC audio on Woden
      boards using the WM8580 codec. Currently, the supported boards are
      EVB, HDK.

config SND_SOC_WODEN_WM5102
    tristate "SoC Audio support for Woden hdk boards using a WM5102 codec"
    depends on SND_SOC_WODEN && I2C
    select SND_SOC_WODEN_I2S
    select SND_SOC_WM5102
    help
      Say Y or M here if you want to add support for SoC audio on Woden
      boards using the WM8580 codec. Currently, the supported boards are
      EVB, HDK.

config SND_SOC_ODIN_FPGA_WM5102
    tristate "SoC Audio support for Odin FPGA board using a WM5102 codec"
    depends on SND_SOC_ODIN && I2C
    select SND_SOC_ODIN_UTILS
    select SND_SOC_ODIN_SI2S
    select SND_SOC_WM5102
    help
      Say Y or M here if you want to add support for SoC audio on Odin
      fpga board using the WM5102 codec.

config SND_SOC_ODIN_MADK_WM5102
    tristate "SoC Audio support for Odin MADK board using a WM5102 codec"
    depends on SND_SOC_ODIN && I2C
    select SND_SOC_ODIN_UTILS
    select SND_SOC_ODIN_SI2S
    select SND_SOC_WM5102
    help
      Say Y or M here if you want to add support for SoC audio on Odin
      madk board using the WM5102 codec.

config SND_SOC_ODIN_DSP_WM5102
    tristate "SoC Audio support for Odin board using a WM5102 codec with DSP"
    depends on I2C
    depends on SND_SOC_ODIN_ALSA_DSP
    select SND_SOC_ODIN_UTILS
    select SND_SOC_WM5102
    help
      Say Y or M here if you want to add support for SoC audio on Odin
      board using the WM5102 codec with DSP.

config SND_SOC_ODIN_RT5671
    tristate "SoC Audio support for odin hdk boards using a alc5671 codec"
    depends on SND_SOC_ODIN && I2C
    select SND_SOC_ODIN_UTILS
    select SND_SOC_ODIN_SI2S
    select SND_SOC_RT5671
    help
      Say Y or M here if you want to add support for SoC audio on Odin hdk
      boards using the rt5671 codec. Currently, the supported boards are
      EVB, HDK.

config SND_SOC_ODIN_MADK_HDMI
    tristate "SoC Audio support for Odin MADK board using the HDMI"
    depends on SND_SOC_ODIN
    select SND_SOC_ODIN_UTILS
    select SND_SOC_ODIN_MI2S
    select SND_SOC_ODIN_HDMI_CODEC
    help
      Say Y or M here if you want to add support for SoC audio on Odin
      madk board using the external HDMI chip or the inner HDMI IP.

config SND_SOC_SI2S_TO_MI2S_IO
    bool "SI2S I/O funcs can change to MI2S"
    depends on SND_SOC_ODIN_MADK_HDMI

config SND_SOC_ODIN_COMPR
	tristate "SoC Compress ALSA audio driver for DSP"
    help
     To add support for Odin Soc Compress Audio.
     This will enable sound soc platform specific
     audio drivers. This includes tensilica DSP
	 to DSP using apr.
```
